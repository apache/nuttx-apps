## benchmarks/sd_bench/Kconfig
```kconfig
#
# For a description of the syntax of this configuration file,
# see the file kconfig-language.txt in the NuttX tools repository.
#

config BENCHMARK_SD_BENCH
	tristate "SD benchmark program"
	depends on ALLOW_BSD_COMPONENTS
	default n
	---help---
		SD benchmark application based on https://github.com/PX4/PX4-Autopilot/blob/main/src/systemcmds/sd_bench/sd_bench.cpp

if BENCHMARK_SD_BENCH

config BENCHMARK_SD_BENCH_PROGNAME
	string "Program name"
	default "sdbench"
	---help---
		This is the name of the program that will be used when the NSH ELF
		program is installed.

config BENCHMARK_SD_BENCH_PRIORITY
	int "SD bench task priority"
	default 100

config BENCHMARK_SD_BENCH_STACKSIZE
	int "SD bench stack size"
	default DEFAULT_TASK_STACKSIZE

config BENCHMARK_SD_BENCH_DEVICE
	string "SD / MMC mount point"
	default "/mnt"

config TESTING_SD_MEM_ALIGN_BYTES
	int "Allocated memory alignment"
	---help---
		Specifies the memory alignment (bytes) used for allocated buffers, when enabled with the -a argument.
	default 512

endif
```

## benchmarks/spinlock_bench/Kconfig
```kconfig
#
# For a description of the syntax of this configuration file,
# see the file kconfig-language.txt in the NuttX tools repository.
#

menuconfig BENCHMARK_SPINLOCK
	bool "Spinlock Benchmark"
	depends on BUILD_FLAT
	default n
	---help---
		Enable the Spinlock benchmark application.

if BENCHMARK_SPINLOCK

config SPINLOCK_PROGNAME
	string "spinlock benchmark"
	default "spinlock_bench"
	---help---
		This is the name of the program that will be used when the NSH ELF
		program is installed.

config SPINLOCK_PRIORITY
	int "Spinlock task priority"
	default 100

config SPINLOCK_STACKSIZE
	int "Spinlock task stack size"
	default 4096


config SPINLOCK_MULTITHREAD
	int "Number of threads"
	default 40
	---help---
		Override the default number of threads to be executed.
		The default value is 40.

config SPINLOCK_ITERATIONS
	int "Number of iterations"
	default 100
	---help---
		Default number of iterations for the benchmark on each thread.
		The default value is 100.

endif # BENCHMARK_SPINLOCK
```

## benchmarks/superpi/Kconfig
```kconfig
#
# For a description of the syntax of this configuration file,
# see the file kconfig-language.txt in the NuttX tools repository.
#

config BENCHMARK_SUPERPI
	tristate "SuperPI test"
	default n

if BENCHMARK_SUPERPI

config BENCHMARK_SUPERPI_PROGNAME
	string "Program Name"
	default "pi_css5"

config BENCHMARK_SUPERPI_STACKSIZE
	int "SuperPI stack size"
	default DEFAULT_TASK_STACKSIZE

config BENCHMARK_SUPERPI_PRIORITY
	int "Task PRIORITY"
	default 100
	---help---
		The higher the priority value, the lower the priority.

endif # BENCHMARK_SUPERPI
```

## benchmarks/tacle-bench/Kconfig
```kconfig
#
# For a description of the syntax of this configuration file,
# see the file kconfig-language.txt in the NuttX tools repository.
#

config BENCHMARK_TACLEBENCH
	tristate "TacleBench"
	default n
	---help---
		A real-time benchmark from WCET'16.

if BENCHMARK_TACLEBENCH

config BENCHMARK_TACLEBENCH_PRIORITY
	int "TacleBench task priority"
	default 100

config BENCHMARK_TACLEBENCH_STACKSIZE
	int "TacleBench stack size"
	default DEFAULT_TASK_STACKSIZE

endif
```
