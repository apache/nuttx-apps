## Kconfig
```kconfig
#
# For a description of the syntax of this configuration file,
# see the file kconfig-language.txt in the NuttX tools repository.
#

menu "Built-In Applications"
source "$APPSDIR/builtin/Kconfig"
endmenu

menu "Examples"
source "$APPSDIR/examples/Kconfig"
endmenu

menu "Graphics Support"
source "$APPSDIR/graphics/Kconfig"
endmenu

menu "IEEE 802.15.4"
source "$APPSDIR/ieee802154/Kconfig"
endmenu

menu "Interpreters"
source "$APPSDIR/interpreters/Kconfig"
endmenu

menu "Network Utilities"
source "$APPSDIR/netutils/Kconfig"
endmenu

menu "FreeModBus"
source "$APPSDIR/modbus/Kconfig"
endmenu

menu "NSH Library"
source "$APPSDIR/nshlib/Kconfig"
endmenu

menu "NxWidgets/NxWM"
source "$APPSDIR/NxWidgets/Kconfig"
endmenu

menu "Platform-specific Support"
source "$APPSDIR/platform/Kconfig"
endmenu

menu "System Libraries and NSH Add-Ons"
source "$APPSDIR/system/Kconfig"
endmenu
```
