## audioutils/alsa-lib/Kconfig
```kconfig
#
# For a description of the syntax of this configuration file,
# see the file kconfig-language.txt in the NuttX tools repository.
#

config AUDIOUTILS_ALSA_LIB
	bool "Enable ALSA lib"
	default n

if AUDIOUTILS_ALSA_LIB

config AUDIOUTILS_ALSA_LIB_DEV_PATH
	string "play/recored device path"
	default "/dev/audio"

config AUDIOUTILS_ALSA_LIB_DUMP_FLAG
	string "play pcm dump flag"
	default "/data/alsa_pcm_dump"

config AUDIOUTILS_ALSA_LIB_DUMP_PATH
	string "play pcm dump path"
	default "/data"

choice
	prompt "Alsa Device to be used"
	default AUDIOUTILS_ALSA_LIB_DEVICE_DMIX

config AUDIOUTILS_ALSA_LIB_DEVICE_DMIX
	bool "Use Dmix device(support mix)"

config AUDIOUTILS_ALSA_LIB_DEVICE_HW
	bool "Use hardware device(not support mix, more faster)"

endchoice # Alsa lib Device

config AUDIOUTILS_ALSA_LIB_OUTPUT_FORMAT
	int "Dmix output format 0/16/32 (16: S16, 32: S32, 0: use input format)"
	default 0

config AUDIOUTILS_ALSA_LIB_OUTPUT_CHANNELS
	int "Dmix output channels 0/1/2 (1: 1ch, 2: 2ch, 0: use input channels)"
	default 0

config AUDIOUTILS_ALSA_LIB_OUTPUT_RATE
	int "Dmix output rate 0/8000/16000/32000/44100/48000/96000 (0: use input rate)"
	default 0

choice
	prompt "Alsa LOG Output Controls"
	default AUDIOUTILS_ALSA_LIB_LOG_INFO

config AUDIOUTILS_ALSA_LIB_LOG_DEBUG
	bool "Output DEBUG+ log"

config AUDIOUTILS_ALSA_LIB_LOG_INFO
	bool "Output INFO+ log"

config AUDIOUTILS_ALSA_LIB_LOG_WARN
	bool "Output WARN+ log"

config AUDIOUTILS_ALSA_LIB_LOG_ERR
	bool "Output ERROR+ log"

endchoice # Alsa LOG Output Controls

endif # AUDIOUTILS_ALSA_LIB
```

## audioutils/fmsynth/Kconfig
```kconfig
#
# For a description of the syntax of this configuration file,
# see the file kconfig-language.txt in the NuttX tools repository.
#

config AUDIOUTILS_FMSYNTH_LIB
	bool "FM Synthesizer Library"
	default n
	---help---
		Enable support for the FM Synthesizer library.
```

## audioutils/lame/Kconfig
```kconfig
#
# For a description of the syntax of this configuration file,
# see the file kconfig-language.txt in the NuttX tools repository.
#

config AUDIOUTILS_LAME
	bool "Enable LAME MP3 Encoder"
	default n
```

## audioutils/mml_parser/Kconfig
```kconfig
#
# For a description of the syntax of this configuration file,
# see the file kconfig-language.txt in the NuttX tools repository.
#

config AUDIOUTILS_MMLPARSER_LIB
	bool "Music Macro Language(MML) Library"
	default n
	---help---
		Enable support for the Music Macro Language library.
```

## audioutils/morsey/Kconfig
```kconfig
config AUDIOUTILS_MORSEY
	bool "Morse code playing library"
	default n
	---help---
		Simple library for parsing ASCII text into playable Morse code. Not
		necessarily restricted to audio.
```

## audioutils/nxaudio/Kconfig
```kconfig
#
# For a description of the syntax of this configuration file,
# see the file kconfig-language.txt in the NuttX tools repository.
#

config AUDIOUTILS_NXAUDIO_LIB
	bool "NX Audio Library"
	default n
	---help---
		Enable support for the NX Audio library.

if AUDIOUTILS_NXAUDIO_LIB

config AUDIOUTILS_NXAUDIO_DEVPATH
	string "Audio Device file path"
	default "/dev/audio/pcm1"
	---help---
		Audio device file path of target audio device.

config AUDIOUTILS_NXAUDIO_MSGQNAME
	string "Message queue name"
	default "/tmp/fmaudio_mq"
	---help---
		Message queue name (file path) to communicate with audio message loop.

endif
```

## audioutils/rtttl-c/Kconfig
```kconfig
config AUDIOUTILS_RTTTL_C
	bool "RTTTL parsing library"
	default n
	---help---
		Simple library for parsing Ring Tone Text Transfer Language (RTTTL)

		Define how to make a sound:

			void
			play_tone(struct rtttl_tone tone)
			{
				/* TODO: Make a sound with
				 * 	tone.frequency_100hz
				 *	tone.period_us
				 *	tone.duration_us
				 */
			}

		and then play RTTTL string:

			rtttl_play("...", play_tone);
```

## audioutils/speexdsp/Kconfig
```kconfig
#
# For a description of the syntax of this configuration file,
# see the file kconfig-language.txt in the NuttX tools repository.
#

config AUDIOUTILS_SPEEXDSP
	bool "Audio libspeexdsp Library"
	depends on ALLOW_BSD_COMPONENTS
	default n
	---help---
		Enable build for various resample functions

if AUDIOUTILS_SPEEXDSP

choice
	prompt "Resample precision"
	default FIXED_POINT

config FIXED_POINT
	bool "fixed point precision"

config FLOATING_POINT
	bool "floating point precision"

endchoice # Resample precision

endif # AUDIOUTILS_SPEEXDSP
```

## benchmarks/cachespeed/Kconfig
```kconfig
#
# For a description of the syntax of this configuration file,
# see the file kconfig-language.txt in the NuttX tools repository.
#

config BENCHMARK_CACHESPEED
	tristate "CACHE Speed Test"
	depends on ARCH_ICACHE && ARCH_DCACHE
	default n
	---help---
		Enable a simple CACHE speed test.

if BENCHMARK_CACHESPEED

config BENCHMARK_CACHESPEED_PROGNAME
	string "Program name"
	default "cachespeed"
	---help---
		This is the name of the program that will be used when the NSH ELF
		program is installed.

config BENCHMARK_CACHESPEED_PRIORITY
	int "CACHE speed test task priority"
	default 100

config BENCHMARK_CACHESPEED_STACKSIZE
	int "CACHE speed test stack size"
	default DEFAULT_TASK_STACKSIZE

config CACHESPEED_MONOTONIC_TIME
	bool "Using Clock Gettime"
	default n
	---help---
		When you turn on this option, your test loop will go from 10000 -> 1000 times
		Please consider the following scenario:
		1. By default (PERFTIME) will have a relatively high precision, but this also
			tends to cause failure in getting values on some smaller bytes, so reducing
			the precision with this option can make it easier to get data values.
		2. whether to compare data with the content of other tools (using CLOCK
			GETTIME method), if so, it is recommended to turn on, so as to ensure that
			the data precision of both consistent.

endif
```

## benchmarks/coremark-pro/Kconfig
```kconfig
#
# For a description of the syntax of this configuration file,
# see the file kconfig-language.txt in the NuttX tools repository.
#

menuconfig BENCHMARK_COREMARK_PRO
	tristate "Coremark Pro Benchmark"
	default n
	depends on LIBC_FLOATINGPOINT

if BENCHMARK_COREMARK_PRO

config BENCHMARK_COREMARK_PRO_STACKSIZE
	int "Coremark Pro stack size"
	default 131072

config BENCHMARK_COREMARK_PRO_PRIORITY
	int "Coremark Pro priority"
	default 100

config BENCHMARK_COREMARK_PRO_USE_SINGLE_CONTEXT
	bool "use single context"
	default n

config BENCHMARK_COREMARK_PRO_SMP
	bool "Relevant configurations in case of SMP"
	default n
	depends on SMP && !BENCHMARK_COREMARK_PRO_USE_SINGLE_CONTEXT

config BENCHMARK_COREMARK_PRO_64BIT
	bool "Running on 64-bit operating systems"
	default n

config BENCHMARK_COREMARK_PRO_USE_FP64
	bool "USE FP64 Data for Test"
	default n

config BENCHMARK_COREMARK_PRO_CORE_TEST
	bool "Core Test"
	default n

config BENCHMARK_COREMARK_PRO_CJPEG_TEST
	bool "cjpeg-rose7-preset"
	default n
	---help---
		Before using this case, place the files in coremark-pro/benchmarks/libbmp
		and coremark-pro/benchmarks/libjpeg in /data/libbmp and /data/libjpeg
		respectively

config BENCHMARK_COREMARK_PRO_LINEAR_ALG_MID_TEST
	bool "Linear_alg_mid TEST"
	default n

config BENCHMARK_COREMARK_PRO_SHA_TEST
	bool "SHA Test"
	default n

config BENCHMARK_COREMARK_PRO_ZIP_TEST
	bool "Zip Test"
	depends on LIB_ZLIB
	default n

choice
	prompt "Coremark Pro FP Test Case configuration"
	default BENCHMARK_COREMARK_PRO_RADIX_TEST

config BENCHMARK_COREMARK_PRO_RADIX_TEST
	bool "Radix Test"

config BENCHMARK_COREMARK_PRO_LOOPS_ALL_MID_TEST
	bool "Loops-all-mid test"

config BENCHMARK_COREMARK_PRO_NNET_TEST
	bool "Nnet Test"

config BENCHMARK_COREMARK_PRO_PARSER_125K
	bool "Parser 125K Test"

endchoice

endif
```

## benchmarks/coremark/Kconfig
```kconfig
#
# For a description of the syntax of this configuration file,
# see the file kconfig-language.txt in the NuttX tools repository.
#

menuconfig BENCHMARK_COREMARK
	tristate "CoreMark Benchmark"
	select LIBC_FLOATINGPOINT
	default n
	---help---
		Enable support for the EEMBC's CoreMark benchmark application.

if BENCHMARK_COREMARK

config COREMARK_PROGNAME
	string "CoreMark program name"
	default "coremark"
	---help---
		This is the name of the program that will be used when the NSH ELF
		program is installed.

config COREMARK_PRIORITY
	int "CoreMark task priority"
	default 100

config COREMARK_STACKSIZE
	int "CoreMark task stack size"
	default 4096

config COREMARK_SEED_METHOD
	int "Coremark Seed Method"
	default 2
	---help---
		Set Coremark Seed Method:
		0: SEED_ARG
		1: SEED_FUNC
		2: SEED_VOLATILE

config COREMARK_MEM_METHOD
	int "Coremark Memory Method"
	default 1
	---help---
		Set Coremark Memory Method:
		0: MEM_STATIC
		1: MEM_MALLOC
		2: MEM_STACK

config COREMARK_DEBUG
	int "Coremark Core Debug"
	default 0
	---help---
		Enable the Core Debug:
		0: Disable
		1: Enable

config COREMARK_PRINT_ARGS
	bool "Print CoreMark arguments when executing"
	default n
	---help---
		Print the command line arguments passed on to coremark.

config COREMARK_MULTITHREAD_OVERRIDE
	bool "Override number of threads"
	default n
	---help---
		Override the default number of threads to be executed.
		The default value is the same as the number of CPU cores.

config COREMARK_MULTITHREAD_COUNT
	depends on COREMARK_MULTITHREAD_OVERRIDE
	int "Number of threads to be executed"
	default 1

config COREMARK_ITERATIONS_OVERRIDE
	bool "Override number of iterations"
	default n
	---help---
		Override the default number of iterations for the benchmark.
		The default value is defined by the application based on the system.

config COREMARK_ITERATIONS_COUNT
	depends on COREMARK_ITERATIONS_OVERRIDE
	int "Number of iterations"
	default 100

endif # BENCHMARK_COREMARK
```

## benchmarks/cyclictest/Kconfig
```kconfig
#
# For a description of the syntax of this configuration file,
# see the file kconfig-language.txt in the NuttX tools repository.
#

menuconfig BENCHMARK_CYCLICTEST
	bool "Cyclictest"
	default n
	---help---
		Enable the cyclictest application.

if BENCHMARK_CYCLICTEST

config BENCHMARK_CYCLICTEST_PROGNAME
	string "Cyclictest App Name"
	default "cyclictest"
	---help---
		This is the name of the program that will be used when the NSH ELF
		program is installed.

config BENCHMARK_CYCLICTEST_PRIORITY
	int "Cyclictest task priority"
	default 100

config BENCHMARK_CYCLICTEST_STACKSIZE
	int "Cyclictest task stack size"
	default 4096

endif # BENCHMARK_CYCLICTEST
```

## benchmarks/dhrystone/Kconfig
```kconfig
#
# For a description of the syntax of this configuration file,
# see the file kconfig-language.txt in the NuttX tools repository.
#

config BENCHMARK_DHRYSTONE
	tristate "dhrystone benchmark"
	default n
	---help---
		Dhrystone is one of the most common benchmark programs
		for measuring the computing power of processors and is commonly
		used to measure the performance of integer computing on processors.

if BENCHMARK_DHRYSTONE

config BENCHMARK_DHRYSTONE_PROGNAME
	string "Program Name"
	default "dhrystone"

config BENCHMARK_DHRYSTONE_STACKSIZE
	int "utils dhrystone stack size"
	default DEFAULT_TASK_STACKSIZE

config BENCHMARK_DHRYSTONE_PRIORITY
	int "Task PRIORITY"
	default 100

endif
```

## benchmarks/fio/Kconfig
```kconfig
#
# For a description of the syntax of this configuration file,
# see the file kconfig-language.txt in the NuttX tools repository.
#

config BENCHMARK_FIO
	tristate "Flexible I/O Tester"
	default n
	depends on LIBC_ELF && LIBC_DLFCN
	---help---
		https://github.com/axboe/fio Fio spawns a number of threads or processes
		doing a particular type of I/O action as specified by the user.

if BENCHMARK_FIO

config BENCHMARK_FIO_PRIORITY
	int "fio task priority"
	default 100

config BENCHMARK_FIO_STACKSIZE
	int "fio stack size"
	default 65536

endif
```

## benchmarks/iozone/Kconfig
```kconfig
#
# For a description of the syntax of this configuration file,
# see the file kconfig-language.txt in the NuttX tools repository.
#

config BENCHMARK_IOZONE
	tristate "IOzone, filesystem benchmark tool"
	default n
	---help---
		https://www.iozone.org/

if BENCHMARK_IOZONE

config BENCHMARK_IOZONE_PROGNAME
	string "Program name"
	default "iozone"

config BENCHMARK_IOZONE_PRIORITY
	int "IOzone task priority"
	default 100

config BENCHMARK_IOZONE_STACKSIZE
	int "IOzone stack size"
	default 8192

config BENCHMARK_IOZONE_VERSION
	string "iozone version"
	default "3_493"

endif
```

## benchmarks/mtd/Kconfig
```kconfig
#
# For a description of the syntax of this configuration file,
# see the file kconfig-language.txt in the NuttX tools repository.
#

config BENCHMARK_MTD
	tristate "MTD test and transfer rate benchmark"
	default n
	depends on BUILD_FLAT && MTD && LIBC_FLOATINGPOINT
	---help---
		This testing/benchmark application performs an erase/write
		operation to evaluate write transfer rate and then reads the
		written content back to evaluate the read transfer rate. Finally,
		it compares the read data with the previously written data to
		ensure the MTD device is working as expected.

		NOTE:  This application uses internal OS interfaces and so it is not
		available in the NuttX kernel build.
```

## benchmarks/osperf/Kconfig
```kconfig
#
# For a description of the syntax of this configuration file,
# see the file kconfig-language.txt in the NuttX tools repository.
#

config BENCHMARK_OSPERF
	tristate "System performance profiling"
	default n
	depends on PIPES
	depends on SCHED_HPWORK
	---help---
		Measure the performance of core system functions, such as thread
		switching and the time required for semaphore execution

if BENCHMARK_OSPERF

config BENCHMARK_OSPERF_PRIORITY
	int "OS profiling task priority"
	default 100

config BENCHMARK_OSPERF_STACKSIZE
	int "OS profiling stack size"
	default DEFAULT_TASK_STACKSIZE

endif
```

## benchmarks/ramspeed/Kconfig
```kconfig
#
# For a description of the syntax of this configuration file,
# see the file kconfig-language.txt in the NuttX tools repository.
#

config BENCHMARK_RAMSPEED
	tristate "RAM Speed Test"
	default n
	depends on LIBC_FLOATINGPOINT
	---help---
		Enable a simple RAM speed test.

if BENCHMARK_RAMSPEED

config BENCHMARK_RAMSPEED_PROGNAME
	string "Program name"
	default "ramspeed"
	---help---
		This is the name of the program that will be used when the NSH ELF
		program is installed.

config BENCHMARK_RAMSPEED_PRIORITY
	int "RAM speed test task priority"
	default 100

config BENCHMARK_RAMSPEED_STACKSIZE
	int "RAM speed test stack size"
	default DEFAULT_TASK_STACKSIZE

endif
```

## benchmarks/rt-tests/Kconfig
```kconfig
#
# For a description of the syntax of this configuration file,
# see the file kconfig-language.txt in the NuttX tools repository.
#

config BENCHMARK_RTTESTS
	tristate "RT-Tests"
	default n
	depends on PIPES && ALLOW_GPL_COMPONENTS
	---help---
		Measure the timer jitter

if BENCHMARK_RTTESTS

config BENCHMARK_RTTESTS_PRIORITY
	int "RT-Tests task priority"
	default 200

config BENCHMARK_RTTESTS_STACKSIZE
	int "RT-Tests stack size"
	default DEFAULT_TASK_STACKSIZE

endif
```
