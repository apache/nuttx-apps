## canutils/lely-canopen/Kconfig
```kconfig
menuconfig CANUTILS_LELYCANOPEN
	bool "Lely CANopen support"
	default n
	---help---
		Enable the Lely CANopen build

if CANUTILS_LELYCANOPEN

config CANUTILS_LELYCANOPEN_URL
	string "URL where Lely CANopen can be downloaded"
	default "https://gitlab.com/lely_industries/lely-core/-/archive/master/"

config CANUTILS_LELYCANOPEN_VERSION
	string "Version number"
	default "637de61625c9e8af2b9598109d6fb0e3a2829ce6"

menu "Lely CANopen configuration"

config CANUTILS_LELYCANOPEN_CANFD
	bool "Lely CANopen enable CAN FD support"
	default n

config CANUTILS_LELYCANOPEN_DIAG
	bool "Lely CANopen enable diagnostic functions"
	default n

config CANUTILS_LELYCANOPEN_DCF
	bool "Lely CANopen enable EDS/DCF support"
	default n

config CANUTILS_LELYCANOPEN_OBJDEFAULT
	bool "Lely CANopen enable default values in the object dictionary"
	default n

config CANUTILS_LELYCANOPEN_OBJFILE
	bool "Lely CANopen enable file support in the object dictionary"
	default n

config CANUTILS_LELYCANOPEN_OBJLIMITS
	bool "Lely CANopen enable limit values in the object dictionary"
	default n

config CANUTILS_LELYCANOPEN_OBJNAME
	bool "Lely CANopen enable names in the object dictionary"
	default n

config CANUTILS_LELYCANOPEN_OBJUPLOAD
	bool "Lely CANopen enable upload indication functions in the object dictionary"
	default n

config CANUTILS_LELYCANOPEN_SDEV
	bool "Lely CANopen enable static device description support"
	default n

config CANUTILS_LELYCANOPEN_CSDO
	bool "Lely CANopen enable Client-SDO support"
	default n

config CANUTILS_LELYCANOPEN_RPDO
	bool "Lely CANopen enable Receive-PDO support"
	default n

config CANUTILS_LELYCANOPEN_TPDO
	bool "Lely CANopen enable Transmit-PDO support"
	default n

config CANUTILS_LELYCANOPEN_MPDO
	bool "Lely CANopen enable Multiplex PDO support"
	default n

config CANUTILS_LELYCANOPEN_SYNC
	bool "Lely CANopen enable SYNC support"
	default n

config CANUTILS_LELYCANOPEN_TIME
	bool "Lely CANopen enable TIME support"
	default n

config CANUTILS_LELYCANOPEN_EMCY
	bool "Lely CANopen enable EMCY support"
	default n

config CANUTILS_LELYCANOPEN_LSS
	bool "Lely CANopen enable LSS support"
	default n

config CANUTILS_LELYCANOPEN_WTM
	bool "Lely CANopen enable WTM support"
	default n

config CANUTILS_LELYCANOPEN_MASTER
	bool "Lely CANopen enable MASTER support"
	default n

config CANUTILS_LELYCANOPEN_NG
	bool "Lely CANopen enable node guardian support"
	default n

config CANUTILS_LELYCANOPEN_NMTBOOT
	bool "Lely CANopen enable NMT boot slave support"
	default n

config CANUTILS_LELYCANOPEN_NMTCFG
	bool "Lely CANopen enable NMT configuration request support"
	default n

config CANUTILS_LELYCANOPEN_GW
	bool "Lely CANopen enable gateway support"
	default n

config CANUTILS_LELYCANOPEN_GW_TXT
	bool "Lely CANopen enable ASCII gateway support"
	default n

if HAVE_CXX

config CANUTILS_LELYCANOPEN_COAPP_MASTER
	bool "Lely CANopen C++ CANopen application master support"
	default n

config CANUTILS_LELYCANOPEN_COAPP_SLAVE
	bool "Lely CANopen C++ CANopen application slave support"
	default n

endif # HAVE_CXX

config CANUTILS_LELYCANOPEN_IOLIB
	bool "Lely CANopen IO lib"
	default n
	depends on NET_CAN
	select NETDEV_IFINDEX
	select NET_CAN_SOCK_OPTS
	select PIPES

endmenu # "Lely CANopen configuration"

menu "Lely CANopen tools"

config CANUTILS_LELYCANOPEN_TOOLS_COCTL
	bool "coctl"
	depends on SERIAL_TERMIOS
	depends on SYSTEM_READLINE
	default n
	select CANUTILS_LELYCANOPEN_IOLIB
	select CANUTILS_LELYCANOPEN_DIAG
	select CANUTILS_LELYCANOPEN_GW
	select CANUTILS_LELYCANOPEN_DCF
	select CANUTILS_LELYCANOPEN_OBJNAME
	select CANUTILS_LELYCANOPEN_GW_TXT
	select CANUTILS_LELYCANOPEN_EMCY
	select CANUTILS_LELYCANOPEN_RPDO
	select CANUTILS_LELYCANOPEN_TPDO
	select CANUTILS_LELYCANOPEN_SYNC
	select CANUTILS_LELYCANOPEN_CSDO

if CANUTILS_LELYCANOPEN_TOOLS_COCTL

config CANUTILS_LELYCANOPEN_TOOLS_COCTL_PRIORITY
	int "coctl task priority"
	default 100

config CANUTILS_LELYCANOPEN_TOOLS_COCTL_STACKSIZE
	int "coctl stack size"
	default DEFAULT_TASK_STACKSIZE

endif #CANUTILS_LELYCANOPEN_TOOLS_COCTL

endmenu # "Lely CANopen tools"

endif # CANUTILS_LELYCANOPEN
```

## canutils/libcanard/Kconfig
```kconfig
#
# For a description of the syntax of this configuration file,
# see the file kconfig-language.txt in the NuttX tools repository.
#

config CANUTILS_LIBCANARD
	bool "libcanard UAVCAN Library"
	default n
	depends on CAN && CAN_EXTID
	---help---
		Enable the libcanard UAVCAN library.

if CANUTILS_LIBCANARD

config LIBCANARD_URL
	string "libcanard URL"
	default "https://github.com/UAVCAN/libcanard/archive"
	---help---
		libcanard URL.

config LIBCANARD_VERSION
	string "libcanard Version"
	default "5ad65c6a4efda60cda7a8f0512da0f465822bbb8"
	---help---
		libcanard version.

endif
```

## canutils/libcanardv0/Kconfig
```kconfig
#
# For a description of the syntax of this configuration file,
# see the file kconfig-language.txt in the NuttX tools repository.
#

config CANUTILS_LIBCANARDV0
	bool "libcanard UAVCAN v0 Library"
	default n
	depends on CAN && CAN_EXTID
	---help---
		Enable the libcanard UAVCAN v0 library.

if CANUTILS_LIBCANARDV0

config LIBCANARDV0_URL
	string "libcanard URL"
	default "https://github.com/UAVCAN/libcanard/archive"
	---help---
		libcanard URL.

config LIBCANARDV0_VERSION
	string "libcanard Version"
	default "5ad65c6a4efda60cda7a8f0512da0f465822bbb8"
	---help---
		libcanard version.

endif
```

## canutils/libcanardv1/Kconfig
```kconfig
#
# For a description of the syntax of this configuration file,
# see the file kconfig-language.txt in the NuttX tools repository.
#

config CANUTILS_LIBCANARDV1
	bool "libcanard UAVCAN v1 Library"
	default n
	depends on NET_CAN && ALLOW_MIT_COMPONENTS
	---help---
		Enable the libcanard UAVCAN v1 library.

if CANUTILS_LIBCANARDV1

config LIBCANARDV1_URL
	string "libcanard URL"
	default "https://github.com/UAVCAN/libcanard/archive"
	---help---
		libcanard URL.

config LIBCANARDV1_VERSION
	string "libcanard Version"
	default "cde670347425023480a1417fcd603b27c8eb06c1"
	---help---
		libcanard version.

config O1HEAP_URL
	string "O(1) heap URL"
	default "https://github.com/pavel-kirienko/o1heap/archive"
	---help---
		libcanard URL.

config O1HEAP_VERSION
	string "O(1) heap Version"
	default "b21b069e4b971d3016dd232784faca6f7d9fd724"
	---help---
		libcanard version.

endif
```

## canutils/libcanutils/Kconfig
```kconfig
#
# For a description of the syntax of this configuration file,
# see the file kconfig-language.txt in the NuttX tools repository.
#

config CANUTILS_LIBCANUTILS
	bool "CAN-utils support library"
	default n
	depends on NET_CAN
	---help---
		Enable the CAN-utils support library ported from
		https://github.com/linux-can/can-utils

if CANUTILS_LIBCANUTILS

endif
```

## canutils/libdronecan/Kconfig
```kconfig
#
# For a description of the syntax of this configuration file,
# see the file kconfig-language.txt in the NuttX tools repository.
#

config CANUTILS_LIBDRONECAN
	bool "libcanard DroneCAN Library"
	default n
	depends on (CAN && CAN_EXTID) || NET_CAN
	---help---
		Enable the libcanard DroneCAN library.

if CANUTILS_LIBDRONECAN

config LIBDRONECAN_URL
	string "libcanard URL"
	default "https://github.com/dronecan/libcanard/archive"
	---help---
		libcanard URL.

config LIBDRONECAN_VERSION
	string "libcanard Version"
	default "21f2a73df86886101e254d02cfc2277cd2a15717"
	---help---
		libcanard version.

config LIBDRONECAN_CANFD
	bool "(Experimental) libcanard CAN FD Support"
	default n
	depends on NET_CAN_CANFD && EXPERIMENTAL
	---help---
		libcanard CAN FD support.
		Adds support for CAN FD, this is still experimental
		since libcanard doesn't support runtime switching
		between CAN2.0B and CAN FD that well

endif # CANUTILS_LIBDRONECAN
```

## canutils/libobd2/Kconfig
```kconfig
#
# For a description of the syntax of this configuration file,
# see the file kconfig-language.txt in the NuttX tools repository.
#

config CANUTILS_LIBOBD2
	bool "OBD-II Library"
	default n
	depends on CAN
	---help---
		Enable the OBD-II Library

if CANUTILS_LIBOBD2

config LIBOBD2_MULTIFRAME
	bool "Enable to Multi-Frame support (increases 4KB RAM)"
	default n
	---help---
		Enable the support for multi-frames of the OBD-II protocol.
		In the multi-frame mode the ECU can send frame up to 4096 bytes.

endif
```

## canutils/libopencyphal/Kconfig
```kconfig
#
# For a description of the syntax of this configuration file,
# see the file kconfig-language.txt in the NuttX tools repository.
#

config CANUTILS_LIBOPENCYPHAL
	bool "libcanard OpenCyphal Cyphal/CAN Library"
	default n
	depends on NET_CAN && ALLOW_MIT_COMPONENTS
	---help---
		Enable the OpenCyphal Cyphal/CAN library.

if CANUTILS_LIBOPENCYPHAL

config LIBOPENCYPHAL_URL
	string "libcanard URL"
	default "https://github.com/OpenCyphal/libcanard/archive"
	---help---
		libcanard URL.

config LIBOPENCYPHAL_VERSION
	string "libcanard Version"
	default "cde670347425023480a1417fcd603b27c8eb06c1"
	---help---
		libcanard version.

config O1HEAP_URL
	string "O(1) heap URL"
	default "https://github.com/pavel-kirienko/o1heap/archive"
	---help---
		O(1) heap allocator URL.

config O1HEAP_VERSION
	string "O(1) heap Version"
	default "b21b069e4b971d3016dd232784faca6f7d9fd724"
	---help---
		O(1) heap allocator version.

endif
```

## canutils/libuavcan/Kconfig
```kconfig
#
# For a description of the syntax of this configuration file,
# see the file kconfig-language.txt in the NuttX tools repository.
#

config CANUTILS_LIBUAVCAN
	bool "libuavcan Library"
	default n
	depends on STM32_HAVE_CAN1
	depends on !STM32_CAN1
	depends on !STM32_CAN2
	depends on !STM32_TIM2 || (STM32_HAVE_TIM3 && !STM32_TIM3) || (STM32_HAVE_TIM4 && !STM32_TIM4) || (STM32_HAVE_TIM5 && !STM32_TIM5) || (STM32_HAVE_TIM6 && !STM32_TIM6) || (STM32_HAVE_TIM7 && !STM32_TIM7)
	depends on C99_BOOL8
	depends on HAVE_CXX
	depends on !DISABLE_POLL
	---help---
		Enables support for the libuavcan library.

if CANUTILS_LIBUAVCAN

config LIBUAVCAN_URL
	string "libuavcan URL"
	default "https://github.com/UAVCAN/libuavcan/archive"
	---help---
		libuavcan URL.

config LIBUAVCAN_VERSION
	string "libuavcan Version"
	default "b04396ace50155573e545ed9bf2fb09964ee2367"
	---help---
		libuavcan version.

config LIBUAVCAN_DSDL_URL
	string "DSDL URL"
	default "https://github.com/UAVCAN/dsdl/archive"
	---help---
		DSDL URL.

config LIBUAVCAN_DSDL_VERSION
	string "DSDL Version"
	default "9804a3e6972825586be252ce08dd899f44994b14"
	---help---
		DSDL version.

config LIBUAVCAN_PYUAVCAN_URL
	string "pyuavcan URL"
	default "https://github.com/UAVCAN/pyuavcan/archive"
	---help---
		pyuavcan URL.

config LIBUAVCAN_PYUAVCAN_VERSION
	string "pyuavcan Version"
	default "c58477a644d20ccf95a20c151f3a0402f271c3b8"
	---help---
		pyuavcan version.

config LIBUAVCAN_STM32_NUM_IFACES
	int "Number of CAN Interfaces"
	default 1
	range 1 1 if !STM32_HAVE_CAN2
	range 1 2 if STM32_HAVE_CAN2

choice
	prompt "Timer"
	default LIBUAVCAN_STM32_TIM2 if !STM32_TIM2
	default LIBUAVCAN_STM32_TIM3 if STM32_HAVE_TIM3 && !STM32_TIM3
	default LIBUAVCAN_STM32_TIM4 if STM32_HAVE_TIM4 && !STM32_TIM4
	default LIBUAVCAN_STM32_TIM5 if STM32_HAVE_TIM5 && !STM32_TIM5
	default LIBUAVCAN_STM32_TIM6 if STM32_HAVE_TIM6 && !STM32_TIM6
	default LIBUAVCAN_STM32_TIM7 if STM32_HAVE_TIM7 && !STM32_TIM7

config LIBUAVCAN_STM32_TIM2
	bool "TIM2"
	depends on !STM32_TIM2
	---help---
		The library will use TIM2.

config LIBUAVCAN_STM32_TIM3
	bool "TIM3"
	depends on STM32_HAVE_TIM3 && !STM32_TIM3
	---help---
		The library will use TIM3.

config LIBUAVCAN_STM32_TIM4
	bool "TIM4"
	depends on STM32_HAVE_TIM4 && !STM32_TIM4
	---help---
		The library will use TIM4.

config LIBUAVCAN_STM32_TIM5
	bool "TIM5"
	depends on STM32_HAVE_TIM5 && !STM32_TIM5
	---help---
		The library will use TIM5.

config LIBUAVCAN_STM32_TIM6
	bool "TIM6"
	depends on STM32_HAVE_TIM6 && !STM32_TIM6
	---help---
		The library will use TIM6.

config LIBUAVCAN_STM32_TIM7
	bool "TIM7"
	depends on STM32_HAVE_TIM7 && !STM32_TIM7
	---help---
		The library will use TIM7.

endchoice

choice
	prompt "C++ Version"
	default LIBUAVCAN_CPP03

config LIBUAVCAN_CPP03
	bool "C++03"
	---help---
		The library will use C++03.

config LIBUAVCAN_CPP11
	bool "C++11"
	---help---
		The library will use C++11.

endchoice

config LIBUAVCAN_DEBUG
	bool "Debug"
	default n
	---help---
		Enables debug.

config LIBUAVCAN_EXCEPTIONS
	bool "Exceptions"
	default n
	---help---
		Enables exceptions.

config LIBUAVCAN_TINY
	bool "Tiny"
	default n
	---help---
		Removes some features to save memory.

config LIBUAVCAN_NO_GLOBAL_DATA_TYPE_REGISTRY
	bool "No Global Data Type Registry"
	default n
	---help---
		Removes the global data type registry.

config LIBUAVCAN_TOSTRING
	bool "Implement toString"
	default n
	depends on LIBUAVCAN_EXCEPTIONS
	---help---
		The library will add a toString method to most of its classes.

config LIBUAVCAN_IMPLEMENT_PLACEMENT_NEW
	bool "Implement Placement new"
	default n
	---help---
		The library will implement placement new.

config LIBUAVCAN_USE_EXTERNAL_SNPRINTF
	bool "Use External snprintf"
	default n
	---help---
		The library will use an external snprintf.

config LIBUAVCAN_USE_EXTERNAL_FLOAT16_CONVERSION
	bool "Use External float16 Conversion"
	default n
	---help---
		The library will use an external float16 conversion.

config LIBUAVCAN_NO_ASSERTIONS
	bool "No Assertions"
	default n
	---help---
		Disables assertions.

config LIBUAVCAN_MEM_POOL_BLOCK_SIZE
	int "Memory Pool Block Size"
	default 0
	---help---
		Specifies the memory pool block size.  If the value is 0, the
		library will use a default value.

config LIBUAVCAN_FLOAT_COMPARISON_EPSILON_MULT
	int "Float Comparion Epsilon Mult"
	default 0
	---help---
		Specifies the float comparison epsilon mult.  If the value is
		0, the library will use a default value.

config LIBUAVCAN_MAX_CAN_ACCEPTANCE_FILTERS
	int "Max CAN Acceptance Filters"
	default 0
	---help---
		Specifies the maximum number of CAN acceptance filters.  If
		the value is 0, the library will use a default value.

config LIBUAVCAN_MAX_NETWORK_SIZE_HINT
	int "Max Network Size Hint"
	default 0
	---help---
		Specifies the maximum network size.  If the value is 0, the
		library will use a default value.

config LIBUAVCAN_RX_QUEUE_CAPACITY
	int "Rx Queue Capacity"
	default 0
	---help---
		Specifies the rx queue capacity.  If the value is 0, the
		library will use a default value.

config LIBUAVCAN_BIT_RATE
	int "Bit Rate"
	default 0
	range 0 1000000
	---help---
		Specifies the CAN bit rate.  If the value is 0, the library
		will automatically detect the bit rate.

config LIBUAVCAN_INIT_RETRIES
	int "Initialization Retries"
	default 0
	---help---
		Specifies the number of times to try initializing the CAN
		peripherals before panicking.  A value of 0 means to try
		forever.

endif
```

## canutils/slcan/Kconfig
```kconfig
#
# For a description of the syntax of this configuration file,
# see the file kconfig-language.txt in the NuttX tools repository.
#

config CANUTILS_SLCAN
	tristate "SocketCAN slcan tool"
	default n
	depends on NET_CAN
	---help---
		Enable the SocketCAN slcan tool

if CANUTILS_SLCAN

config CANUTILS_SLCAN_STACKSIZE
	int "SocketCAN slcan stack size"
	default DEFAULT_TASK_STACKSIZE

config SLCAN_TRACE
	bool "Print trace output"
	default y
	---help---
		Debug trace output

endif
```
