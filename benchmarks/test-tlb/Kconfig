## benchmarks/test-tlb/Kconfig
```kconfig
#
# For a description of the syntax of this configuration file,
# see the file kconfig-language.txt in the NuttX tools repository.
#

config BENCHMARK_TESTTLB
	tristate "Memory Latency profiling"
	depends on ALLOW_GPL_COMPONENTS
	default n
	---help---
		Measure the memory latency

if BENCHMARK_TESTTLB

config BENCHMARK_TESTTLB_PRIORITY
	int "TestTLB task priority"
	default 100

config BENCHMARK_TESTTLB_STACKSIZE
	int "TestTLB stack size"
	default DEFAULT_TASK_STACKSIZE

endif
```

## benchmarks/tinymembench/Kconfig
```kconfig
#
# For a description of the syntax of this configuration file,
# see the file kconfig-language.txt in the NuttX tools repository.
#

config BENCHMARK_TINY_MEMBENCH
	tristate "TinyMemBench"
	default n
	---help---
		Measure the memory bandwidth and latency

if BENCHMARK_TINY_MEMBENCH

config BENCHMARK_TINY_MEMBENCH_PRIORITY
	int "TinyMemBench task priority"
	default 100

config BENCHMARK_TINY_MEMBENCH_STACKSIZE
	int "TinyMemBench stack size"
	default DEFAULT_TASK_STACKSIZE

endif
```

## benchmarks/whetstone/Kconfig
```kconfig
#
# For a description of the syntax of this configuration file,
# see the file kconfig-language.txt in the NuttX tools repository.
#

config BENCHMARK_WHETSTONE
	tristate "Double Precision Benchmark"
	default n
	depends on ALLOW_CUSTOM_PERMISSIVE_COMPONENTS
	---help---
		Enable a Whetstone test.

		This benchmark is based on the C converted version from
		https://www.netlib.org/benchmark/whetstone.c which has a
		custom permissive license requiring attribution.

if BENCHMARK_WHETSTONE

config BENCHMARK_WHETSTONE_PROGNAME
	string "Program name"
	default "whetstone"
	---help---
		This is the name of the program that will be used when the NSH ELF
		program is installed.

config BENCHMARK_WHETSTONE_PRIORITY
	int "Whetstone test task priority"
	default 100

config BENCHMARK_WHETSTONE_STACKSIZE
	int "Whetstone test stack size"
	default DEFAULT_TASK_STACKSIZE

endif
```

## boot/mcuboot/Kconfig
```kconfig
#
# For a description of the syntax of this configuration file,
# see the file kconfig-language.txt in the NuttX tools repository.
#

menuconfig BOOT_MCUBOOT
	bool "MCUboot"
	default n
	select BCH
	---help---
		Enable support for the MCUboot bootloader.

if BOOT_MCUBOOT

config MCUBOOT_VERSION
	string "MCUboot version"
	default "bb927ac014787992f2d8b42c7bd5d05eb4c17e05"

config MCUBOOT_ENABLE_LOGGING
	bool "Enable MCUboot logging"
	default n
	---help---
		Enable MCUboot's logging infrastructure.

choice
	prompt "Cryptographic backend"
	default MCUBOOT_USE_TINYCRYPT

config MCUBOOT_USE_MBED_TLS
	bool "Mbed TLS"
	depends on CRYPTO_MBEDTLS

config MCUBOOT_USE_TINYCRYPT
	bool "TinyCrypt"

endchoice # Cryptographic backend

config MCUBOOT_BOOTLOADER
	bool "MCUboot bootloader application"
	default n
	select BOARDCTL
	select BOARDCTL_BOOT_IMAGE
	---help---
		MCUboot bootloader application.

config MCUBOOT_BOOTSTRAP
	bool "Bootstrap erased the primary slot from the secondary slot"
	depends on MCUBOOT_BOOTLOADER
	default n
	---help---
		Enable bootstrapping support. Bootstrapping allows an erased primary slot
		to be initialized from a valid image in the secondary slot.

choice
	prompt "Upgrade mode"
	default MCUBOOT_SWAP
	---help---
		The default is to support A/B image swapping with rollback.  Other
		modes with simpler code path, which only supports overwriting the
		existing image with the update image or running the newest image
		directly from its flash partition, are also available.

config MCUBOOT_SWAP
	bool "A/B image swapping with rollback"

config MCUBOOT_OVERWRITE_ONLY
	bool "Overwrite the existing image with the update image"

config MCUBOOT_DIRECT_XIP
	bool "Run the newest image directly from its flash partition"

config MCUBOOT_RAM_LOAD
	bool "Loaded the image into RAM instead of run directly from flash"

endchoice # Upgrade mode

choice
	prompt "Swap upgrade policy"
	depends on MCUBOOT_SWAP
	default MCUBOOT_SWAP_USING_SCRATCH

config MCUBOOT_SWAP_USING_SCRATCH
	bool "Image swap using scratch area"

config MCUBOOT_SWAP_USING_MOVE
	bool "Image swap without using scratch area"

endchoice # Swap upgrade policy

config MCUBOOT_OVERWRITE_ONLY_FAST
	bool "Enable faster copy for overwrite only upgrade"
	depends on MCUBOOT_OVERWRITE_ONLY
	default n
	---help---
		Only erase and overwrite those primary slot sectors needed
		to install the new image, rather than the entire image slot.

config MCUBOOT_DIRECT_XIP_REVERT
	bool "Enable the revert mechanism in direct-xip mode"
	depends on MCUBOOT_DIRECT_XIP
	default n

config MCUBOOT_WATCHDOG
	bool "Watchdog feeding support"
	default n
	depends on WATCHDOG
	---help---
		This config must be selected in case the Watchdog is enabled while
		performing a swap upgrade and the time it takes for a swapping is long
		enough to cause an unwanted reset.

config MCUBOOT_WATCHDOG_DEVPATH
	string "Watchdog device path"
	default "/dev/watchdog0"
	depends on MCUBOOT_WATCHDOG
	---help---
		The path to the watchdog device.
		Default: /dev/watchdog0

config MCUBOOT_PRIMARY_SLOT_PATH
	string "Application firmware image primary slot path"
	default "/dev/ota0"
	---help---
		The path to the application firmware image primary slot character
		device driver.
		Default: /dev/ota0

config MCUBOOT_SECONDARY_SLOT_PATH
	string "Application firmware image secondary slot path"
	default "/dev/ota1"
	---help---
		The path to the application firmware image secondary slot character
		device driver.
		Default: /dev/ota1

config MCUBOOT_SCRATCH_PATH
	string "Scratch partition path"
	default "/dev/otascratch"
	---help---
		The path to the scratch partition character device driver.
		Default: /dev/otascratch

config MCUBOOT_DEFAULT_FLASH_ERASE_STATE
	hex "Default flash erase state"
	default 0xff
	---help---
		MCUboot will attempt to retrieve this value from the underlying MTD
		driver.
		In case of failure, the value from this config will be used as a
		fallback.

endif # BOOT_MCUBOOT
```

## boot/miniboot/Kconfig
```kconfig
#
# For a description of the syntax of this configuration file,
# see the file kconfig-language.txt in the NuttX tools repository.
#

menuconfig BOOT_MINIBOOT
	bool "Minimal bootloader"
	default n
	select BOARDCTL_BOOT_IMAGE
	---help---
		Enable support for the minimal NuttX based bootloader.

if BOOT_MINIBOOT

config MINIBOOT_SLOT_PATH
	string "Application firmware image slot path"
	default "/dev/ota0"
	---help---
		The path to the application firmware image slot character
		device driver.
		Default: /dev/ota0

config MINIBOOT_HEADER_SIZE
	hex "Application firmware image header size"
	default 0x200

endif # BOOT_MINIBOOT
```

## boot/nxboot/Kconfig
```kconfig
#
# For a description of the syntax of this configuration file,
# see the file kconfig-language.txt in the NuttX tools repository.
#

menuconfig BOOT_NXBOOT
	bool "NuttX bootloader"
	default n
	select BCH
	---help---
		Enable support for the minimal NuttX based bootloader.

if BOOT_NXBOOT

config NXBOOT_PRIMARY_SLOT_PATH
	string "Application firmware primary image slot path"
	default "/dev/ota0"
	---help---
		The path to the application firmware image primary slot character
		device driver. The image runs from this location.
		Default: /dev/ota0

config NXBOOT_SECONDARY_SLOT_PATH
	string "Application firmware secondary image slot path"
	default "/dev/ota1"
	---help---
		The path to the application firmware image primary slot character
		device driver. This is either update or recovery slot.
		Default: /dev/ota1

config NXBOOT_TERTIARY_SLOT_PATH
	string "Application firmware tertiary image slot path"
	default "/dev/ota2"
	---help---
		The path to the application firmware image primary slot character
		device driver. This is either update or recovery slot.
		Default: /dev/ota2

config NXBOOT_HEADER_SIZE
	hex "Application firmware image header size"
	default 0x200
	---help---
		Note that this size should be aligned with the program memory write
		page size!

config NXBOOT_PLATFORM_IDENTIFIER
	hex "A unique platform identifier"
	default 0x0
	---help---
		This is a unique platform identifier used by the bootloader to
		verify whether the image should be run on a given platform. An update
		(or even a firmware uploaded via a programmer) is rejected if the
		value in image's header doesn't match this option.

config NXBOOT_BOOTLOADER
	bool "Build nxboot bootloader application"
	default n
	select BOARDCTL
	select BOARDCTL_BOOT_IMAGE
	---help---
		This option builds and links a bootloader application. This application
		should be an entry function for NuttX. It checks for possible update/
		revert operation, performs it and boot the correct image.

if NXBOOT_BOOTLOADER

config NXBOOT_COPY_TO_RAM
	bool "Copy bootable image to RAM before calling board boot-image function"
	default n
	---help---
		The is a board and/or arch specific option that may be used when running
		directly from flash, especially if external flash, even in XIP mode, is too
		slow.
		Running from RAM usually results in faster execution but the board must, of
		course, have sufficient RAM available for the application image, stack
		and heap.

config NXBOOT_RAMSTART
	hex "Start address in RAM that the application is to be loaded"
	default 0x0
	depends on NXBOOT_COPY_TO_RAM
	---help---
		This will be board specific. A check of the board's linker script
		may be informative. For example the SAMA5D2-XULT eval board's uboot
		linker script - boards/arm/sama5/sama5d2-xult/scripts/uboot.ld - has:
		
		sdram (W!RX) : ORIGIN = 0x20008000, LENGTH = 256M - 32K

		This shows the load address to be 0x20008000 and would be the address
		to use here if the same linker script is to be be used for NXboot.

		Typically the address is the base address of the RAM to be used, plus the
		size of the NXboot image itself. The example above has reserved
		32KiB (0x8000) for this from the 256MiB available on the board at
		address 0x20000000.

config NXBOOT_SWRESET_ONLY
	bool "Perform update/revert only on SW reset"
	default n
	select BOARDCTL_RESET_CAUSE
	---help---
		This option ensures the update/revert is performed only for following
		reset causes:
			BOARDIOC_RESETCAUSE_CPU_SOFT: software reset
			BOARDIOC_RESETCAUSE_CPU_RWDT: watchdog error
			BOARDIOC_RESETCAUSE_PIN: reset button

		This way the board can keep its image (even if not confirmed) during
		for example power shutdown and perform update/revent only if expected
		based on user/maintainer input.

config NXBOOT_PREVENT_DOWNGRADE
	bool "Perform update only for newer version"
	default n
	---help---
		NXboot uses Semantic Version 2.0.0 (without build metadata). By default
		the update is performed for every version that doesn't match the
		currently running one. If NXBOOT_PREVENT_DOWNGRADE selected, update is
		performed only for newer versions (according to Semantic Version
		preference rules).

		WARNING: NXboot currently implements preferences only for
		MAJOR.MINOR.PATCH and ignores prerelease.

config NXBOOT_PROGRESS
	bool
	default n

config NXBOOT_PRINTF_PROGRESS
	bool "Enable progress messages to be sent to STDOUT"
	default y
	select NXBOOT_PROGRESS
	---help---
		This will display progress during typically lengthy operations:
			- Calculating checksums
			- copying images between slots

		Note: the NXboot binary will be approximately 2KiB larger with this enabled.

choice
	prompt "Choose preferred progress indication type"
	depends on NXBOOT_PRINTF_PROGRESS
	default NXBOOT_PRINTF_PROGRESS_PERCENT

config NXBOOT_PRINTF_PROGRESS_DOTS
	bool "Display progress using sequential dots"

config NXBOOT_PRINTF_PROGRESS_PERCENT
	bool "Display progress using percentage remaining"

endchoice

endif # NXBOOT_BOOTLOADER

endif # BOOT_NXBOOT
```

## builtin/Kconfig
```kconfig
#
# For a description of the syntax of this configuration file,
# see the file kconfig-language.txt in the NuttX tools repository.
#

menu "Built-In Applications"
	depends on BUILTIN

config BUILTIN_PROXY_STACKSIZE
	int "Builtin Proxy Stack Size"
	default 1024
	---help---
		If exec_builtin uses I/O redirection options, then it will require
		an intermediary/proxy task to muck with the file descriptors.  This
		configuration item specifies the stack size used for the proxy. Default:
		1024 bytes.

endmenu # Built-In Applications
```

## canutils/Kconfig
```kconfig
#
# For a description of the syntax of this configuration file,
# see the file kconfig-language.txt in the NuttX tools repository.
#

menu "CAN Utilities"

source "$APPSDIR/canutils/libcanard/Kconfig"
source "$APPSDIR/canutils/libuavcan/Kconfig"

endmenu # CAN Utilities
```

## canutils/candump/Kconfig
```kconfig
#
# For a description of the syntax of this configuration file,
# see the file kconfig-language.txt in the NuttX tools repository.
#

config CANUTILS_CANDUMP
	tristate "SocketCAN candump tool"
	default n
	depends on NET_CAN
        select CANUTILS_LIBCANUTILS
	---help---
		Enable the SocketCAN candump tool ported from
		https://github.com/linux-can/can-utils

if CANUTILS_CANDUMP
endif
```

## canutils/canlib/Kconfig
```kconfig
#
# For a description of the syntax of this configuration file,
# see the file kconfig-language.txt in the NuttX tools repository.
#

config CANUTILS_CANLIB
	bool "CAN utility library"
	default n
	depends on CAN
	---help---
		Enable the CAN utility library

if CANUTILS_CANLIB

endif
```

## canutils/cansend/Kconfig
```kconfig
#
# For a description of the syntax of this configuration file,
# see the file kconfig-language.txt in the NuttX tools repository.
#

config CANUTILS_CANSEND
	tristate "SocketCAN cansend tool"
	default n
	depends on NET_CAN
        select CANUTILS_LIBCANUTILS
	---help---
		Enable the SocketCAN cansend tool ported from
		https://github.com/linux-can/can-utils

if CANUTILS_CANSEND

config CANUTILS_CANSEND_STACKSIZE
	int "SocketCAN cansend stack size"
	default DEFAULT_TASK_STACKSIZE

endif
```
