## examples/audio_rttl/Kconfig
```kconfig
#
# For a description of the syntax of this configuration file,
# see the file kconfig-language.txt in the NuttX tools repository.
#

config EXAMPLES_AUDIO_SOUND
	bool "Audio tone generator example (RTTL player)"
	default n
	---help---
		Enable the audio RTTL player example

if EXAMPLES_AUDIO_SOUND

config EXAMPLES_AUDIO_SOUND_PROGNAME
	string "Program name"
	default "audio_rttl"

config EXAMPLES_AUDIO_SOUND_PRIORITY
	int "Audio sound task priority"
	default 150

config EXAMPLES_AUDIO_SOUND_STACKSIZE
	int "Audio sound stack size"
	default DEFAULT_TASK_STACKSIZE

endif
```

## examples/baromonitor/Kconfig
```kconfig
#
# For a description of the syntax of this configuration file,
# see the file kconfig-language.txt in the NuttX tools repository.
#

config EXAMPLES_BAROMONITOR
	tristate "Barometer monitoring dashboard example"
	default n
	depends on UORB
	depends on LIBC_FLOATINGPOINT
	depends on GRAPHICS_LVGL
	depends on LV_USE_NUTTX
	depends on LV_FONT_MONTSERRAT_24
	depends on LV_FONT_MONTSERRAT_32
	---help---
		Enable the barometer monitoring dashboard.

if EXAMPLES_BAROMONITOR

config EXAMPLES_BAROMONITOR_PROGNAME
	string "Program name"
	default "baromonitor"

config EXAMPLES_BAROMONITOR_PRIORITY
	int "Barometer monitor task priority"
	default 100

config EXAMPLES_BAROMONITOR_STACKSIZE
	int "Baromonitor stack size"
	default DEFAULT_TASK_STACKSIZE

config EXAMPLES_BAROMONITOR_SAMPLERATE
	int "Sample rate (ms)"
	default	50
	---help---
		Sample rate in milliseconds of barometer data.

endif # EXAMPLES_BARO_DASHBOARD
```

## examples/bastest/Kconfig
```kconfig
#
# For a description of the syntax of this configuration file,
# see the file kconfig-language.txt in the NuttX tools repository.
#

config EXAMPLES_BASTEST
	tristate "Setup Test Files for BAS"
	default n
	depends on FS_ROMFS && INTERPRETERS_BAS
	---help---
		Mount the ROMFS file system containing the BAS test files at
		/mnt/romfs.  This selection depends both on INTERPRETER_BAS to provide
		the BASIC interpreter and and upon FS_ROMFS to provide support for the
		ROMFS file system.

		The logic in certain tests (test33.bas and test36.bas will also fail
		if there is no writable file system mount at /tmp.

if EXAMPLES_BASTEST

config EXAMPLES_BASTEST_DEVMINOR
	int "ROMFS Minor Device Number"
	default 0
	---help---
		The minor device number of the ROMFS block. For example, the N in
		/dev/ramN. Used for registering the RAM block driver that will hold
		the ROMFS file system containing the BASIC files to be tested.
		Default: 0

config EXAMPLES_BASTEST_DEVPATH
	string "ROMFS Device Path"
	default "/dev/ram0"
	---help---
		The path to the ROMFS block driver device.  This must match
		EXAMPLES_BASTEST_DEVMINOR. Used for registering the RAM block driver
		that will hold the ROMFS file system containing the BASIC files to
		be tested.  Default: "/dev/ram0"

endif
```

## examples/battery/Kconfig
```kconfig
#
# For a description of the syntax of this configuration file,
# see the file kconfig-language.txt in the NuttX tools repository.
#

config EXAMPLES_BATTERY
	tristate "Battery monitor example"
	default n
	---help---
		Enable the battery monitor example

if EXAMPLES_BATTERY

config EXAMPLES_BATTERY_PROGNAME
	string "Program name"
	default "batt"
	---help---
		This is the name of the program that will be used when the NSH ELF
		program is installed.

config EXAMPLES_BATTERY_DEVNAME
	string "Battery charger device name"
	default "/dev/batt0"

config EXAMPLES_BATTERY_PRIORITY
	int "Battery task priority"
	default 100

config EXAMPLES_BATTERY_STACKSIZE
	int "Battery stack size"
	default DEFAULT_TASK_STACKSIZE
endif
```
