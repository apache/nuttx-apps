## crypto/openssl_mbedtls_wrapper/Kconfig
```kconfig
#
# For a description of the syntax of this configuration file,
# see the file kconfig-language.txt in the NuttX tools repository.
#

config OPENSSL_MBEDTLS_WRAPPER
	depends on CRYPTO_MBEDTLS
	bool "openssl mbedtls wrapper"
	default n

if OPENSSL_MBEDTLS_WRAPPER

choice
	prompt "Openssl Mbedtls Wrapper Assert Debug"
	default OPENSSL_ASSERT_EXIT

config OPENSSL_ASSERT_DEBUG
	bool "SSL_ASSERT* will show error file name and line"

config OPENSSL_ASSERT_EXIT
	bool "SSL_ASSERT* will just return error code"

config OPENSSL_ASSERT_DEBUG_EXIT
	bool "SSL_ASSERT* will show error file name and line, then return error code"

config OPENSSL_ASSERT_DEBUG_BLOCK
	bool "SSL_ASSERT* will show error file name and line, then block here with 'while (1)'"

endchoice

endif # OPENSSL_MBEDTLS_WRAPPER
```

## crypto/tinycrypt/Kconfig
```kconfig
#
# For a description of the syntax of this configuration file,
# see the file kconfig-language.txt in the NuttX tools repository.
#

menu "Crypto: TinyCrypt cryptography library"

config TINYCRYPT
	bool "TinyCrypt Support"
	---help---
		This option enables the TinyCrypt cryptography library.

if TINYCRYPT
config TINYCRYPT_VERSION
	string "Tinycrypt Version"
	default "0.2.8"

config TINYCRYPT_CTR_PRNG
	bool "PRNG in counter mode"
	default n
	---help---
		This option enables support for the pseudo-random number
		generator in counter mode.

config TINYCRYPT_SHA256
	bool "SHA-256 Hash function support"
	default n
	---help---
		This option enables support for SHA-256
		hash function primitive.

config TINYCRYPT_SHA256_HMAC
	bool "HMAC (via SHA256) message auth support"
	default n
	---help---
		This option enables support for HMAC using SHA-256
		message authentication code.

config TINYCRYPT_SHA256_HMAC_PRNG
	bool "PRNG (via HMAC-SHA256) support"
	default n
	---help---
		This option enables support for pseudo-random number
		generator.

config TINYCRYPT_ECC
	bool
	default n

config TINYCRYPT_ECC_DH
	bool "ECC_DH anonymous key agreement protocol"
	default n
	select TINYCRYPT_ECC
	---help---
		This option enables support for the Elliptic curve
		Diffie-Hellman anonymous key agreement protocol.

		Enabling ECC requires a cryptographically secure random number
		generator.

config TINYCRYPT_ECC_DSA
	bool "ECC_DSA digital signature algorithm"
	default n
	select TINYCRYPT_ECC
	---help---
		This option enables support for the Elliptic Curve Digital
		Signature Algorithm (ECDSA).

		Enabling ECC requires a cryptographically secure random number
		generator.

config TINYCRYPT_AES
	bool "AES-128 decrypt/encrypt"
	default n
	---help---
		This option enables support for AES-128 decrypt and encrypt.

config TINYCRYPT_AES_CBC
	bool "AES-128 block cipher"
	default n
	---help---
		This option enables support for AES-128 block cipher mode.

config TINYCRYPT_AES_CTR
	bool "AES-128 counter mode"
	default n
	---help---
		This option enables support for AES-128 counter mode.

config TINYCRYPT_AES_CCM
	bool "AES-128 CCM mode"
	default n
	---help---
		This option enables support for AES-128 CCM mode.

config TINYCRYPT_AES_CMAC
	bool "AES-128 CMAC mode"
	default n
	---help---
		This option enables support for AES-128 CMAC mode.

config TINYCRYPT_TEST
	tristate "Enable TinyCrypt test"
	default n
	---help---
		Enable the TinyCrypt test.

if TINYCRYPT_TEST

config TINYCRYPT_TEST_PRIORITY
	int "TinyCrypt test priority"
	default 100

config TINYCRYPT_TEST_STACKSIZE
	int "TinyCrypt test stack size"
	default DEFAULT_TASK_STACKSIZE

endif # TINYCRYPT_TEST

endif # TINYCRYPT

endmenu # "Crypto: TinyCrypt cryptography library"
```

## crypto/tinydtls/Kconfig
```kconfig
#
# For a description of the syntax of this configuration file,
# see the file kconfig-language.txt in the NuttX tools repository.
#

config CRYPTO_TINYDTLS
	bool "Eclipse Tinydtls"
	default n
	depends on ALLOW_ECLIPSE_COMPONENTS
	---help---
		Enable Eclipse tinydtls - a minimal library for DTLS.

if CRYPTO_TINYDTLS

config TINYDTLS_VERSION
	string "Tinydtls version"
	default "ba830a390642d057fcf21bbb6bd57546d12e584c"

endif # CRYPTO_TINYDTLS
```

## database/sqlite/Kconfig
```kconfig
#
# For a description of the syntax of this configuration file,
# see the file kconfig-language.txt in the NuttX tools repository.
#

config LIB_SQLITE
	bool "SQLITE library"
	depends on CONFIG_FS_LOCK_BUCKET_SIZE > 0
	default n

if LIB_SQLITE

config LIB_SQLITE_VERSION
	string "SQLITE version"
	default "3.45.1"

config UTILS_SQLITE
	tristate "SQLite cmd line tool"
	default n

config UTILS_SQLITE_STACKSIZE
	int "SQLite3 cmd line tool stack size"
	default 8192
	depends on UTILS_SQLITE

endif
```

## epaper/write_cmd/Kconfig
```kconfig
#
# For a description of the syntax of this configuration file,
# see the file kconfig-language.txt in the NuttX tools repository.
#

config EPAPER_WRITE_CMD
	tristate "write_cmd"
	default n
	---help---
		Enable write command to epaper display

if EPAPER_WRITE_CMD

config EPAPER_WRITE_CMD_PROGNAME
	string "Program name"
	default "write_cmd"
	---help---
		This is the name of the program that will be used when the NSH ELF
		program is installed.

config EPAPER_WRITE_CMD_PRIORITY
	int "epwrite task priority"
	default 100

config EPAPER_WRITE_CMD_STACKSIZE
	int "epwritecmd stack size"
	default DEFAULT_TASK_STACKSIZE

endif
```

## epaper/write_dta/Kconfig
```kconfig
#
# For a description of the syntax of this configuration file,
# see the file kconfig-language.txt in the NuttX tools repository.
#

config EPAPER_WRITE_DTA
	tristate "write_dta"
	default n
	---help---
		Enable write data to epaper display

if EPAPER_WRITE_DTA

config EPAPER_WRITE_DTA_PROGNAME
	string "Program name"
	default "write_dta"
	---help---
		This is the name of the program that will be used when the NSH ELF
		program is installed.

config EPAPER_WRITE_DTA_PRIORITY
	int "write_dta task priority"
	default 100

config EPAPER_WRITE_DTA_STACKSIZE
	int "epwritedta stack size"
	default DEFAULT_TASK_STACKSIZE

endif
```

## examples/abntcodi/Kconfig
```kconfig
#
# For a description of the syntax of this configuration file,
# see the file kconfig-language.txt in the NuttX tools repository.
#

config EXAMPLES_ABNTCODI
	tristate "ABNT CODI example"
	default n
	select INDUSTRY_ABNT_CODI_LIB
	---help---
		Enable the ABNT CODI test example

if EXAMPLES_ABNTCODI

config EXAMPLES_ABNTCODI_PROGNAME
	string "Program name"
	default "abntcodi"
	---help---
		This is the name of the program that will be used when the NSH ELF
		program is installed.

config EXAMPLES_ABNTCODI_PRIORITY
	int "ABNTCODI task priority"
	default 100

config EXAMPLES_ABNTCODI_STACKSIZE
	int "ABNTCODI stack size"
	default DEFAULT_TASK_STACKSIZE

endif
```

## examples/adc/Kconfig
```kconfig
#
# For a description of the syntax of this configuration file,
# see the file kconfig-language.txt in the NuttX tools repository.
#

config EXAMPLES_ADC
	tristate "ADC example"
	default n
	depends on ADC && LIB_BOARDCTL
	select BOARDCTL_ADCTEST
	---help---
		Enable the ADC example

if EXAMPLES_ADC

config EXAMPLES_ADC_DEVPATH
	string "ADC device path"
	default "/dev/adc0"
	---help---
		The default path to the ADC device. Default: /dev/adc0

config EXAMPLES_ADC_NSAMPLES
	int "Number of Sample Groups"
	default 0
	depends on !NSH_BUILTIN_APPS
	---help---
		If NSH_BUILTIN_APPS is defined, then the number of samples is provided
		on the command line and this value is ignored.  Otherwise, this number
		of samples is collected and the program terminates.  Default:  0 (samples
		are collected indefinitely).

config EXAMPLES_ADC_GROUPSIZE
	int "Number of Samples per Group"
	default 4
	---help---
		The number of samples to read at once. Default: 4

config EXAMPLES_ADC_SWTRIG
	bool "Use software trigger"
	default n
	---help---
		Some ADCs may be configured so there is no automatic or periodic
		conversion of samples.  Rather, the ADC sampling must be trigger by
		software via an ioctl command.  Select this option only if
		applicable for your ADC configuration.  In this case, the test will
		issue the software trigger ioctl before attempting to read from the
		ADC.

endif
```

## examples/adjtime/Kconfig
```kconfig
#
# For a description of the syntax of this configuration file,
# see the file kconfig-language.txt in the NuttX tools repository.
#

config EXAMPLES_ADJTIME
	tristate "Ajdtime function example"
	default n
	depends on CLOCK_ADJTIME
	---help---
		Enable the adjtime example. This application demonstrates the usage
		of adjtime() interface used to synchronize system clock time if
		its value varies from real time (usually get by external RTC).

if EXAMPLES_ADJTIME

config EXAMPLES_ADJTIME_PROGNAME
	string "Program name"
	default "adjtime"
	---help---
		This is the name of the program that will be used when the NSH ELF
		program is installed.

config EXAMPLES_ADJTIME_PRIORITY
	int "Adjtime task priority"
	default 100

config EXAMPLES_ADJTIME_STACKSIZE
	int "Adjtime stack size"
	default DEFAULT_TASK_STACKSIZE

endif
```

## examples/ads7046/Kconfig
```kconfig
#
# For a description of the syntax of this configuration file,
# see the file kconfig-language.txt in the NuttX tools repository.
#

config EXAMPLES_ADS7046
	tristate "ADS7046 ADC example"
	default n
	depends on ADC_ADS7046
	---help---
		Enable the ADS7046 example

if EXAMPLES_ADS7046

config EXAMPLES_ADS7046_PROGNAME
	string "Program name"
	default "ads7046"
	---help---
		This is the name of the program that will be used when the NSH ELF
		program is installed.

config EXAMPLES_ADS7046_PRIORITY
	int "ADS7046 task priority"
	default 100

config EXAMPLES_ADS7046_STACKSIZE
	int "ADS7046 stack size"
	default DEFAULT_TASK_STACKSIZE

config EXAMPLES_ADS7046_DEVPATH
	string "ADS7046 device path"
	default "/dev/adc0"
	---help---
		The default path to the ADS7046 ADC device

endif
```

## examples/adxl372_test/Kconfig
```kconfig
#
# For a description of the syntax of this configuration file,
# see the file kconfig-language.txt in the NuttX tools repository.
#

config EXAMPLES_ADXL372_TEST
	tristate "ADXL372 test program"
	default n
	---help---
		Enable the ADXL372 sensor SPI test program.

if EXAMPLES_ADXL372_TEST

config EXAMPLES_ADXL372_TEST_PROGNAME
	string "Program name"
	default "adxl372_test"
	---help---
		This is the name of the program that will be used when the NSH ELF
		program is installed.

config EXAMPLES_ADXL372_TEST_PRIORITY
	int "adxl372_test task priority"
	default 100

config EXAMPLES_ADXL372_TEST_STACKSIZE
	int "adxl372_test stack size"
	default DEFAULT_TASK_STACKSIZE

endif
```

## examples/ajoystick/Kconfig
```kconfig
#
# For a description of the syntax of this configuration file,
# see the file kconfig-language.txt in the NuttX tools repository.
#

config EXAMPLES_AJOYSTICK
	tristate "Analog joystick example"
	default n
	depends on INPUT_AJOYSTICK
	---help---
		Enable the analog joystick example

if EXAMPLES_AJOYSTICK

config EXAMPLES_AJOYSTICK_DEVNAME
	string "Joystick device name"
	default "/dev/ajoy0"

config EXAMPLES_AJOYSTICK_SIGNO
	int "Joystick signal"
	default 13

endif
```

## examples/alarm/Kconfig
```kconfig
#
# For a description of the syntax of this configuration file,
# see the file kconfig-language.txt in the NuttX tools repository.
#

config EXAMPLES_ALARM
	bool "RTC alarm driver example"
	default n
	depends on RTC_DRIVER && RTC_ALARM
	---help---
		Enable the RTC driver alarm test

if EXAMPLES_ALARM

config EXAMPLES_ALARM_PROGNAME
	string "Program name"
	default "alarm"
	depends on BUILD_LOADABLE
	---help---
		This is the name of the program that will be use when the NSH ELF
		program is installed.

config EXAMPLES_ALARM_PRIORITY
	int "Alarm task priority"
	default 100

config EXAMPLES_ALARM_STACKSIZE
	int "Alarm stack size"
	default 2048

config EXAMPLES_ALARM_DEVPATH
	string "RTC device path"
	default "/dev/rtc0"

config EXAMPLES_ALARM_SIGNO
	int "Alarm signal"
	default 1

endif # EXAMPLES_ALARM
```

## examples/amg88xx/Kconfig
```kconfig
config EXAMPLES_AMG88XX
	tristate "AMG88xx sensor example"
	default n
	depends on SENSORS_AMG88XX
	---help---
		Enable the AMG88xx sensor example

if EXAMPLES_AMG88XX

config EXAMPLES_AMG88XX_PROGNAME
	string "Program name"
	default "amg88xx"
	---help---
		This is the name of the program that will be used when the NSH ELF
		program is installed.

config EXAMPLES_AMG88XX_PRIORITY
	int "AMG88xx task priority"
	default 100

config EXAMPLES_AMG88XX_STACKSIZE
	int "AMG88xx stack size"
	default DEFAULT_TASK_STACKSIZE

endif
```

## examples/apa102/Kconfig
```kconfig
#
# For a description of the syntax of this configuration file,
# see the file kconfig-language.txt in the NuttX tools repository.
#

config EXAMPLES_APA102
	tristate "APA102 LED Strip example"
	default n
	depends on LCD_APA102
	---help---
		Enable the APA102 example

if EXAMPLES_APA102

config EXAMPLES_APA102_PROGNAME
	string "Program name"
	default "apa102"
	---help---
		This is the name of the program that will be used when the NSH ELF
		program is installed.

endif
```

## examples/apds9960/Kconfig
```kconfig
#
# For a description of the syntax of this configuration file,
# see the file kconfig-language.txt in the NuttX tools repository.
#

config EXAMPLES_APDS9960
	tristate "APDS-9960 Test Application"
	default n
	depends on SENSORS_APDS9960
	---help---
		Enable the APDS-9960 test application.

if EXAMPLES_APDS9960

config EXAMPLES_APDS9960_PROGNAME
	string "APDS-9960 Test Program name"
	default "apds9960"
	depends on BUILD_LOADABLE
	---help---
		This is the name of the program that will be use when the NSH ELF
		program is installed.

config EXAMPLES_APDS9960_DEVNAME
	string "APDS-9960 device file name"
	default "/dev/gest0"
	---help---
		This is the name of device file name created by APDS9960 driver.

config EXAMPLES_APDS9960_PRIORITY
	int "APDS-9960 Test task priority"
	default 100

config EXAMPLES_APDS9960_STACKSIZE
	int "APDS-9960 Test stack size"
	default 2048

endif
```

## examples/aplicativo/Kconfig
```kconfig
config EXAMPLES_APP
	tristate "\"Application!\" example"
	default n
	---help---
		Enable the \"Application!\" example

if EXAMPLES_APP

config EXAMPLES_APP_PROGNAME
	string "Program name"
	default "application"
	---help---
		This is the name of the program that will be used when the NSH ELF
		program is installed.

config EXAMPLES_APP_PRIORITY
	int "App task priority"
	default 100

config EXAMPLES_APP_STACKSIZE
	int "App stack size"
	default 2048

endif
```

## examples/archbuttons/Kconfig
```kconfig
#
# For a description of the syntax of this configuration file,
# see the file kconfig-language.txt in the NuttX tools repository.
#

config EXAMPLES_ARCHBUTTONS
	bool "Arch Buttons example"
	default n
	depends on ARCH_BUTTONS && BUILD_FLAT
	---help---
		Enable the buttons example.  May require ARCH_BUTTONS on some boards.

if EXAMPLES_ARCHBUTTONS
config EXAMPLES_ARCHBUTTONS_MIN
int "Lowest Button Number"
default 0

config EXAMPLES_ARCHBUTTONS_MAX
int "Highest Button Number"
default 7

if ARCH_IRQBUTTONS
config EXAMPLES_IRQBUTTONS_MIN
int "Lowest Interrupting Button Number"
default 0

config EXAMPLES_IRQBUTTONS_MAX
int "Highest Interrupting Button Number"
default 7

config EXAMPLES_ARCHBUTTONS_NAME0
string "Button 0 Name"
default "Button 0"

config EXAMPLES_ARCHBUTTONS_NAME1
string "Button 1 Name"
default "Button 1"

config EXAMPLES_ARCHBUTTONS_NAME2
string "Button 2 Name"
default "Button 2"

config EXAMPLES_ARCHBUTTONS_NAME3
string "Button 3 Name"
default "Button 3"

config EXAMPLES_ARCHBUTTONS_NAME4
string "Button 4 Name"
default "Button 4"

config EXAMPLES_ARCHBUTTONS_NAME5
string "Button 5 Name"
default "Button 5"

config EXAMPLES_ARCHBUTTONS_NAME6
string "Button 6 Name"
default "Button 6"

config EXAMPLES_ARCHBUTTONS_NAME7
string "Button 7 Name"
default "Button 7"

endif
endif
```
