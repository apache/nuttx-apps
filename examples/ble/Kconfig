## examples/ble/Kconfig
```kconfig
#
# For a description of the syntax of this configuration file,
# see the file kconfig-language.txt in the NuttX tools repository.
#

config EXAMPLES_BLE
	tristate "BLE sensor reading example"
	default n
	depends on WIRELESS_BLUETOOTH
	---help---
		Enable the BLE example

if EXAMPLES_BLE

config EXAMPLES_BLE_PROGNAME
	string "Program name"
	default "ble"
	---help---
		This is the name of the program that will be used when the NSH ELF
		program is installed.

config EXAMPLES_BLE_PRIORITY
	int "BLE task priority"
	default 100

config EXAMPLES_BLE_STACKSIZE
	int "BLE stack size"
	default DEFAULT_TASK_STACKSIZE

config EXAMPLES_BLE_USE_BME680
	bool "Use BME680 sensor data"
	default n
	depends on SENSORS_BME680
	---help---
		If enabled, use real BME680 sensor data. If disabled, use dummy data.

endif
```

## examples/bme680/Kconfig
```kconfig
#
# For a description of the syntax of this configuration file,
# see the file kconfig-language.txt in the NuttX tools repository.
#

config EXAMPLES_BME680
	tristate "BME680 sensor example"
	default n
	depends on SENSORS_BME680
	---help---
		Enable the BME680 example

if EXAMPLES_BME680

config EXAMPLES_BME680_PROGNAME
	string "Program name"
	default "bme680"
	---help---
		This is the name of the program that will be used when the NSH ELF
		program is installed.

config EXAMPLES_BME680_PRIORITY
	int "BME680 task priority"
	default 100

config EXAMPLES_BME680_STACKSIZE
	int "BME680 stack size"
	default DEFAULT_TASK_STACKSIZE

endif
```

## examples/bmi160/Kconfig
```kconfig
#
# For a description of the syntax of this configuration file,
# see the file kconfig-language.txt in the NuttX tools repository.
#

config EXAMPLES_SIXAXIS
	bool "BMI160 sensor example"
	default n
	depends on SENSORS_BMI160
	---help---
		Enable the 6 axis sensor example

if EXAMPLES_SIXAXIS

config EXAMPLES_SIXAXIS_UORB
	bool "BMI160 sensor uorb example"
	default n
	depends on SENSORS_BMI160_UORB
	---help---
		Enables Work with the UORB or Character Device interface.
		If not set, the Character Device is used by default.

config EXAMPLES_SIXAXIS_PROGNAME
	string "Program name"
	default "sixaxis"
	---help---
		This is the name of the program that will be use when the NSH ELF
		program is installed.

config EXAMPLES_SIXAXIS_PRIORITY
	int "sixaxis task priority"
	default 100

config EXAMPLES_SIXAXIS_STACKSIZE
	int "sixaxis stack size"
	default DEFAULT_TASK_STACKSIZE

endif
```

## examples/bmp180/Kconfig
```kconfig
#
# For a description of the syntax of this configuration file,
# see the file kconfig-language.txt in the NuttX tools repository.
#

config EXAMPLES_BMP180
	tristate "BMP180/280 Barometer sensor example"
	default n
	depends on SENSORS_BMP180 || SENSORS_BMP280
	---help---
		Enable the BMP180/BMP280 example

if EXAMPLES_BMP180

config EXAMPLES_BMP180_PROGNAME
	string "Program name"
	default "bmp180"
	---help---
		This is the name of the program that will be used when the NSH ELF
		program is installed.

config EXAMPLES_BMP180_PRIORITY
	int "BMP180 task priority"
	default 100

config EXAMPLES_BMP180_STACKSIZE
	int "BMP180 stack size"
	default DEFAULT_TASK_STACKSIZE

endif
```

## examples/bmp280/Kconfig
```kconfig
#
# For a description of the syntax of this configuration file,
# see the file kconfig-language.txt in the NuttX tools repository.
#

config EXAMPLES_BMP280
	tristate "BMP280 Barometer sensor example"
	default n
	depends on SENSORS_BMP280
	---help---
		Enable the BMP280 example

if EXAMPLES_BMP280

config EXAMPLES_BMP280_PROGNAME
	string "Program name"
	default "bmp280"
	---help---
		This is the name of the program that will be used when the NSH ELF
		program is installed.

config EXAMPLES_BMP280_PRIORITY
	int "BMP280 task priority"
	default 100

config EXAMPLES_BMP280_STACKSIZE
	int "BMP280 stack size"
	default DEFAULT_TASK_STACKSIZE

endif
```

## examples/bridge/Kconfig
```kconfig
#
# For a description of the syntax of this configuration file,
# see the file kconfig-language.txt in the NuttX tools repository.
#

config EXAMPLES_BRIDGE
	tristate "UDP bridge example"
	default n
	depends on NET_UDP && !NET_IPv6
	---help---
		Simple test of a system with multiple networks.  It simply echoes all
		UDP packets received on network 1 and network 2 to network 2 and
		network 1, respectively.  Interface 1 and interface may or may not
		lie on the same network.

		If used as a NSH add-on, then it is assumed that initialization of
		both networks was performed externally prior to the time that this
		test was started.

if EXAMPLES_BRIDGE

comment "Network 1 configuration"

config EXAMPLES_BRIDGE_NET1_IFNAME
	string "Device name"
	default "eth0"
	---help---
		The register name of the network 1 device.  Must match the previously
		registered driver name and must not be the same as
		EXAMPLES_BRIDGE_NET2_IFNAME

config EXAMPLES_BRIDGE_NET1_RECVPORT
	int "UDP receive port"
	default 5471
	---help---
		Network 1 listen port number

config EXAMPLES_BRIDGE_NET1_IOBUFIZE
	int "UDP I/O buffer size"
	default 1024
	---help---
		Size of the UDP send/receive I/O buffer

if !NSH_BUILTIN_APPS

config EXAMPLES_BRIDGE_NET1_DHCPC
	bool "DHCP Client"
	default n
	select NETUTILS_DHCPC
	select NETDB_DNSCLIENT

config EXAMPLES_BRIDGE_NET1_NOMAC
	bool "Use Canned MAC Address"
	default n
	---help---
		Select if the hardware has no built-in MAC address.

config EXAMPLES_BRIDGE_NET1_MACADDR
	hex "Canned MAC address"
	default 0x00e0deadbeef
	depends on EXAMPLES_BRIDGE_NET1_NOMAC
	---help---
		If the hardware has no built-in MAC address then the fixed,
		software-assigned MAC address MAC address must provided
		with this selection.

config EXAMPLES_BRIDGE_NET1_IPADDR
	hex "IP address"
	default 0x0a000002
	depends on !EXAMPLES_BRIDGE_NET1_DHCPC
	---help---
		IP address of network 1 for the target

config EXAMPLES_BRIDGE_NET1_DRIPADDR
	hex "Default Router IP address (Gateway)"
	default 0x0a000001

config EXAMPLES_BRIDGE_NET1_NETMASK
	hex "Network Mask"
	default 0xffffff00

endif # !NSH_BUILTIN_APPS

config EXAMPLES_BRIDGE_NET1_IPHOST
	hex "Host IP address"
	default 0x0a000001
	---help---
		IP address of network 1 for the host

config EXAMPLES_BRIDGE_NET1_HOSTPORT
	int "Host listen port"
	default 5472
	---help---
		Port number used by the host on network 1

config EXAMPLES_BRIDGE_NET1_STACKSIZE
	int "Network 1 daemon stacksize"
	default 2048

config EXAMPLES_BRIDGE_NET1_PRIORITY
	int "Network 1 daemon task priority"
	default 100

comment "Network 2 configuration"

config EXAMPLES_BRIDGE_NET2_IFNAME
	string "Device name"
	default "eth1"
	---help---
		The register name of the network 2 device.  Must match the previously
		registered driver name and must not be the same as
		EXAMPLES_BRIDGE_NET2_IFNAME

config EXAMPLES_BRIDGE_NET2_RECVPORT
	int "UDP receive port"
	default 5473
	---help---
		Network 1 listen port number

config EXAMPLES_BRIDGE_NET2_IOBUFIZE
	int "UDP I/O buffer size"
	default 1024
	---help---
		Size of the UDP send/receive I/O buffer

if !NSH_BUILTIN_APPS

config EXAMPLES_BRIDGE_NET2_DHCPC
	bool "DHCP Client"
	default n
	select NETUTILS_DHCPC
	select NETDB_DNSCLIENT

config EXAMPLES_BRIDGE_NET2_NOMAC
	bool "Use Canned MAC Address"
	default n
	---help---
		Select if the hardware has no built-in MAC address.

config EXAMPLES_BRIDGE_NET2_MACADDR
	hex "Canned MAC address"
	default 0x00e0f00dface
	depends on EXAMPLES_BRIDGE_NET2_NOMAC
	---help---
		If the hardware has no built-in MAC address then the fixed,
		software-assigned MAC address MAC address must provided
		with this selection.

config EXAMPLES_BRIDGE_NET2_IPADDR
	hex "IP address"
	default 0x0a000003
	depends on !EXAMPLES_BRIDGE_NET2_DHCPC
	---help---
		IP address of network 2 for the target

config EXAMPLES_BRIDGE_NET2_DRIPADDR
	hex "Default Router IP address (Gateway)"
	default 0x0a000001

config EXAMPLES_BRIDGE_NET2_NETMASK
	hex "Network Mask"
	default 0xffffff00

endif # !NSH_BUILTIN_APPS

config EXAMPLES_BRIDGE_NET2_IPHOST
	hex "Host IP address"
	default 0x0a000001
	---help---
		IP address of network 2 for the host

config EXAMPLES_BRIDGE_NET2_HOSTPORT
	int "Host listen port"
	default 5474
	---help---
		Port number used by the host on network 2

config EXAMPLES_BRIDGE_NET2_STACKSIZE
	int "Network 2 daemon stacksize"
	default 2048

config EXAMPLES_BRIDGE_NET2_PRIORITY
	int "Network 2 daemon task priority"
	default 100

endif # EXAMPLES_BRIDGE
```

## examples/buttons/Kconfig
```kconfig
#
# For a description of the syntax of this configuration file,
# see the file kconfig-language.txt in the NuttX tools repository.
#

config EXAMPLES_BUTTONS
	tristate "Buttons driver example"
	default n
	depends on BUTTONS
	---help---
		Enable the Buttons drivers example

if EXAMPLES_BUTTONS

config EXAMPLES_BUTTONS_PROGNAME
	string "Program name"
	default "buttons"
	---help---
		This is the name of the program that will be used when the NSH ELF
		program is installed.

config EXAMPLES_BUTTONS_PRIORITY
	int "Button task priority"
	default 100

config EXAMPLES_BUTTONS_STACKSIZE
	int "Button stack size"
	default DEFAULT_TASK_STACKSIZE

config EXAMPLES_BUTTONS_DEVPATH
	string "Button device path"
	default "/dev/buttons"

config EXAMPLES_BUTTONS_NAMES
	bool "Show Buttons Names"
	default n
	---help---
		Enable to show the button's name in the application.

choice
	prompt "Notification mechanism"
	default EXAMPLES_BUTTONS_SIGNAL

config EXAMPLES_BUTTONS_SIGNAL
	bool "Notify using signals"

config EXAMPLES_BUTTONS_POLL
	bool "Notify using poll()"

endchoice

if EXAMPLES_BUTTONS_NAMES

config EXAMPLES_BUTTONS_QTD
	int "Number of Buttons in the Board"
	default 8

config EXAMPLES_BUTTONS_NAME0
	string "Button 0 Name"
	default "BUTTON0"

config EXAMPLES_BUTTONS_NAME1
	string "Button 1 Name"
	default "BUTTON1"

config EXAMPLES_BUTTONS_NAME2
	string "Button 2 Name"
	default "BUTTON2"

config EXAMPLES_BUTTONS_NAME3
	string "Button 3 Name"
	default "BUTTON3"

config EXAMPLES_BUTTONS_NAME4
	string "Button 4 Name"
	default "BUTTON4"

config EXAMPLES_BUTTONS_NAME5
	string "Button 5 Name"
	default "BUTTON5"

config EXAMPLES_BUTTONS_NAME6
	string "Button 6 Name"
	default "BUTTON6"

config EXAMPLES_BUTTONS_NAME7
	string "Button 7 Name"
	default "BUTTON7"

endif # EXAMPLES_BUTTONS_NAMES
endif # EXAMPLES_BUTTONS
```

## examples/calib_udelay/Kconfig
```kconfig
#
# For a description of the syntax of this configuration file,
# see misc/tools/kconfig-language.txt.
#

config EXAMPLES_CALIB_UDELAY
	tristate "Calibration tool for udelay"
	default n
	select LIBC_FLOATINGPOINT
	---help---
		Note that libm support is also required by this tool.  You
		may select CONFIG_LIBM to use the NuttX libm if you are not
		using an external libm.

if EXAMPLES_CALIB_UDELAY

config EXAMPLES_CALIB_UDELAY_NUM_MEASUREMENTS
	int "Number of measurements to take for each loop iteration count"
	default 3
	---help---

config EXAMPLES_CALIB_UDELAY_NUM_RESULTS
	int "Number of results to generate for calibration slope"
	default 20
	---help---

endif
```

## examples/camera/Kconfig
```kconfig
#
# For a description of the syntax of this configuration file,
# see the file kconfig-language.txt in the NuttX tools repository.
#

config EXAMPLES_CAMERA
	tristate "Camera example"
	default n
	---help---
		Enable the camera example

if EXAMPLES_CAMERA

config EXAMPLES_CAMERA_PROGNAME
	string "Program name"
	default "camera"
	---help---
		This is the name of the program that will be use when the NSH ELF
		program is installed.

config EXAMPLES_CAMERA_PRIORITY
	int "Camera task priority"
	default 100

config EXAMPLES_CAMERA_STACKSIZE
	int "Camera stack size"
	default 2048

config EXAMPLES_CAMERA_OUTPUT_LCD
	bool "Output to LCD"
	default n
	---help---
		This enables to output the captured RGB565 image to LCD.

endif
```

## examples/can/Kconfig
```kconfig
#
# For a description of the syntax of this configuration file,
# see the file kconfig-language.txt in the NuttX tools repository.
#

config EXAMPLES_CAN
	tristate "CAN example"
	default n
	depends on CAN
	---help---
		Enable the CAN example

if EXAMPLES_CAN

config EXAMPLES_CAN_DEVPATH
	string "Device Path"
	default "/dev/can0"
	---help---
		The device path

config EXAMPLES_CAN_NMSGS
	int "Number of Messages"
	default 32
	depends on NSH_BUILTIN_APPS
	---help---
		The number of CAN messages to send before returning

choice
	prompt "Read-only, write-only or read-write"
	default EXAMPLES_CAN_READWRITE
	---help---
		Choose to only read, only write, or read and write CAN messages

config EXAMPLES_CAN_READ
	bool "Read-only"
	---help---
		Only read CAN messages

config EXAMPLES_CAN_WRITE
	bool "Write-only"
	---help---
		Only write CAN messages

config EXAMPLES_CAN_READWRITE
	bool "Read-write"
	---help---
		Read and write CAN messages

endchoice

endif
```

## examples/canard/Kconfig
```kconfig
#
# For a description of the syntax of this configuration file,
# see the file kconfig-language.txt in the NuttX tools repository.
#

config EXAMPLES_LIBCANARD
	tristate "libcandard example"
	default n
	depends on CANUTILS_LIBCANARD && CLOCK_MONOTONIC && SYSTEM_TIME64
	---help---
		Enable the LIBCANARD example

if EXAMPLES_LIBCANARD

config EXAMPLES_LIBCANARD_DEVPATH
	string "Device Path"
	default "/dev/can0"
	---help---
		The device path

config EXAMPLES_LIBCANARD_NODE_ID
	int "Node ID"
	default 1
	range 1 127
	---help---
		Specifies the node's ID

config EXAMPLES_LIBCANARD_APP_NODE_NAME
	string "Node name"
	default "org.uavcan.libcanard.nuttx.demo"
	---help---
		app node name

config EXAMPLES_LIBCANARD_NODE_MEM_POOL_SIZE
	int "Node Memory Pool Size"
	default 1024
	---help---
		Specifies the node's memory pool size

config EXAMPLES_LIBCANARD_DAEMON_PRIORITY
	int "daemon task priority"
	default 100

config EXAMPLES_LIBCANARD_STACKSIZE
	int "canard stack size"
	default DEFAULT_TASK_STACKSIZE

endif
```

## examples/canardv0/Kconfig
```kconfig
#
# For a description of the syntax of this configuration file,
# see the file kconfig-language.txt in the NuttX tools repository.
#

config EXAMPLES_LIBCANARDV0
	tristate "libcandard v0 example"
	default n
	depends on CANUTILS_LIBCANARDV0 && SYSTEM_TIME64
	---help---
		Enable the LIBCANARDV0 example

if EXAMPLES_LIBCANARDV0

config EXAMPLES_LIBCANARDV0_DEVPATH
	string "Device Path"
	default "/dev/can0"
	---help---
		The device path

config EXAMPLES_LIBCANARDV0_NODE_ID
	int "Node ID"
	default 1
	range 1 127
	---help---
		Specifies the node's ID

config EXAMPLES_LIBCANARDV0_APP_NODE_NAME
	string "Node name"
	default "org.uavcan.libcanard.nuttx.demo"
	---help---
		app node name

config EXAMPLES_LIBCANARDV0_NODE_MEM_POOL_SIZE
	int "Node Memory Pool Size"
	default 1024
	---help---
		Specifies the node's memory pool size

config EXAMPLES_LIBCANARDV0_DAEMON_PRIORITY
	int "daemon task priority"
	default 100

config EXAMPLES_LIBCANARDV0_STACKSIZE
	int "canard stack size"
	default DEFAULT_TASK_STACKSIZE

endif
```

## examples/canardv1/Kconfig
```kconfig
#
# For a description of the syntax of this configuration file,
# see the file kconfig-language.txt in the NuttX tools repository.
#

config EXAMPLES_LIBCANARDV1
	tristate "libcandard v1 example"
	default n
	depends on CANUTILS_LIBCANARDV1
	---help---
		Enable the LIBCANARDV1 example

if EXAMPLES_LIBCANARDV1

config EXAMPLES_LIBCANARDV1_DEV
	string "Device"
	default "can0"
	---help---
		The device

config EXAMPLES_LIBCANARDV1_NODE_ID
	int "Node ID"
	default 1
	range 1 127
	---help---
		Specifies the node's ID

config EXAMPLES_LIBCANARDV1_APP_NODE_NAME
	string "Node name"
	default "org.uavcan.libcanardv1.nuttx.demo"
	---help---
		app node name

config EXAMPLES_LIBCANARDV1_NODE_MEM_POOL_SIZE
	int "Node Memory Pool Size"
	default 1024
	---help---
		Specifies the node's memory pool size

config EXAMPLES_LIBCANARDV1_DAEMON_PRIORITY
	int "daemon task priority"
	default 100

config EXAMPLES_LIBCANARDV1_DAEMON_STACK_SIZE
	int "canard stack size"
	default DEFAULT_TASK_STACKSIZE

endif
```
