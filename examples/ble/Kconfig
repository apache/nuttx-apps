## examples/capture/Kconfig
```kconfig
#
# For a description of the syntax of this configuration file,
# see the file kconfig-language.txt in the NuttX tools repository.
#

config EXAMPLES_CAPTURE
	tristate "PWM Capture example"
	default n
	depends on CAPTURE
	---help---
		Enable the pwm capture example

if EXAMPLES_CAPTURE

config EXAMPLES_CAPTURE_DEVPATH
	string "Capture device path"
	default "/dev/capture0"
	---help---
		The default path to the capture device

config EXAMPLES_CAPTURE_NSAMPLES
	int "Number of samples"
	default 0
	---help---
		This number of samples is collected and the program
		terminates. If the value is 0, samples are collected indefinitely.

config EXAMPLES_CAPTURE_DELAY
	int "Delay between samples"
	default 100
	---help---
		This value provides the delay (in milliseconds) between each sample.
		If CONFIG_NSH_BUILTIN_APPS is defined, then this value is the default
		delay if no other delay is provided on the command line.

endif
```

## examples/cbortest/Kconfig
```kconfig
#
# For a description of the syntax of this configuration file,
# see the file kconfig-language.txt in the NuttX tools repository.
#

config EXAMPLES_TINYCBOR_TEST
	tristate "TinyCBOR Test Example"
	default n
	depends on FSUTILS_TINYCBOR_LIB
	---help---
		Enable the TinyCBOR test example

if EXAMPLES_TINYCBOR_TEST

config EXAMPLES_TINYCBOR_TEST_PROGNAME
	string "Program name"
	default "cbor"
	---help---
		This is the name of the program that will be used when the NSH ELF
		program is installed.

config EXAMPLES_TINYCBOR_TEST_PRIORITY
	int "TINYCBOR_TEST task priority"
	default 100

config EXAMPLES_TINYCBOR_TEST_STACKSIZE
	int "TINYCBOR_TEST stack size"
	default DEFAULT_TASK_STACKSIZE

endif
```

## examples/cc3000/Kconfig
```kconfig
#
# For a description of the syntax of this configuration file,
# see the file kconfig-language.txt in the NuttX tools repository.
#

config EXAMPLES_CC3000BASIC
	bool "A Basic Application to use CC3000 Module"
	default n
	depends on WL_CC3000
	---help---
		Enable the CC3000BASIC example

if EXAMPLES_CC3000BASIC

config EXAMPLES_CC3000_MEM_CHECK
	bool "Memory check instrumentation"
	default n
	---help---
		Define to help debug memory issues

config EXAMPLES_CC3000_STACK_CHECK
	bool "Stack check instrumentation"
	default n
	---help---
		Define to help debug stack size issues

endif
```

## examples/cctype/Kconfig
```kconfig
#
# For a description of the syntax of this configuration file,
# see the file kconfig-language.txt in the NuttX tools repository.
#

config EXAMPLES_CCTYPE
	tristate "Verify C++ cctype operations"
	default n
	---help---
		Enable the a simple test to verify C++ cctype operations.
```

## examples/cdcacm/Kconfig
```kconfig
#
# For a description of the syntax of this configuration file,
# see misc/tools/kconfig-language.txt.
#

config EXAMPLES_CDCACM
	bool "CDC/ACM example"
	default n
	depends on CDCACM
	---help---
		Enable the USB CDC/ACM class driver example

if EXAMPLES_CDCACM

config EXAMPLES_CDCACM_DEVMINOR
	int "CDC/ACM Minor Device Number"
	default 0
	---help---
		The minor device number of the serial driver for the CDC/ACM device.
		For example, N in /dev/ttyACMN.  Used for registering the serial
		driver. Default is zero.

config EXAMPLES_CDCACM_TRACEINIT
	bool "USB Trace Initialization"
	default n
	depends on USBDEV_TRACE || DEBUG_USB
	---help---
		If USBDEV_TRACE is enabled (or DEBUG and DEBUG_USB),
		then the example code will also manage the USB trace output.  The
		amount of trace output can be controlled this configuration value:
		This setting will show USB initialization events

config EXAMPLES_CDCACM_TRACECLASS
	bool "USB Trace Class"
	default n
	depends on USBDEV_TRACE || DEBUG_USB
	---help---
		If USBDEV_TRACE is enabled (or DEBUG and DEBUG_USB),
		then the example code will also manage the USB trace output.  The
		amount of trace output can be controlled this configuration value:
		This setting will show USB class driver events

config EXAMPLES_CDCACM_TRACETRANSFERS
	bool "USB Trace Transfers"
	default n
	depends on USBDEV_TRACE || DEBUG_USB
	---help---
		If USBDEV_TRACE is enabled (or DEBUG and DEBUG_USB),
		then the example code will also manage the USB trace output.  The
		amount of trace output can be controlled this configuration value:
		This setting will show USB data transfer events

config EXAMPLES_CDCACM_TRACECONTROLLER
	bool "USB Trace Device Controller Events"
	default n
	depends on USBDEV_TRACE || DEBUG_USB
	---help---
		If USBDEV_TRACE is enabled (or DEBUG and DEBUG_USB),
		then the example code will also manage the USB trace output.  The
		amount of trace output can be controlled this configuration value:
		This setting will show USB device controller events

config EXAMPLES_CDCACM_TRACEINTERRUPTS
	bool "USB Trace Device Controller Interrupt Events"
	default n
	depends on USBDEV_TRACE || DEBUG_USB
	---help---
		If USBDEV_TRACE is enabled (or DEBUG and DEBUG_USB),
		then the example code will also manage the USB trace output.  The
		amount of trace output can be controlled this configuration value:
		This setting will show USB device controller interrupt-related events.

endif
```

## examples/charger/Kconfig
```kconfig
config EXAMPLES_CHARGER
	bool "Battery charger example"
	default n
	---help---
		This application is an example of using charger device.

if EXAMPLES_CHARGER

config EXAMPLES_CHARGER_DEVNAME
	string "Charger device name"
	default "/dev/bat"
	---help---
		Set create charger device name.

config EXAMPLES_CHARGER_PROGNAME
	string "Program name"
	default "charger"
	---help---
		This is the name of the program that will be use when the NSH ELF
		program is installed.

config EXAMPLES_CHARGER_PRIORITY
	int "charger task priority"
	default 100

config EXAMPLES_CHARGER_STACKSIZE
	int "charger stack size"
	default DEFAULT_TASK_STACKSIZE

endif
```

## examples/chat/Kconfig
```kconfig
#
# For a description of the syntax of this configuration file,
# see the file kconfig-language.txt in the NuttX tools repository.
#

menuconfig EXAMPLES_CHAT
	tristate "AT modem chat utility"
	default n
	select NETUTILS_CHAT
	---help---
		Enable the AT chat utility.

if EXAMPLES_CHAT

config EXAMPLES_CHAT_TTY_DEVNODE
	string "default modem chat TTY device node"
	default "/dev/ttyS1"
	---help---
		TTY device node used by modem chat.

config EXAMPLES_CHAT_TIMEOUT_SECONDS
	int "default modem timeout (sec)"
	default 20
	---help---
		The default timeout in seconds for the expected string to be
		received.

config EXAMPLES_CHAT_SIZE
	int "maximum chat script file size"
	default 1024
	---help---
		Maximum size of a chat script file, in bytes. Used for run-time
		buffer allocation when reading from file.

config EXAMPLES_CHAT_PRESET0
	string "preset script 0"
	default ""
	---help---
		Preset chat script number 0.

config EXAMPLES_CHAT_PRESET1
	string "preset script 1"
	default ""
	---help---
		Preset chat script number 1.

config EXAMPLES_CHAT_PRESET2
	string "preset script 2"
	default ""
	---help---
		Preset chat script number 2.

config EXAMPLES_CHAT_PRESET3
	string "preset script 3"
	default ""
	---help---
		Preset chat script number 3.

endif # EXAMPLES_CHAT
```

## examples/chrono/Kconfig
```kconfig
#
# For a description of the syntax of this configuration file,
# see the file kconfig-language.txt in the NuttX tools repository.
#

config EXAMPLES_CHRONO
	tristate "Chronometer example to use with STM32LDiscover"
	default n
	---help---
		Enable the Chronometer example

if EXAMPLES_CHRONO

config EXAMPLES_CHRONO_PROGNAME
	string "Program name"
	default "chrono"
	---help---
		This is the name of the program that will be used when the NSH ELF
		program is installed.

config EXAMPLES_CHRONO_PRIORITY
	int "Chrono task priority"
	default 100

config EXAMPLES_CHRONO_STACKSIZE
	int "Chrono stack size"
	default DEFAULT_TASK_STACKSIZE

endif
```

## examples/composite/Kconfig
```kconfig
#
# For a description of the syntax of this configuration file,
# see misc/tools/kconfig-language.txt.
#

config EXAMPLES_COMPOSITE
	bool "USB composite class driver example"
	default n
	---help---
		Enable the USB compsite class driver example

if EXAMPLES_COMPOSITE
config EXAMPLES_COMPOSITE_TRACEINIT
	bool "USB Trace Initialization"
	default n
	depends on USBDEV_TRACE || DEBUG_USB
	---help---
		If USBDEV_TRACE is enabled (or DEBUG and DEBUG_USB),
		then the example code will also manage the USB trace output.  The
		amount of trace output can be controlled this configuration value:
		This setting will show USB initialization events

config EXAMPLES_COMPOSITE_TRACECLASS
	bool "USB Trace Class"
	default n
	depends on USBDEV_TRACE || DEBUG_USB
	---help---
		If USBDEV_TRACE is enabled (or DEBUG and DEBUG_USB),
		then the example code will also manage the USB trace output.  The
		amount of trace output can be controlled this configuration value:
		This setting will show USB class driver events

config EXAMPLES_COMPOSITE_TRACETRANSFERS
	bool "USB Trace Transfers"
	default n
	depends on USBDEV_TRACE || DEBUG_USB
	---help---
		If USBDEV_TRACE is enabled (or DEBUG and DEBUG_USB),
		then the example code will also manage the USB trace output.  The
		amount of trace output can be controlled this configuration value:
		This setting will show USB data transfer events

config EXAMPLES_COMPOSITE_TRACECONTROLLER
	bool "USB Trace Device Controller Events"
	default n
	depends on USBDEV_TRACE || DEBUG_USB
	---help---
		If USBDEV_TRACE is enabled (or DEBUG and DEBUG_USB),
		then the example code will also manage the USB trace output.  The
		amount of trace output can be controlled this configuration value:
		This setting will show USB device controller events

config EXAMPLES_COMPOSITE_TRACEINTERRUPTS
	bool "USB Trace Device Controller Interrupt Events"
	default n
	depends on USBDEV_TRACE || DEBUG_USB
	---help---
		If USBDEV_TRACE is enabled (or DEBUG and DEBUG_USB),
		then the example code will also manage the USB trace output.  The
		amount of trace output can be controlled this configuration value:
		This setting will show USB device controller interrupt-related events.

endif
```

## examples/configdata/Kconfig
```kconfig
#
# For a description of the syntax of this configuration file,
# see the file kconfig-language.txt in the NuttX tools repository.
#

config EXAMPLES_CONFIGDATA
	tristate "Config Data example / unit test"
	default n
	---help---
		Enable the Config Data example

if EXAMPLES_CONFIGDATA

config EXAMPLES_CONFIGDATA_ARCHINIT
	bool "Architecture-specific initialization"
	default n
	---help---
		The default is to use the RAM MTD device at drivers/mtd/rammtd.c.
		But an architecture-specific MTD driver can be used instead by
		defining EXAMPLES_CONFIGDATA_ARCHINIT.  In this case, the
		initialization logic will call configdata_archinitialize() to obtain
		the MTD driver instance.

config EXAMPLES_CONFIGDATA_NEBLOCKS
	int "Number of erase blocks (simulated)"
	default 4
	depends on !EXAMPLES_CONFIGDATA_ARCHINIT
	---help---
		When EXAMPLES_CONFIGDATA_ARCHINIT is not defined, this test will use
		the RAM MTD device at drivers/mtd/rammtd.c to simulate FLASH.  In
		this case, this value must be provided to give the number of erase
		blocks in the MTD RAM device.

		The size of the allocated RAM drive will be:

			RAMMTD_ERASESIZE * EXAMPLES_CONFIGDATA_NEBLOCKS

config EXAMPLES_CONFIGDATA_NLOOPS
	int "Number of test loops"
	default 1000

config EXAMPLES_CONFIGDATA_VERBOSE
	bool "Verbose output"
	default n

config EXAMPLES_CONFIGDATA_SILENT
	bool "Silence the test details"
	default n

endif
```

## examples/cordic/Kconfig
```kconfig
#
# For a description of the syntax of this configuration file,
# see the file kconfig-language.txt in the NuttX tools repository.
#

config EXAMPLES_CORDIC
	tristate "CORDIC example"
	default n
	---help---
		Enable the CORDIC example

if EXAMPLES_CORDIC

config EXAMPLES_CORDIC_DEVPATH
	string "CORDIC Device Path"
	default "/dev/cordic0"
	---help---
		The device path

config EXAMPLES_CORDIC_PROGNAME
	string "Program name"
	default "cordic"
	---help---
		This is the name of the program that will be used when the NSH ELF
		program is installed.

config EXAMPLES_CORDIC_PRIORITY
	int "CORDIC task priority"
	default 100

config EXAMPLES_CORDIC_STACKSIZE
	int "CORDIC stack size"
	default DEFAULT_TASK_STACKSIZE

endif
```

## examples/cpuhog/Kconfig
```kconfig
#
# For a description of the syntax of this configuration file,
# see the file kconfig-language.txt in the NuttX tools repository.
#

config EXAMPLES_CPUHOG
	tristate "CPU hog"
	default n
	depends on PIPES
	---help---
		Enable the cpuhog example

if EXAMPLES_CPUHOG

config EXAMPLES_CPUHOG_STACKSIZE
	int "CPU hog stack size"
	default 2048

config EXAMPLES_CPUHOG_PRIORITY
	int "CPU hog task priority"
	default 50

endif
```
