## examples/nxterm/Kconfig
```kconfig
#
# For a description of the syntax of this configuration file,
# see the file kconfig-language.txt in the NuttX tools repository.
#

config EXAMPLES_NXTERM
	tristate "NxTerm example"
	default n
	depends on NXTERM
	select BOARDCTL
	---help---
		Enable the NxTerm example

if EXAMPLES_NXTERM

config EXAMPLES_NXTERM_PROGNAME
	string "Program name"
	default "nxterm"
	---help---
		This is the name of the program that will be used when the NSH ELF
		program is installed.

config EXAMPLES_NXTERM_PRIORITY
	int "NxTerm task priority"
	default 100

config EXAMPLES_NXTERM_STACKSIZE
	int "NxTerm stack size"
	default DEFAULT_TASK_STACKSIZE

config EXAMPLES_NXTERM_LISTENERPRIO
	int "Listener priority"
	default 100

config EXAMPLES_NXTERM_CLIENTPRIO
	int "Client priority"
	default 100

config EXAMPLES_NXTERM_SERVERPRIO
	int "Server priority"
	default 120

config EXAMPLES_NXTERM_BPP
	int "Pixel width"
	default 16
	range 1 32
	---help---
		The only valid selections are 1, 2, 4, 8, 16, and 32.  The
		corresponding NX disable selection (e.g., CONFIG_NX_DISABLE_16BPP),
		must not be set.

config EXAMPLES_NXTERM_BGCOLOR
	hex "Background color"
	default 0x2211

config EXAMPLES_NXTERM_WCOLOR
	hex "Window color"
	default 0xcf1f

config EXAMPLES_NXTERM_FULLSCREEN
	bool "Full-screen window"
	default n
	---help---
		Size the NXTerm window to cover the complete display instead of
		centering it at three quarters of the display size.

config EXAMPLES_NXTERM_PTYCONSOLE
	bool "PTY-backed keyboard console"
	default n
	depends on PSEUDOTERM && INPUT_KEYBOARD
	depends on !INPUT_KEYBOARD_BYTESTREAM
	depends on !NSH_ALTCONDEV && !NSH_USBKBD
	---help---
		Route NSH through a pseudo-terminal and bridge an event-mode keyboard
		to the terminal master.  This gives NXTerm a real TTY, translates
		NuttX keyboard special-key codes to VT100 input, and permits terminal
		generated signals such as Ctrl-C and Ctrl-Z.

config EXAMPLES_NXTERM_NSH_FALLBACK
	bool "Fall back to serial NSH"
	default n
	depends on NSH_CONSOLE
	---help---
		Run NSH on the original system console if NX or NXTerm initialization
		fails.  This is useful on framebuffer systems where display startup
		failures would otherwise leave no interactive console.

config EXAMPLES_NXTERM_STARTUP_TIMEOUT
	int "NX startup timeout"
	default 5
	range 1 60
	depends on EXAMPLES_NXTERM_NSH_FALLBACK
	---help---
		Number of seconds to wait for the NX server to accept the client
		connection before falling back to NSH on the system console.

config EXAMPLES_NXTERM_KBDDEV
	string "Keyboard device"
	default "/dev/kbda"
	depends on EXAMPLES_NXTERM_PTYCONSOLE
	---help---
		Path of the keyboard event device bridged to the pseudo-terminal.

config EXAMPLES_NXTERM_TOOLBAR_HEIGHT
	int "Toolbar height"
	default 16

config EXAMPLES_NXTERM_TBCOLOR
	hex "Toolbar color"
	default 0xbdf7

config EXAMPLES_NXTERM_FONTID
	int "Font ID"
	default 16

config EXAMPLES_NXTERM_FONTCOLOR
	hex "Font color"
	default 0x0000

endif
```

## examples/pmstress/Kconfig
```kconfig
#
# For a description of the syntax of this configuration file,
# see the file kconfig-language.txt in the NuttX tools repository.
#

config EXAMPLES_PMSTRESS
	tristate "Power management current staircase"
	default n
	depends on PM
	---help---
		Walk the power management states in a fixed, timed sequence, so
		that a logging supply can record the current of each state with
		nothing attached to the board.  The deepest state comes last and
		is held until the board is powered off.

		On the rp23xx, "pmstress suspend <seconds>" suspends to RAM until
		an RTC alarm (RP23XX_PM_SUSPEND, BOARDCTL_IOCTL, RTC_DRIVER and
		RTC_ALARM).

if EXAMPLES_PMSTRESS

config EXAMPLES_PMSTRESS_PROGNAME
	string "Program name"
	default "pmstress"

config EXAMPLES_PMSTRESS_PRIORITY
	int "Task priority"
	default 100

config EXAMPLES_PMSTRESS_STACKSIZE
	int "Stack size"
	default DEFAULT_TASK_STACKSIZE

config EXAMPLES_PMSTRESS_STEP_SECS
	int "Seconds to hold each state"
	default 30

config EXAMPLES_PMSTRESS_DISCONNECT_SECS
	int "Seconds to wait before starting"
	default 30
	---help---
		Time to unplug the debugger and the console before the run.  A
		debugger keeps power domains on.

config EXAMPLES_PMSTRESS_LEDPATH
	string "User LED device"
	default "/dev/userleds"
	depends on USERLED_LOWER
	---help---
		Device used to turn the LEDs off.

endif
```

## examples/sandbox/Kconfig
```kconfig
#
# For a description of the syntax of this configuration file,
# see the file kconfig-language.txt in the NuttX tools repository.
#

config EXAMPLES_SANDBOX
	tristate "Protected-build sandbox containment test"
	default n
	---help---
		A test that deliberately tries to escape the kernel/user boundary of
		a protected or kernel build, and checks that the attempt is contained:
		the offending process is terminated and everything else keeps running.

		Each target carries the outcome it expects, so the test fails a build
		that refuses everything as well as one that permits everything.  The
		"self" target is the control: it touches memory the process owns and
		must be allowed.

		A protected build derives the kernel target from CONFIG_NUTTX_USERSPACE.
		A kernel build has no such address, because every process is loaded
		into its own address environment, so the addresses below supply it.

if EXAMPLES_SANDBOX

config EXAMPLES_SANDBOX_PROGNAME
	string "Program name"
	default "sandbox"

config EXAMPLES_SANDBOX_PRIORITY
	int "sandbox task priority"
	default 100

config EXAMPLES_SANDBOX_STACKSIZE
	int "sandbox stack size"
	default DEFAULT_TASK_STACKSIZE

config EXAMPLES_SANDBOX_ALLOC
	int "Bytes the offender holds when it dies"
	default 65536
	---help---
		The offending process allocates this much, writes to all of it so the
		pages are really committed, and opens a file, before it makes the bad
		access.  It still holds both when it is killed.

		A process that dies owning nothing proves nothing about whether the
		kill leaks.  Compare "free" before and after a run: the kernel heap
		and the page pool both have to come back to where they started.

config EXAMPLES_SANDBOX_KERNEL_ADDR
	hex "Address of kernel memory"
	default 0x0
	---help---
		An address that is mapped and belongs to the kernel.  Reading it from
		a user process must fault.

		It has to be mapped.  An unmapped address tests the absence of a
		mapping instead of the permission on one, which is a different thing;
		use the unmapped target for that.

		Zero means the target is unavailable, and the test reports it as such.
		A protected build may leave this at zero, because CONFIG_NUTTX_USERSPACE
		gives the boundary.

config EXAMPLES_SANDBOX_PERIPH_ADDR
	hex "Address of a peripheral register"
	default 0x0
	---help---
		A peripheral register that a user process must not reach, such as the
		registers that control the memory mapping itself.

		An MMU keeps processes apart but does not stop one from reaching a
		peripheral, so this target exercises a different mechanism from the
		kernel target.  Zero means the target is unavailable.

config EXAMPLES_SANDBOX_UNMAPPED_ADDR
	hex "Address with no mapping"
	default 0x0
	---help---
		An address in no mapping at all.  Touching it must be reported.

		Hardware that answers an unmapped access quietly, with zero for a read
		and no fault, hides errors that a fault would show.  Zero means the
		target is unavailable.

endif
```

## examples/scl3300test/Kconfig
```kconfig
#
# For a description of the syntax of this configuration file,
# see the file kconfig-language.txt in the NuttX tools repository.
#

config EXAMPLES_SCL3300TEST
	tristate "SCL3300 inclinometer test program"
	default n
	depends on SENSORS_SCL3300
	---help---
		Enable the Murata SCL3300 test program. It checks WHOAMI and the
		self-test, prints the device info, measures the noise in every
		operation mode, cycles the power-down policy and resets the
		device, using the driver's uORB topics and ioctls.

if EXAMPLES_SCL3300TEST

config EXAMPLES_SCL3300TEST_PROGNAME
	string "Program name"
	default "scl3300test"
	---help---
		This is the name of the program that will be used when the NSH ELF
		program is installed.

config EXAMPLES_SCL3300TEST_PRIORITY
	int "scl3300test task priority"
	default 100

config EXAMPLES_SCL3300TEST_STACKSIZE
	int "scl3300test stack size"
	default 4096

endif
```

## examples/tinygl/Kconfig
```kconfig
#
# For a description of the syntax of this configuration file,
# see the file kconfig-language.txt in the NuttX tools repository.
#

config EXAMPLES_TINYGL
	tristate "TinyGL gears demo"
	default n
	depends on GRAPHICS_TINYGL && VIDEO_FB
	---help---
		Render the classic OpenGL "gears" demo with TinyGL on a framebuffer
		device.  The framebuffer must use the same pixel format as TinyGL
		(RGB32 or RGB565, see CONFIG_TINYGL_RENDER_BITS_*).

		Usage: tinygl [frames] [fbdev]

if EXAMPLES_TINYGL

config EXAMPLES_TINYGL_DEFAULTFB
	string "Default framebuffer driver"
	default "/dev/fb0"

config EXAMPLES_TINYGL_PROGNAME
	string "Program name"
	default "tinygl"
	---help---
		This is the name of the program that will be used when the NSH ELF
		program is installed.

config EXAMPLES_TINYGL_PRIORITY
	int "Task priority"
	default 100

config EXAMPLES_TINYGL_STACKSIZE
	int "Stack size"
	default 16384

endif
```

## examples/uGLy_demo/Kconfig
```kconfig
#
# For a description of the syntax of this configuration file,
# see the file kconfig-language.txt in the NuttX tools repository.
#

config EXAMPLES_UGLY_DEMO
	tristate "uGLy Graphic Demo"
	default n
	depends on GRAPHICS_UGLY
	---help---
		Enable the uGLy demo.  It renders a rotating textured quad to the
		framebuffer selected by GRAPHICS_UGLY_FBDEV.  Press 'q' or ESC to
		quit; 'w', 's', 'a', 'd', 'z', 'x' rotate it and '0' resets it.

if EXAMPLES_UGLY_DEMO

config EXAMPLES_UGLY_DEMO_PROGNAME
	string "Program name"
	default "uGLy"
	---help---
		This is the name of the program that will be used when the NSH ELF
		program is installed.

config EXAMPLES_UGLY_DEMO_PRIORITY
	int "Task priority"
	default 100

config EXAMPLES_UGLY_DEMO_STACKSIZE
	int "Stack size"
	default 8192
	---help---
		The uGLy rasterizer needs about 2KB of stack on its own.

endif
```
