## examples/calculator/Kconfig
```kconfig
#
# For a description of the syntax of this configuration file,
# see the file kconfig-language.txt in the NuttX tools repository.
#

menuconfig EXAMPLES_CALCULATOR
	tristate "Calculator"
	default n
	depends on GRAPHICS_LVGL && INPUT_TOUCHSCREEN
	select LV_FONT_MONTSERRAT_20
	---help---
		Enable the simple LVGL touchscreen calculator example.

if EXAMPLES_CALCULATOR

config EXAMPLES_CALCULATOR_PRIORITY
	int "calculator task priority"
	default 100

config EXAMPLES_CALCULATOR_STACKSIZE
	int "calculator stack size"
	default 16384

config EXAMPLES_CALCULATOR_INPUT_DEVPATH
	string "Touchscreen device path"
	default "/dev/input0"
	---help---
		The path to the touchscreen device. Default: "/dev/input0"

config EXAMPLES_CALCULATOR_FB_DEVPATH
	string "Framebuffer device path"
	default "/dev/fb0"
	---help---
		The path to the framebuffer device. Default: "/dev/fb0"

config EXAMPLES_CALCULATOR_YOFFSET
	int "Top screen offset"
	default 0
	---help---
		Rows to leave unused at the top of the display. Set this to the
		height of any supervisor bar shown above the calculator.

endif # EXAMPLES_CALCULATOR
```

## examples/comp/Kconfig
```kconfig
#
# For a description of the syntax of this configuration file,
# see the file kconfig-language.txt in the NuttX tools repository.
#

config EXAMPLES_COMP
	tristate "Comparator tool"
	default n
	depends on COMP
	---help---
		Enable support for the comparator tool.

if EXAMPLES_COMP

config EXAMPLES_COMP_PROGNAME
	string "Program name"
	default "comp"
	---help---
		This is the name of the program that will be used in the shell

config EXAMPLES_COMP_PRIORITY
	int "Comparator tool task priority"
	default 100

config EXAMPLES_COMP_STACKSIZE
	int "Comparator tool stack size"
	default DEFAULT_TASK_STACKSIZE

config EXAMPLES_COMP_DEVPATH
	string "Comparator device path"
	default "/dev/comp0"
	---help---
		The default path to the comparator device. Default: /dev/comp0

config EXAMPLES_COMP_DACPATH
	string "DAC device path for ramp test"
	default "/dev/dac5" if ARCH_CHIP_STM32G4
	default "/dev/dac0"
	depends on DAC
	---help---
		The default path to the DAC device for generating a voltage ramp.

endif
```

## examples/fdpicxip/Kconfig
```kconfig
#
# For a description of the syntax of this configuration file,
# see the file kconfig-language.txt in the NuttX tools repository.
#

config EXAMPLES_FDPICXIP
	tristate "FDPIC modules executed in place from xipfs demo"
	depends on FS_XIPFS && FDPIC && LIBC_EXECFUNCS
	default n
	---help---
		Write FDPIC modules into xipfs at run time, the way a download
		would, then run them.  Their text is executed directly out of
		flash and shared between concurrent instances, while each
		instance gets its own data.

		Subcommands:

		  qsort   one self-contained module, two instances
		  solib   a shared library across two instances
		  cxx     the same in C++, checking global constructors ran
		  jmprel  a module whose imports are all in DT_JMPREL

		With no subcommand, qsort runs.

		The modules are embedded in the image as C headers.  Their
		sources are in modules/, which rebuilds the headers on an
		explicit 'make regen': linking one needs arm-uclinuxfdpiceabi
		binutils, which this build does not.

		This demonstrates; it does not assert.  For the assertions see
		the fdpic and reject sections of CONFIG_TESTING_FS_XIPFS.

if EXAMPLES_FDPICXIP

config EXAMPLES_FDPICXIP_MOUNTPT
	string "xipfs mountpoint"
	default "/mnt/xipfs"

endif # EXAMPLES_FDPICXIP
```

## examples/hello/Kconfig
```kconfig
#
# For a description of the syntax of this configuration file,
# see the file kconfig-language.txt in the NuttX tools repository.
#

config EXAMPLES_HELLO
	tristate "\"Hello, World!\" example"
	default n
	---help---
		Enable the \"Hello, World!\" example

if EXAMPLES_HELLO

config EXAMPLES_HELLO_PROGNAME
	string "Program name"
	default "hello"
	---help---
		This is the name of the program that will be used when the NSH ELF
		program is installed.

config EXAMPLES_HELLO_PRIORITY
	int "Hello task priority"
	default 100

config EXAMPLES_HELLO_STACKSIZE
	int "Hello stack size"
	default DEFAULT_TASK_STACKSIZE

config EXAMPLES_HELLO_RESTRICTED
	bool "Install hello as owner-execute only (0744)"
	default n
	depends on SCHED_USER_IDENTITY
	---help---
		Set the installed mode to ``-rwxr--r--`` owned by root so a
		non-root user cannot exec ``/bin/hello``.  Used with
		``CONFIG_SYSTEM_SUDO`` to show ``sudo /bin/hello`` restoring
		access.

endif
```

## examples/hidcombo/Kconfig
```kconfig
#
# For a description of the syntax of this configuration file,
# see the file kconfig-language.txt in the NuttX tools repository.
#

config EXAMPLES_HIDCOMBO
	tristate "USB HID keyboard + mouse combo example"
	default n
	depends on USBHOST_HIDKBD && USBHOST_HIDMOUSE && !HIDMOUSE_TSCIF
	---help---
		Read a USB HID keyboard and a USB HID mouse at the same time from
		a single task using poll().  Useful to test keyboard + touchpad
		receivers, which expose both devices on the same USB device.

if EXAMPLES_HIDCOMBO

config EXAMPLES_HIDCOMBO_PROGNAME
	string "Program name"
	default "hidcombo"
	---help---
		This is the name of the program that will be used when the NSH ELF
		program is installed.

config EXAMPLES_HIDCOMBO_PRIORITY
	int "Task priority"
	default 100

config EXAMPLES_HIDCOMBO_STACKSIZE
	int "Task stack size"
	default DEFAULT_TASK_STACKSIZE

config EXAMPLES_HIDCOMBO_KBDDEV
	string "Keyboard device"
	default "/dev/kbda"

config EXAMPLES_HIDCOMBO_MOUSEDEV
	string "Mouse device"
	default "/dev/mouse0"

endif # EXAMPLES_HIDCOMBO
```

## examples/lvgldemo/Kconfig
```kconfig
#
# For a description of the syntax of this configuration file,
# see the file kconfig-language.txt in the NuttX tools repository.
#

menuconfig EXAMPLES_LVGLDEMO
	tristate "LVGL Demo"
	default n
	depends on GRAPHICS_LVGL
	---help---
		Enable build the Light and Versatile Graphics Library Demo programs

if EXAMPLES_LVGLDEMO

config EXAMPLES_LVGLDEMO_PRIORITY
	int "lvgldemo task priority"
	default 100

config EXAMPLES_LVGLDEMO_STACKSIZE
	int "lvgldemo stack size"
	default 16384

config EXAMPLES_LVGLDEMO_PORT_FBDEV
	bool "Enable Custom Safeguard Framebuffer Port (/dev/fb0)"
	default n
	depends on !LV_USE_NUTTX_LCD
	---help---
		Enables the Safeguard Architecture for /dev/fb0:
		1. Color probe test (endianness and channel order check)
		2. Smart flush callback with byte-order adaptation and forced alpha (0xFF)
		3. Partial draw buffering (40 rows) to prevent heap exhaustion.

config EXAMPLES_LVGLDEMO_COLOR_PROBE
	bool "Enable Color Probe test pixels on startup"
	default n
	depends on EXAMPLES_LVGLDEMO_PORT_FBDEV
	---help---
		Writes 3 test pixels (Red, Green, Blue) at (0,0)-(2,0) on startup
		for hardware color-order diagnostic.

config EXAMPLES_LVGLDEMO_FBDEV_PATH
	string "Framebuffer device path"
	default "/dev/fb0"
	depends on EXAMPLES_LVGLDEMO_PORT_FBDEV
	---help---
		The path to the framebuffer device. Default: "/dev/fb0"

config EXAMPLES_LVGLDEMO_INPUT_DEVPATH
	string "Touchscreen device path"
	default "/dev/input0"
	depends on INPUT_TOUCHSCREEN
	---help---
		The path to the touchscreen device. Default: "/dev/input0"

endif # EXAMPLES_LVGLDEMO
```

## examples/lvglterm/Kconfig
```kconfig
#
# For a description of the syntax of this configuration file,
# see the file kconfig-language.txt in the NuttX tools repository.
#

menuconfig EXAMPLES_LVGLTERM
	tristate "LVGL Terminal"
	default n
	depends on GRAPHICS_LVGL
	---help---
		Enable LVGL Terminal

if EXAMPLES_LVGLTERM

choice
	prompt "LVGL Terminal input source"
	default EXAMPLES_LVGLTERM_INPUT_TOUCH
	---help---
		Select how the terminal receives keystrokes.  Only one input source
		is built at a time.

config EXAMPLES_LVGLTERM_INPUT_TOUCH
	bool "On-screen keyboard (touch)"
	---help---
		Input comes from an on-screen LVGL keyboard operated by touch; a
		command line is typed and submitted with Enter.  This is the default
		and matches the original behaviour.

config EXAMPLES_LVGLTERM_INPUT_KBD
	bool "Physical keyboard"
	depends on INPUT_KEYBOARD
	---help---
		Any keyboard registered with keyboard_register():  USB HID, a matrix,
		the simulator, virtio.  The terminal does not need to know which one
		it is.  Cursor Up and Down scroll the terminal, everything else goes
		to the shell.

endchoice

config EXAMPLES_LVGLTERM_KBD_DEV
	string "Keyboard device path"
	default "/dev/kbd0"
	depends on EXAMPLES_LVGLTERM_INPUT_KBD
	---help---
		Keyboard device the terminal reads from.  Can also be overridden at
		run time by passing the path as the first command-line argument
		(useful when more than one keyboard is present).

		Note that the USB HID driver names its devices /dev/kbda onwards,
		since they come and go as keyboards are plugged in.

choice
	prompt "LVGL Terminal font"
	default EXAMPLES_LVGLTERM_FONT_UNSCII_16
	---help---
		Monospaced font used to render the terminal.  Use the smaller UNSCII 8
		on low-resolution displays where UNSCII 16 shows too few columns.

config EXAMPLES_LVGLTERM_FONT_UNSCII_8
	bool "UNSCII 8 (small)"
	select LV_FONT_UNSCII_8

config EXAMPLES_LVGLTERM_FONT_UNSCII_16
	bool "UNSCII 16"
	select LV_FONT_UNSCII_16

endchoice

config EXAMPLES_LVGLTERM_PRIORITY
	int "lvglterm task priority"
	default 100

config EXAMPLES_LVGLTERM_STACKSIZE
	int "lvglterm stack size"
	default 16384

endif # EXAMPLES_LVGLTERM
```

## examples/nanoxcalc/Kconfig
```kconfig
config EXAMPLES_NANOXCALC
	tristate "Nano-X calculator example"
	default n
	depends on MICROWINDOWS_NANOX && LIBC_FLOATINGPOINT
	---help---
		Enable the Nano-X calculator example application.  It is a
		port of the nxcalc demo from Microwindows which connects to
		the Nano-X server started by examples/nanoxterm and shows
		a calculator keypad operated by the mouse or keyboard.

if EXAMPLES_NANOXCALC

config EXAMPLES_NANOXCALC_PROGNAME
	string "Program name"
	default "nanoxcalc"
	---help---
		This is the name of the program that will be used when the NSH ELF
		program is installed.

config EXAMPLES_NANOXCALC_PRIORITY
	int "Nano-X calculator task priority"
	default 100

config EXAMPLES_NANOXCALC_STACKSIZE
	int "Nano-X calculator stack size"
	default 16384

endif
```

## examples/nanoxterm/Kconfig
```kconfig
config EXAMPLES_NANOXTERM
	tristate "Nano-X terminal emulator example"
	default n
	depends on MICROWINDOWS_NANOX && PSEUDOTERM && LIBC_EXECFUNCS
	---help---
		Enable the Nano-X terminal emulator example application.  It is
		a port of the nxterm demo from Microwindows.  It starts the
		Nano-X server, connects to it and creates a
		terminal window that runs an NSH shell instance on a pseudo
		terminal.

if EXAMPLES_NANOXTERM

config EXAMPLES_NANOXTERM_PROGNAME
	string "Program name"
	default "nanoxterm"
	---help---
		This is the name of the program that will be used when the NSH ELF
		program is installed.

config EXAMPLES_NANOXTERM_PRIORITY
	int "Nano-X terminal emulator task priority"
	default 100

config EXAMPLES_NANOXTERM_STACKSIZE
	int "Nano-X terminal emulator stack size"
	default 16384

endif
```

## examples/npzero/Kconfig
```kconfig
#
# For a description of the syntax of this configuration file,
# see the file kconfig-language.txt in the NuttX tools repository.
#

config EXAMPLES_NPZERO
	tristate "nPZero G1S power-saving IC example"
	default n
	depends on NPZERO
	---help---
		Example of the nPZero G1S driver for the nPZero G1S Development
		Kit.  At each wake-up of the host, it shows the wake-up reason
		and the values of the sensors, configures the nPZero to poll the
		LIS2DW12 accelerometer (SPI, peripheral 3) and the AS6212
		temperature sensor (I2C, peripheral 4) and enters Idle state,
		which switches the host off.

if EXAMPLES_NPZERO

config EXAMPLES_NPZERO_PROGNAME
	string "Program name"
	default "npzero"
	---help---
		This is the name of the program that will be used when the NSH ELF
		program is installed.

config EXAMPLES_NPZERO_PRIORITY
	int "nPZero task priority"
	default 100

config EXAMPLES_NPZERO_STACKSIZE
	int "nPZero stack size"
	default DEFAULT_TASK_STACKSIZE

config EXAMPLES_NPZERO_DEVPATH
	string "nPZero device path"
	default "/dev/npzero0"

config EXAMPLES_NPZERO_IDLE_DELAY
	int "Delay before Idle state (ms)"
	default 1000
	---help---
		Time to wait before sending the Idle command, which switches the
		host off.  It leaves time to connect a debugger to the host.

endif
```

## examples/nxflatxip/Kconfig
```kconfig
#
# For a description of the syntax of this configuration file,
# see the file kconfig-language.txt in the NuttX tools repository.
#

config EXAMPLES_NXFLATXIP
	tristate "NXFLAT execute-in-place from xipfs demo"
	depends on FS_XIPFS && NXFLAT && LIBC_EXECFUNCS
	default n
	---help---
		Write an NXFLAT module into xipfs at run time, the way a download
		would, then run two instances of it concurrently.  The module's
		text is executed directly out of flash and shared between the
		instances, while each instance gets its own data.

		Subcommands:

		  bench   XIP read throughput before and after a flash write
		  defrag  fragment the volume, compact it, with a block map

		Building the module needs the mknxflat and ldnxflat host tools
		from the NuttX toolchain, and the board's Make.defs must name
		them, exactly as apps/examples/nxflat requires.

if EXAMPLES_NXFLATXIP

config EXAMPLES_NXFLATXIP_MOUNTPT
	string "xipfs mountpoint"
	default "/mnt/xipfs"

config EXAMPLES_NXFLATXIP_MTD
	string "MTD device backing the volume"
	default "/dev/rpflash"
	---help---
		Used only by the defrag subcommand, which remounts the volume to
		show that what it did survives.

endif # EXAMPLES_NXFLATXIP
```
