## examples/fstest/Kconfig
```kconfig
#
# For a description of the syntax of this configuration file,
# see the file kconfig-language.txt in the NuttX tools repository.
#

config EXAMPLES_FSTEST
	tristate "Generic file system test"
	default n
	depends on FS_READABLE && FS_WRITABLE
	---help---
		Enable the generic file system test

if EXAMPLES_FSTEST

config EXAMPLES_FSTEST_PROGNAME
	string "Program name"
	default "fstest"
	depends on BUILD_LOADABLE
	---help---
		This is the name of the program that will be use when the NSH ELF
		program is installed.

config EXAMPLES_FSTEST_PRIORITY
	int "FS test task priority"
	default 100

config EXAMPLES_FSTEST_STACKSIZE
	int "FS test stack size"
	default 2048

config EXAMPLES_FSTEST_MAXNAME
	int "Max name size"
	default 32
	range 1 255
	---help---
		Determines the maximum size of names used in the filesystem

config EXAMPLES_FSTEST_MAXFILE
	int "Max file size"
	default 8192
	---help---
		Determines the maximum size of a file

config EXAMPLES_FSTEST_MAXIO
	int "Max I/O"
	default 347

config EXAMPLES_FSTEST_MAXOPEN
	int "Max open files"
	default 512

config EXAMPLES_FSTEST_MOUNTPT
	string "FSTEST mountpoint"

config EXAMPLES_FSTEST_NLOOPS
	int "Number of test loops"
	default 100

config EXAMPLES_FSTEST_SPIFFS
	bool "Enable SPIFFS testing"
	default y
	depends on FS_SPIFFS && EXPERIMENTAL
	---help---
		SPIFFS garbage collection and integrity checking will be performed
		after each pass through the test.

		If this option is not selected then the SPIFFS FLASH will be be
		reclaimed on-demand when there is no longer any available FLASH.

		Marked EXPERIMENTAL because it interferes with test performance.

config EXAMPLES_FSTEST_VERBOSE
	bool "Verbose output"
	default n

endif
```

## examples/ft80x/Kconfig
```kconfig
#
# For a description of the syntax of this configuration file,
# see the file kconfig-language.txt in the NuttX tools repository.
#

config EXAMPLES_FT80X
	tristate "FT80x example"
	default n
	depends on LCD_FT80X
	select GRAPHICS_FT80X
	---help---
		Enable the FT80X example

if EXAMPLES_FT80X

config EXAMPLES_FT80X_DEVPATH
	string "FT80x device path"
	default "/dev/ft800" if LCD_FT800
	default "/dev/ft801" if LCD_FT801

config EXAMPLES_FT80X_PRIMITIVES
	bool "Enable primitive examples"
	default n
	---help---
		Enable some low level tests of GPU primitives.  Not very interesting
		for the most part.

config EXAMPLES_FT80X_EXCLUDE_BITMAPS
	bool "Exclude bitmaps"
	default n
	---help---
		On some very minimal platforms, you might want to exclude bitmaps
		which will require 10's of kilobytes of memory (probably FLASH
		memory, depending on the CPU and the linker script.)

config EXAMPLES_FT80X_PROGNAME
	string "FT80x program name"
	default "ft80x"
	---help---
		This is the name of the program that will be used when the NSH ELF
		program is installed.

config EXAMPLES_FT80X_PRIORITY
	int "FT80x task priority"
	default 100

config EXAMPLES_FT80X_STACKSIZE
	int "FT80x stack size"
	default DEFAULT_TASK_STACKSIZE

endif
```

## examples/ftpc/Kconfig
```kconfig
#
# For a description of the syntax of this configuration file,
# see the file kconfig-language.txt in the NuttX tools repository.
#

config EXAMPLES_FTPC
	tristate "FTP client example"
	default n
	---help---
		Enable the FTP client example

if EXAMPLES_FTPC

config EXAMPLES_FTPC_STACKSIZE
	int "FTPC stack size"
	default 4096

endif
```

## examples/ftpd/Kconfig
```kconfig
#
# For a description of the syntax of this configuration file,
# see the file kconfig-language.txt in the NuttX tools repository.
#

config EXAMPLES_FTPD
	tristate "FTP server example"
	default n
	---help---
		Enable the FTP server example

if EXAMPLES_FTPD

config EXAMPLES_FTPD_STACKSIZE
	int "FTP Daemon Stack Size"
	default 2048

endif
```

## examples/fxos8700cq_test/Kconfig
```kconfig
#
# For a description of the syntax of this configuration file,
# see the file kconfig-language.txt in the NuttX tools repository.
#

config EXAMPLES_FXOS8700CQ
	bool "FXOS8700CQ motion sensor example"
	default n
	select SENSORS
	select SENSORS_FXOS8700CQ
	---help---
		Enable the motion sensor example

if EXAMPLES_FXOS8700CQ

config EXAMPLES_FXOS8700CQ_PROGNAME
	string "Program name"
	default "fxos8700cq"
	---help---
		This is the name of the program that will be use when the NSH ELF
		program is installed.

config EXAMPLES_FXOS8700CQ_PRIORITY
	int "fxos8700cq task priority"
	default 100

config EXAMPLES_FXOS8700CQ_STACKSIZE
	int "fxos8700cq stack size"
	default DEFAULT_TASK_STACKSIZE

endif
```
