## examples/fbcon/Kconfig
```kconfig
#
# For a description of the syntax of this configuration file,
# see the file kconfig-language.txt in the NuttX tools repository.
#

config EXAMPLES_FBCON
	tristate "Framebuffer console example"
	default n
	---help---
		Enable the Framebuffer console example.
		This example allows STDOUT and/or STDERR to be redirected and displayed
		on a framebuffer character device.

		A chosen builtin app can be spawned - such as "nsh" - to create a
		console and, if required, STDIN can be intercepted to allow input
		characters to be interpreted and pre-processed before passing them
		on to the spawned app.

		Relies on and uses NX and NXFONTS

if EXAMPLES_FBCON

comment "Console STDIN and/or STDOUT setup"

config EXAMPLES_FBCON_PIPE_STDOUT
	bool "Pipe stdout to this console"
	default y

config EXAMPLES_FBCON_PIPE_STDERR
	bool "Pipe stderr to this console"
	default y

config EXAMPLES_FBCON_PIPE_STDIN
	bool "Pipe stdin via this console"
	default y
	---help---
		This is usually needed if the spawned App is "nsh" as we need to
		intercept input characters in some cases

comment "Console Framebuffer setup"

config EXAMPLES_FBCON_DEF_FB
	string "Default framebuffer driver"
	default "/dev/fb0"
	---help---
		Default framebuffer drivers.  This selection can be overridden from
		the command line.

comment "BPP setup"

choice EXAMPLES_FBCON_BPP_SELECTION
	prompt "BPP Configuration"
	default EXAMPLES_FBCON_BPP_NX_DEFAULT

config EXAMPLES_FBCON_BPP_NX_DEFAULT
	bool "Use smallest BPP as enabled via NXFONTS setup"

config EXAMPLES_FBCON_CUSTOM_BPP
	bool "Choose custom BPP (must not be disabled in NX)"

endchoice # EXAMPLES_FBCON_BPP_SELECTION

choice EXAMPLES_FBCON_CUSTOM_BPP
	prompt "Custom Font pixel depth (BPP - Bits Per Pixel)"
	depends on EXAMPLES_FBCON_CUSTOM_BPP
	---help---
		Note: The required BPP must not be disabled via the NXFONT setup

config EXAMPLES_FBCON_1BPP
	bool "1 BPP"
	depends on !NX_DISABLE_1BPP

config EXAMPLES_FBCON_2BPP
	bool "2 BPP"
	depends on !NX_DISABLE_2BPP

config EXAMPLES_FBCON_4BPP
	bool "4 BPP"
	depends on !NX_DISABLE_4BPP

config EXAMPLES_FBCON_8BPP
	bool "8 BPP"
	depends on !NX_DISABLE_8BPP

config EXAMPLES_FBCON_16BPP
	bool "16 BPP"
	depends on !NX_DISABLE_16BPP

config EXAMPLES_FBCON_24BPP
	bool "24 BPP"
	depends on !NX_DISABLE_24BPP

config EXAMPLES_FBCON_32BPP
	bool "32 BPP"
	depends on !NX_DISABLE_32BPP

endchoice # EXAMPLES_FBCON_CUSTOM_BPP

comment "Console appearance"

config EXAMPLES_FBCON_SHOW_WELCOME
	bool "Display welcome messages on stdout and/or stdin"
	default y

config EXAMPLES_FBCON_DEFAULT_COLORS
	bool "Use Default Colors (white characters on black background)"
	default y

if !EXAMPLES_FBCON_DEFAULT_COLORS

config EXAMPLES_FBCON_BGCOLOR
	hex "Background color"
	default 0x0
	---help---
		The color of the background.  Default depends on config
		EXAMPLES_FBCON_BPP.

config EXAMPLES_FBCON_FCOLOR
	hex "Console font color"
	default 0x0
	---help---
		The color of the fonts used by the console.
endif # !EXAMPLES_FBCON_DEFAULT_COLORS

config EXAMPLES_FBCON_LINESPACING
	int "Line spacing"
	default 0
	range 0 4
	---help---
		The vertical distance between lines is the sum of (1) the vertical
		bounding box dimension of the font, and (2) this additional line
		space.  This value may be zero, but not negative.
	
config EXAMPLES_FBCON_NOWRAP
	bool "No wrap"
	default n
	---help---
		By default, lines will wrap when the test reaches the right hand side
		of the window. This setting can be defining to change this behavior so
		that the text is simply truncated until a new line is encountered.

choice EXAMPLES_FBCON_FONT
	prompt "Font Configuration"
	default EXAMPLES_FBCON_DEFAULT_FONT

config EXAMPLES_FBCON_DEFAULT_FONT
	bool "Use Default Font"

config EXAMPLES_FBCON_CUSTOM_FONTID
	bool "Use Custom Font ID"

config EXAMPLES_FBCON_FONTID
	int "Custom font ID"
	depends on EXAMPLES_FBCON_CUSTOM_FONTID 
	default 0
	---help---
		Selects the font used by the console (see font ID numbers
		in include/nuttx/nx/nxfonts.h)

endchoice # EXAMPLES_FBCON_FONT

config EXAMPLES_FBCON_CURSORCHAR
	int "Character code to use as the cursor"
	default 95
	---help---
		The bitmap code to use as the cursor.  Default '_' (95)

comment "FB Console App Escape code decoding"

config EXAMPLES_FBCON_VT100_DECODE
	bool "Decode VT100 Escape Codes"
	default y
	---help---
		Decode VT100 ESC codes - only minimal supporting functions

comment "FB Console spawn task configuration"

config EXAMPLES_FBCON_SPAWN_TASK
	string "Built-in application, or task, to spawn after console setup"
	default "nsh"
	---help---
		The required App must be enabled via Kconfig, of course. Its 
		priority and stack size will be determined by this example and passed
		on during the spawn of the chosen app.

comment "FB Console App stack and priority options and glyph cache size"

config EXAMPLES_FBCON_STACKSIZE
	int "Stack Size"
	default DEFAULT_TASK_STACKSIZE
	---help---
		The stacksize to use when starting the example.

config EXAMPLES_FBCON_PRIORITY
	int "Task Priority"
	default 100
	---help---
		The priority of the example.

config EXAMPLES_FBCON_GLCACHE
	int "Glyph cache size"
	default 94
	---help---
		Size of the glyph cache. Default allows all usual ASCII characters to be cached

endif # EXAMPLES_FBCON
```

## examples/fboverlay/Kconfig
```kconfig
#
# For a description of the syntax of this configuration file,
# see the file kconfig-language.txt in the NuttX tools repository.
#

config EXAMPLES_FBOVERLAY
	tristate "Framebuffer overlay test tool"
	depends on FB_OVERLAY
	default n
	---help---
		Enable framebuffer overlay test.

if EXAMPLES_FBOVERLAY

config EXAMPLES_FBOVERLAY_PROGNAME
	string "Program name"
	default "fboverlay"
	depends on BUILD_LOADABLE
	---help---
		This is the name of the program that will be use when the NSH ELF
		program is installed.

config EXAMPLES_FBOVERLAY_PRIORITY
	int "Task priority"
	default 100

config EXAMPLES_FBOVERLAY_STACKSIZE
	int "Stack size"
	default 2048

endif
```

## examples/flash_test/Kconfig
```kconfig
#
# For a description of the syntax of this configuration file,
# see the file kconfig-language.txt in the NuttX tools repository.
#

config EXAMPLES_FLASH_TEST
	tristate "SMART FLASH block device test"
	default n
	depends on BUILD_FLAT && MTD_SMART
	---help---
		This logic performs a SMART flash block device test.  This test
		performs a sector allocate, read, write, free and garbage collection
		test on a SMART MTD block device.

		NOTE:  This test uses internal OS interfaces and so is not available
		in the NUTTX kernel build

if EXAMPLES_FLASH_TEST
endif
```

## examples/flowc/Kconfig
```kconfig
#
# For a description of the syntax of this configuration file,
# see the file kconfig-language.txt in the NuttX tools repository.
#

config EXAMPLES_FLOWC
	bool "Serial flow control example"
	default n
	depends on SERIAL_TERMIOS
	---help---
		Enable the serial hardware flow control test.

		Serial termios support must be enabled.

			CONFIG_SERIAL_TERMIOS=y

		In addtion, you will need these related serial driver settings (the
		actual values of the watermark setting may be tuned to suit your
		preferences)

			CONFIG_SERIAL_IFLOWCONTROL=y
			CONFIG_SERIAL_IFLOWCONTROL_WATERMARKS=y
			CONFIG_SERIAL_IFLOWCONTROL_LOWER_WATERMARK=25
			CONFIG_SERIAL_IFLOWCONTROL_UPPER_WATERMARK=75

		And for the CDC/ACM driver in particular:

			CONFIG_CDCACM_IFLOWCONTROL=y

		There are hooks in place for output flow control but these have not
		been exercised.

if EXAMPLES_FLOWC

config EXAMPLES_FLOWC_INPUT
	bool "Verify input flow control"
	default y
#	depends on SERIAL_IFLOWCONTROL

config EXAMPLES_FLOWC_OUTPUT
	bool "Verify output flow control"
	default y
#	depends on SERIAL_OFLOWCONTROL

config EXAMPLES_FLOWC_SENDER1
	bool "Target1 is the sender"
	default n
	---help---
		By default Target1 is the receiver and the host PC (or Target2) is
		the sender.  That is the configuration you would to test RX flow
		control on the target.

config EXAMPLES_FLOWC_PROGNAME1
	string "Target1 program name"
	default "receiver" if !EXAMPLES_FLOWC_SENDER1
	default "sender" if EXAMPLES_FLOWC_SENDER1
	depends on BUILD_LOADABLE
	---help---
		This is the name of the Target1 program that will be use when the
		NSH ELF program is installed.

config EXAMPLES_FLOWC_PRIORITY1
	int "Target1 task priority"
	default 100

config EXAMPLES_FLOWC_STACKSIZE1
	int "Target1 stack size"
	default 2048

config EXAMPLES_FLOWC_TARGET2
	bool "Second endpoint is a target"
	default n
	---help---
		By default, the host PC is configured as the second endpoint of the
		FLOWC test.  If this option is selected, then the second endpoint
		will be built into the FLASH image as well.  This means that you
		can use two target boards to run the test with no host PC
		involvement.

if EXAMPLES_FLOWC_TARGET2

config EXAMPLES_FLOWC_PROGNAME2
	string "Target2 program name"
	default "receiver" if !EXAMPLES_FLOWC_RECEIVER2
	default "sender" if EXAMPLES_FLOWC_RECEIVER2
	depends on BUILD_LOADABLE
	---help---
		This is the name of the Target2 program that will be use when the
		NSH ELF program is installed.

config EXAMPLES_FLOWC_PRIORITY2
	int "Target2 task priority"
	default 100

config EXAMPLES_FLOWC_STACKSIZE2
	int "Target2 stack size"
	default 2048

endif # EXAMPLES_FLOWC_TARGET2

config EXAMPLES_FLOWC_RECEIVER_BUFSIZE
	int "Receiver buffer size"
	default 64

config EXAMPLES_FLOWC_RECEIVER_DELAY
	int "Receiver read delay (msec)"
	default 100

config EXAMPLES_FLOWC_RECEVER_DEVNAME
	string "Default TTY device for receiver"
	default "/dev/ttyACM0"

config EXAMPLES_FLOWC_SENDER_DEVNAME
	string "Default TTY device for sender"
	default "/dev/ttyACM0"

endif # EXAMPLES_FLOWC
```

## examples/fmsynth/Kconfig
```kconfig
#
# For a description of the syntax of this configuration file,
# see the file kconfig-language.txt in the NuttX tools repository.
#

config EXAMPLES_FMSYNTH
	tristate "FM Synthesizer examples"
	default n
	---help---
		Examples for fmsynth library.

if EXAMPLES_FMSYNTH

config EXAMPLES_FMSYNTH_KEYBOARD_PROGNAME
	string "Simple music keyboard Program name"
	default "keyboard"
	---help---
		Command name of this "Simple music keyboard".

config EXAMPLES_FMSYNTH_KEYBOARD_PRIORITY
	int "Simple music keyboard task priority"
	default 100

config EXAMPLES_FMSYNTH_KEYBOARD_STACKSIZE
	int "Simple music keyboard stack size"
	default 2048

config EXAMPLES_FMSYNTH_MMLPLAYER_PROGNAME
	string "MML Player Program name"
	default "mmlplayer"
	---help---
		Command name of this "MML Player".

config EXAMPLES_FMSYNTH_MMLPLAYER_PRIORITY
	int "MML Player task priority"
	default 100

config EXAMPLES_FMSYNTH_MMLPLAYER_STACKSIZE
	int "MML Player stack size"
	default 2048

endif
```
