## examples/cromfs/Kconfig
```kconfig
#
# For a description of the syntax of this configuration file,
# see the file kconfig-language.txt in the NuttX tools repository.
#

config EXAMPLES_CROMFS
	bool "CROMFS Example"
	default n
	depends on FS_CROMFS && BUILD_FLAT
	---help---
		Enable the CROMFS loader example

		NOTE:  This example simple creates a CROMFS image.  There is no
		program to be executed.  If properly constructed, it should provide
		the in-memory, compressed file system image used by the CROMFS file
		system.

		From the NSH command line, this file system can be mounted like:

		  nsh> mount -t cromfs /mnt/cromfs

		NOTE:  Since this example does export symbols used with the OS, it
		can only be used in the FLAT build mode.
```

## examples/cxxtest/Kconfig
```kconfig
#
# For a description of the syntax of this configuration file,
# see the file kconfig-language.txt in the NuttX tools repository.
#

config EXAMPLES_CXXTEST
	tristate "C++ test program"
	default n
	depends on HAVE_CXX
	---help---
		Enable the C++ test program

if EXAMPLES_CXXTEST

config EXAMPLES_CXXTEST_CXXINITIALIZE
	bool "C++ Initialization"
	default y
	depends on HAVE_CXX && HAVE_CXXINITIALIZE
	---help---
		By default, if CONFIG_HAVE_CXX and CONFIG_HAVE_CXXINITIALIZE are
		defined, then this example will call the NuttX function to
		initialize static C++ constructors.  This option may be disabled,
		however, if that static initialization was performed elsewhere.

endif
```

## examples/dac/Kconfig
```kconfig
config EXAMPLES_DAC
	tristate "DAC tool"
	default n
	depends on DAC
	---help---
		Enable support for the DAC tool.

if EXAMPLES_DAC

config EXAMPLES_DAC_DEVPATH
	string "DAC device path"
	default "/dev/dac0"
	---help---
		The default path to the DAC device. Default: /dev/dac0
endif
```

## examples/dhcpd/Kconfig
```kconfig
#
# For a description of the syntax of this configuration file,
# see the file kconfig-language.txt in the NuttX tools repository.
#

config EXAMPLES_DHCPD
	tristate "DHCP server example"
	default n
	---help---
		Enable the DHCP server example

if EXAMPLES_DHCPD

config EXAMPLES_DHCPD_NOMAC
	bool "Use Canned MAC Address"
	default n

endif
```

## examples/dhtxx/Kconfig
```kconfig
#
# For a description of the syntax of this configuration file,
# see the file kconfig-language.txt in the NuttX tools repository.
#

config EXAMPLES_DHTXX
	tristate "Dhtxx sensor example"
	default n
	---help---
		Enable the dhtxx sensor example

if EXAMPLES_DHTXX

config EXAMPLES_DHTXX_PROGNAME
	string "Program name"
	default "dhtxx"
	---help---
		This is the name of the program that will be used when the NSH ELF
		program is installed.

config EXAMPLES_DHTXX_DEVPATH
	string "Device path"
	default "/dev/hum0"
	---help---
		The device path

config EXAMPLES_DHTXX_PRIORITY
	int "Dhtxx task priority"
	default 100

config EXAMPLES_DHTXX_STACKSIZE
	int "Dhtxx stack size"
	default DEFAULT_TASK_STACKSIZE

endif
```

## examples/discover/Kconfig
```kconfig
#
# For a description of the syntax of this configuration file,
# see the file kconfig-language.txt in the NuttX tools repository.
#

config EXAMPLES_DISCOVER
	tristate "UDP Discovery Example"
	default n
	depends on NET_UDP
	select NETUTILS_DISCOVER
	---help---
		Enable the netutils/discover utility.  This example initializes and
		starts the UDP discover daemon. This daemon is useful for
		discovering devices in local networks, especially with DHCP
		configured devices.  It listens for UDP broadcasts which also can
		include a device class so that groups of devices can be discovered.
		It is also possible to address all classes with a kind of broadcast
		discover.

config EXAMPLES_DISCOVER_DHCPC
	bool "DHCP Client"
	default n
	depends on EXAMPLES_DISCOVER && !NSH_BUILTIN_APPS
	select NETUTILS_DHCPC
	select NETDB_DNSCLIENT

config EXAMPLES_DISCOVER_NOMAC
	bool "Use Canned MAC Address"
	default n
	depends on EXAMPLES_DISCOVER && !NSH_BUILTIN_APPS

config EXAMPLES_DISCOVER_IPADDR
	hex "Target IP address"
	default 0x0a000002
	depends on EXAMPLES_DISCOVER && !NSH_BUILTIN_APPS && !EXAMPLES_DISCOVER_DHCPC

config EXAMPLES_DISCOVER_DRIPADDR
	hex "Default Router IP address (Gateway)"
	default 0x0a000001
	depends on EXAMPLES_DISCOVER && !NSH_BUILTIN_APPS

config EXAMPLES_DISCOVER_NETMASK
	hex "Network Mask"
	default 0xffffff00
	depends on EXAMPLES_DISCOVER && !NSH_BUILTIN_APPS
```

## examples/djoystick/Kconfig
```kconfig
#
# For a description of the syntax of this configuration file,
# see the file kconfig-language.txt in the NuttX tools repository.
#

config EXAMPLES_DJOYSTICK
	tristate "Discrete joystick example"
	default n
	depends on DJOYSTICK && !DISABLE_SIGNALS
	---help---
		Enable the discrete joystick example

if EXAMPLES_DJOYSTICK

config EXAMPLES_DJOYSTICK_DEVNAME
	string "Joystick device name"
	default "/dev/djoy0"

config EXAMPLES_DJOYSTICK_SIGNO
	int "Joystick signal"
	default 13

endif
```

## examples/dsptest/Kconfig
```kconfig
#
# For a description of the syntax of this configuration file,
# see the file kconfig-language.txt in the NuttX tools repository.
#

config EXAMPLES_DSPTEST
	tristate "LIBDSP library testing"
	default n
	---help---
		Enable the LIBDSP library testing

if EXAMPLES_DSPTEST

config EXAMPLES_DSPTEST_PROGNAME
	string "Program name"
	default "dsptest"
	---help---
		This is the name of the program that will be used when the NSH ELF
		program is installed.

config EXAMPLES_DSPTEST_PRIORITY
	int "Dsptest task priority"
	default 100

config EXAMPLES_DSPTEST_STACKSIZE
	int "Dsptest stack size"
	default DEFAULT_TASK_STACKSIZE

endif
```

## examples/elf/Kconfig
```kconfig
#
# For a description of the syntax of this configuration file,
# see the file kconfig-language.txt in the NuttX tools repository.
#

config EXAMPLES_ELF
	tristate "ELF Loader Example"
	default n
	select LIBC_EXECFUNCS
	depends on ELF
	---help---
		Enable the ELF loader example

if EXAMPLES_ELF

choice
	prompt "ELF File System"
	default EXAMPLES_ELF_ROMFS  if   FS_ROMFS && BUILD_FLAT
	default EXAMPLES_ELF_CROMFS if  !FS_ROMFS && FS_CROMFS && BUILD_FLAT
	default EXAMPLES_ELF_EXTERN if (!FS_ROMFS && !FS_CROMFS) || !BUILD_FLAT

config EXAMPLES_ELF_ROMFS
	bool "ROMFS"
	depends on FS_ROMFS && BUILD_FLAT
	---help---
		Automatically generates and mounts an internal ROMFS file
		system

config EXAMPLES_ELF_CROMFS
	bool "CROMFS"
	depends on FS_CROMFS && BUILD_FLAT
	---help---
		Automatically generates and mounts an internal CROMFS file
		system

config EXAMPLES_ELF_EXTERN
	bool "External File system"
	---help---
		The file system is assumed to reside on some external media
		such as an SD card or a USB FLASH drive.  In this case, that
		external file system must be created manually by copying the
		files in apps/examples/elf/tests/romfs to the volume.

		The external volume can optionally be mounted by the test if
		the CONFIG_EXAMPLES_FSMOUNT option is also selected.

endchoice # ROM File System

config EXAMPLES_ELF_FSMOUNT
	bool "Mount external file system"
	default y
	depends on EXAMPLES_ELF_EXTERN
	---help---
		Automatically mount the external file system using the block
		device provided by CONFIG_EXAMPLES_ELF_DEVPATH and the file
		system type specified by CONFIG_EXAMPLES_ELF_FSTYPE.

config EXAMPLES_ELF_FSREMOVEABLE
	bool "Removable file system"
	default n
	depends on EXAMPLES_ELF_FSMOUNT
	---help---
		If the external file system is on removable media such as an
		SD card or a USB FLASH driver, then this option may be selected
		to build in logic to wait for the media to be installed and
		initialized before trying to mount it.

config EXAMPLES_ELF_DEVMINOR
	int "ROMFS Minor Device Number"
	default 0
	depends on EXAMPLES_ELF_ROMFS
	---help---
		The minor device number of the ROMFS block. For example, the N in
		/dev/ramN.  Used for registering the RAM block driver that will hold
		the ROMFS file system containing the ELF executables to be tested.
		Default: 0

config EXAMPLES_ELF_FSTYPE
	string "External file system type"
	default "vfat"
	depends on EXAMPLES_ELF_FSMOUNT
	---help---
		The type of the external file system as will be used in the mount()
		command.  Default: "vfat"

config EXAMPLES_ELF_DEVPATH
	string "Block driver device path"
	default "/dev/ram0" if EXAMPLES_ELF_ROMFS
	default "/dev/mmcsd0" if EXAMPLES_ELF_FSMOUNT
	depends on EXAMPLES_ELF_ROMFS || EXAMPLES_ELF_FSMOUNT
	---help---
		The path to the ROMFS/External block driver device.  This must match
		EXAMPLES_ELF_DEVMINOR for the case of ROMFS.  Used for mounting the
		file system containing the ELF executables to be tested.  Default:
		"/dev/ram0" for ROMFS, "/dev/mmcsd0" for the external file system.

config EXAMPLES_ELF_SYSCALL
	bool "Link with SYSCALL library"
	default n
	depends on LIB_SYSCALL
	---help---
		Link with the SYSCALL library.  By default, all undefined symbols
		must be provided via a symbol table.  But if this option is
		selected, then each ELF test program will link with the SYSCALL
		library and will interface with the OS system calls.  In this case,
		those symbols will not be undefined.  If the SYSCALL library is
		available then you probably will want to select this option.

config EXAMPLES_ELF_LIBC
	bool "Link with LIBC"
	default n
	---help---
		Link with the C library (and also math library if it was built).
		By default, all undefined symbols must be provided via a symbol
		table.  But if this option is selected, then each ELF test program
		will link with the C library and will not require symbol table
		entries.  You probably will NOT want this option, however,
		because it will substantially increase the size of code.  For
		example, a separate copy of printf() would be linked with every
		program greatly increasing the total code size.  This option is
		primarily intended only for testing.

config EXAMPLES_ELF_CXX
	bool "uClibc++/libcxx is installed"
	default n
	depends on UCLIBCXX || LIBCXX
	---help---
		By default, uClibc++/libcxx is not installed and configured. If the
		user installs and configures the C++ standard library, this
		example will compile the demos using it.

endif
```

## examples/embedlog/Kconfig
```kconfig
#
# For a description of the syntax of this configuration file,
# see the file kconfig-language.txt in the NuttX tools repository.
#

if LOGGING_EMBEDLOG

config EXAMPLES_EMBEDLOG
	tristate "embedlog example"
	default n
	select EMBEDLOG_ENABLE_OUT_FILE
	select EMBEDLOG_ENABLE_OUT_STDERR
	select EMBEDLOG_ENABLE_OUT_TTY
	select EMBEDLOG_ENABLE_OUT_CUSTOM
	select EMBEDLOG_ENABLE_BINARY_LOGS
	select EMBEDLOG_ENABLE_TIMESTAMP
	select EMBEDLOG_ENABLE_FRACTIONS
	select EMBEDLOG_ENABLE_PREFIX
	select EMBEDLOG_ENABLE_FINFO
	select EMBEDLOG_ENABLE_COLORS
	---help---
		Enable the "embedlog" example.

if EXAMPLES_EMBEDLOG

config EXAMPLES_EMBEDLOG_STRIP_ALL_STRINGS
	bool "Disable embedlog (strip)"
	default n
	---help---
		Enabled embedlog so you can disable it... sounds about right.

		Enable this to replace all embedlog function calls with stub
		functions that always return OK. This will effectively strip
		final binary from all log strings making code considerably
		smaller.

		This may be useful in two cases (at least):

		1) You develop your app on bigger version of target MCU, on
		which you have a lot of memory. So on that version of the
		build you can afford to enable good diagnostic logs. But
		final image may be run on smaller version, on which logs
		would not fit. In that case you can strip binary in final
		production image. Thanks to that you will get logs in dev
		env, but still maintain small footprint on production build.

		2) You want to hide implementation details that could be
		leaked with debug logs from final image.

		It only makes sense to enable this on production type builds.
		Linker will optimize out embedlog and remove all unused
		functions, just as if embedlog was never built.

		Enabling this will render embedlog example useless - it
		will not print anything, but example will stil compile
		and final image will be about 15kB smaller. But YMMV
		depending how much strings you have in project.

config EXAMPLES_EMBEDLOG_PROGNAME
	string "Program name"
	default "embedlog"
	---help---
		This is the name of the program that will be used when the NSH ELF
		program is installed.

config EXAMPLES_EMBEDLOG_PRIORITY
	int "embedlog example task priority"
	default 100

config EXAMPLES_EMBEDLOG_STACKSIZE
	int "embedlog example stack size"
	default DEFAULT_TASK_STACKSIZE

endif #EXAMPLES_EMBEDLOG
endif #LOGGING_EMBEDLOG
```

## examples/esp32_efuse/Kconfig
```kconfig
#
# For a description of the syntax of this configuration file,
# see the file kconfig-language.txt in the NuttX tools repository.
#

config EXAMPLES_ESP32_EFUSE
	tristate "ESP32 EFUSE Example"
	default n
	---help---
		ESP32 EFUSE Example

if EXAMPLES_ESP32_EFUSE

config EXAMPLES_ESP32_EFUSE_PROGNAME
	string "Program name"
	default "esp32efuse"
	---help---
		This is the name of the program that will be used when the NSH ELF
		program is installed.

config EXAMPLES_ESP32_EFUSE_PRIORITY
	int "ESP32 EFUSE task priority"
	default 100

config EXAMPLES_ESP32_EFUSE_STACKSIZE
	int "ESP32 EFUSE stack size"
	default DEFAULT_TASK_STACKSIZE

endif
```

## examples/esp32_himem/Kconfig
```kconfig
#
# For a description of the syntax of this configuration file,
# see the file kconfig-language.txt in the NuttX tools repository.
#

config EXAMPLES_ESP32_HIMEM
	tristate "ESP32 HIMEM Example"
	default n
	---help---
		ESP32 HIMEM Example

if EXAMPLES_ESP32_HIMEM

config EXAMPLES_ESP32_HIMEM_PROGNAME
	string "Program name"
	default "esp32himem"
	---help---
		This is the name of the program that will be used when the NSH ELF
		program is installed.

config EXAMPLES_ESP32_HIMEM_PRIORITY
	int "ESP32 HIMEM task priority"
	default 100

config EXAMPLES_ESP32_HIMEM_STACKSIZE
	int "ESP32 HIMEM stack size"
	default DEFAULT_TASK_STACKSIZE

endif
```

## examples/etl/Kconfig
```kconfig
#
# For a description of the syntax of this configuration file,
# see the file kconfig-language.txt in the NuttX tools repository.
#

config EXAMPLES_ETL
	tristate "Embedded Template Library (ETL) C++ example"
	default n
	depends on HAVE_CXX && ETL
	---help---
		Enable the ETL C++ example which showcases the etl::vector container
		and C++11 iterator
```

## examples/fb/Kconfig
```kconfig
#
# For a description of the syntax of this configuration file,
# see the file kconfig-language.txt in the NuttX tools repository.
#

config EXAMPLES_FB
	tristate "Framebuffer driver example"
	default n
	select LCD_PACKEDMSFIRST if LCD
	depends on VIDEO_FB
	---help---
		Enable the Framebuffer driver example.

		This example currently supports only framebuffer devices with 1, 8,
		16, or 24/32 pixel depth with only Mono, RGB323, RGB565, and RGB888
		color formats, respectively.  The example would have be extended to
		support other bits-per-pixels or other color formats.

if EXAMPLES_FB

config EXAMPLES_FB_DEFAULTFB
	string "Default framebuffer driver"
	default "/dev/fb0"
	---help---
		Default framebuffer drivers.  This selection can be overridden from
		the command line.

config EXAMPLES_FB_PROGNAME
	string "Program name"
	default "fb"
	---help---
		This is the name of the program that will be used when the NSH ELF
		program is installed.

config EXAMPLES_FB_PRIORITY
	int "Task priority"
	default 100

config EXAMPLES_FB_STACKSIZE
	int "Stack size"
	default DEFAULT_TASK_STACKSIZE

endif
```
