## examples/gpio/Kconfig
```kconfig
#
# For a description of the syntax of this configuration file,
# see the file kconfig-language.txt in the NuttX tools repository.
#

config EXAMPLES_GPIO
	tristate "GPIO driver example"
	default n
	depends on DEV_GPIO
	---help---
		Enable the GPIO driver example

if EXAMPLES_GPIO

config EXAMPLES_GPIO_PROGNAME
	string "Program name"
	default "gpio"
	---help---
		This is the name of the program that will be used when the NSH ELF
		program is installed.

config EXAMPLES_GPIO_PRIORITY
	int "GPIO task priority"
	default 100

config EXAMPLES_GPIO_STACKSIZE
	int "GPIO stack size"
	default DEFAULT_TASK_STACKSIZE

endif
```

## examples/gps/Kconfig
```kconfig
#
# For a description of the syntax of this configuration file,
# see the file kconfig-language.txt in the NuttX tools repository.
#

config EXAMPLES_GPS
	tristate "GPS example"
	default n
	select GPSUTILS_MINMEA_LIB
	---help---
		Enable the gps test example

if EXAMPLES_GPS

config EXAMPLES_GPS_PROGNAME
	string "Program name"
	default "gps"
	---help---
		This is the name of the program that will be used when the NSH ELF
		program is installed.

config EXAMPLES_GPS_PRIORITY
	int "GPS task priority"
	default 100

config EXAMPLES_GPS_STACKSIZE
	int "GPS stack size"
	default DEFAULT_TASK_STACKSIZE

endif
```

## examples/hall/Kconfig
```kconfig
#
# For a description of the syntax of this configuration file,
# see the file kconfig-language.txt in the NuttX tools repository.
#

config EXAMPLES_HALL
	tristate "Hall effect sensor example"
	default n
	depends on SENSORS_HALL3PHASE
	---help---
		Enable the Hall effect sensor example

if EXAMPLES_HALL

config EXAMPLES_HALL_DEVPATH
	string "Hall effect sensor device path"
	default "/dev/hall0"
	---help---
		The default path to the Hall effect sensor device

config EXAMPLES_HALL_NSAMPLES
	int "Number of samples"
	default 0
	---help---
		This number of samples is collected and the program
		terminates. If the value is 0, samples are collected indefinitely.

config EXAMPLES_HALL_DELAY
	int "Delay between samples"
	default 100
	---help---
		This value provides the delay (in milliseconds) between each sample.
		If CONFIG_NSH_BUILTIN_APPS is defined, then this value is the default
		delay if no other delay is provided on the command line.

choice
	prompt "Hall effect sensor type"
	default EXAMPLES_HALL_SENSOR_120DEG

config EXAMPLES_HALL_SENSOR_120DEG
	bool "120 deg Hall effect sensor"

config EXAMPLES_HALL_SENSOR_60DEG
	bool "60 deg Hall effect sensor"

endchoice # Hall effect sensor type

endif
```

## examples/hdc1008_demo/Kconfig
```kconfig
#
# For a description of the syntax of this configuration file,
# see the file kconfig-language.txt in the NuttX tools repository.
#

config EXAMPLES_HDC1008
	tristate "HDC1008 driver example"
	default n
	---help---
		Enable the example application
```

## examples/hello_d/Kconfig
```kconfig
#
# For a description of the syntax of this configuration file,
# see the file kconfig-language.txt in the NuttX tools repository.
#

config EXAMPLES_HELLO_D
	tristate "\"Hello, D!\" D example"
	default n
	---help---
		Enable the \"Hello, D!\" D example

if EXAMPLES_HELLO_D

config EXAMPLES_HELLO_D_PROGNAME
	string "Program name"
	default "hello_d"
	---help---
		This is the name of the program that will be used when the
		program is installed.

config EXAMPLES_HELLO_D_PRIORITY
	int "Hello D task priority"
	default 100

config EXAMPLES_HELLO_D_STACKSIZE
	int "Hello D stack size"
	default DEFAULT_TASK_STACKSIZE

endif
```

## examples/hello_nim/Kconfig
```kconfig
#
# For a description of the syntax of this configuration file,
# see the file kconfig-language.txt in the NuttX tools repository.
#

config EXAMPLES_HELLO_NIM
	tristate "\"Hello, World!\" example (Nim)"
	default n
	---help---
		Enable the \"Hello, World!\" example

if EXAMPLES_HELLO_NIM

config EXAMPLES_HELLO_NIM_PROGNAME
	string "Program name"
	default "hello_nim"
	---help---
		This is the name of the program that will be used when the NSH ELF
		program is installed.

config EXAMPLES_HELLO_NIM_PRIORITY
	int "Hello task priority"
	default 100

config EXAMPLES_HELLO_NIM_STACKSIZE
	int "Hello stack size"
	default DEFAULT_TASK_STACKSIZE

endif
```

## examples/hello_rust/Kconfig
```kconfig
#
# For a description of the syntax of this configuration file,
# see the file kconfig-language.txt in the NuttX tools repository.
#

config EXAMPLES_HELLO_RUST
	tristate "\"Hello, Rust!\" example"
	default n
	---help---
		Enable the \"Hello, Rust!\" example

if EXAMPLES_HELLO_RUST

config EXAMPLES_HELLO_RUST_PROGNAME
	string "Program name"
	default "hello_rust"
	---help---
		This is the name of the program that will be used when the
		program is installed.

config EXAMPLES_HELLO_RUST_PRIORITY
	int "Hello Rust task priority"
	default 100

config EXAMPLES_HELLO_RUST_STACKSIZE
	int "Hello Rust stack size"
	default DEFAULT_TASK_STACKSIZE

endif
```

## examples/hello_rust_cargo/Kconfig
```kconfig
#
# For a description of the syntax of this configuration file,
# see the file kconfig-language.txt in the NuttX tools repository.
#

config EXAMPLES_HELLO_RUST_CARGO
	tristate "\"Hello, Rust!\" example with Cargo"
	default n
	---help---
		Enable the \"Hello, Rust!\" example using Cargo to build.

if EXAMPLES_HELLO_RUST_CARGO

config EXAMPLES_HELLO_RUST_CARGO_PROGNAME
	string "Program name"
	default "hello_rust_cargo"
	---help---
		This is the name of the program that will be used when the
		program is installed.

config EXAMPLES_HELLO_RUST_CARGO_PRIORITY
	int "Hello Rust task priority"
	default 100

config EXAMPLES_HELLO_RUST_CARGO_STACKSIZE
	int "Hello Rust stack size"
	default DEFAULT_TASK_STACKSIZE

endif
```

## examples/hello_swift/Kconfig
```kconfig
#
# For a description of the syntax of this configuration file,
# see the file kconfig-language.txt in the NuttX tools repository.
#

config EXAMPLES_HELLO_SWIFT
	tristate "\"Hello, Swift!\" Swift embedded example"
	default n
	---help---
		Enable the \"Hello, Swift!\" Swift embedded example

if EXAMPLES_HELLO_SWIFT

config EXAMPLES_HELLO_SWIFT_PROGNAME
	string "Program name"
	default "hello_swift"
	---help---
		This is the name of the program that will be used when the
		program is installed.

config EXAMPLES_HELLO_SWIFT_PRIORITY
	int "Hello Swift task priority"
	default 100

config EXAMPLES_HELLO_SWIFT_STACKSIZE
	int "Hello Swift stack size"
	default DEFAULT_TASK_STACKSIZE

endif
```

## examples/hello_wasm/Kconfig
```kconfig
#
# For a description of the syntax of this configuration file,
# see the file kconfig-language.txt in the NuttX tools repository.
#

config EXAMPLES_HELLO_WASM
	tristate "\"Hello, WebAssembly!\" example"
	default n
	---help---
		Enable the \"Hello, WebAssembly!\" example

if EXAMPLES_HELLO_WASM

config EXAMPLES_HELLO_WASM_PROGNAME
	string "Program name"
	default "hello_wasm"
	---help---
		This is the name of the program that will be used when the NSH ELF
		program is installed.

config EXAMPLES_HELLO_WASM__PRIORITY
	int "Hello wasm task priority"
	default 100

config EXAMPLES_HELLO_WASM_STACKSIZE
	int "Hello wasm stack size"
	default DEFAULT_TASK_STACKSIZE

config EXAMPLES_HELLO_WASM_BUILD_WASM
	bool "Build as WebAssembly module"
	default y
	---help---
		Build the WebAssembly binary from the C source code.

config EXAMPLES_HELLO_WASM_BUILD_NATIVE
	bool "Build as native program"
	default n
	---help---
		Build the native binary from the C source code.

endif
```

## examples/hello_zig/Kconfig
```kconfig
#
# For a description of the syntax of this configuration file,
# see the file kconfig-language.txt in the NuttX tools repository.
#

config EXAMPLES_HELLO_ZIG
	tristate "\"Hello, Zig!\" example"
	default n
	---help---
		Enable the \"Hello, Zig!\" example

if EXAMPLES_HELLO_ZIG

config EXAMPLES_HELLO_ZIG_PROGNAME
	string "Program name"
	default "hello_zig"
	---help---
		This is the name of the program that will be used when the
		program is installed.

config EXAMPLES_HELLO_ZIG_PRIORITY
	int "Hello Zig task priority"
	default 100

config EXAMPLES_HELLO_ZIG_STACKSIZE
	int "Hello Zig stack size"
	default DEFAULT_TASK_STACKSIZE

endif
```

## examples/helloxx/Kconfig
```kconfig
#
# For a description of the syntax of this configuration file,
# see the file kconfig-language.txt in the NuttX tools repository.
#

config EXAMPLES_HELLOXX
	tristate "\"Hello, World!\" C++ example"
	default n
	depends on HAVE_CXX
	---help---
		Enable the \"Hello, World!\" C++ example
```

## examples/hidkbd/Kconfig
```kconfig
#
# For a description of the syntax of this configuration file,
# see the file kconfig-language.txt in the NuttX tools repository.
#

config EXAMPLES_HIDKBD
	tristate "USB HID keyboard example"
	default n
	---help---
		Enable the USB HID keyboard example

if EXAMPLES_HIDKBD

config EXAMPLES_HIDKBD_PROGNAME
	string "Program name"
	default "hidkbd"
	---help---
		This is the name of the program that will be used when the Nettest
		program is installed.

config EXAMPLES_HIDKBD_STACKSIZE
	int "Task stack size"
	default DEFAULT_TASK_STACKSIZE

config EXAMPLES_HIDKBD_DEFPRIO
	int "Task priority"
	default 100

config EXAMPLES_HIDKBD_DEVNAME
	string "Keyboard Device Name"
	default "/dev/kbda"
	---help---
		Name of keyboard device to be used. Default: "/dev/kbda"

config EXAMPLES_HIDKBD_ENCODED
	bool "Encode Special Keys"
	default y
	depends on HIDKBD_ENCODED && LIB_KBDCODEC
	---help---
		Decode special key press events in the user buffer.  In this case,
		the example coded will use the interfaces defined in
		include/nuttx/input/kbd_codec.h to decode the returned keyboard
		data.  These special keys include such things as up/down arrows,
		home and end keys, etc.  If this not defined, only 7-bit print-able
		and control ASCII characters will be provided to the user.

endif
```

## examples/hts221_reader/Kconfig
```kconfig
#
# For a description of the syntax of this configuration file,
# see the file kconfig-language.txt in the NuttX tools repository.
#

config EXAMPLES_HTS221_READER
	bool "HTS221 reader example"
	default n
	depends on SENSORS_HTS221
	---help---
		Enable the HTS221 reader example
```

## examples/hx711/Kconfig
```kconfig
#
# For a description of the syntax of this configuration file,
# see the file kconfig-language.txt in the NuttX tools repository.
#

config EXAMPLES_HX711
	tristate "HX711 driver example"
	default n
	select ADC_HX711
	---help---
		Enable the HX711 example. This program is also useful during
		development as it's possible to manipulate and dump hx711
		settings, as well as print conversions to terminal.

if EXAMPLES_HX711

config EXAMPLES_HX711_PROGNAME
	string "Program name"
	default "hx711"
	---help---
		This is the name of the program that will be used when the NSH ELF
		program is installed.

config EXAMPLES_HX711_PRIORITY
	int "hx711 task priority"
	default 100

config EXAMPLES_HX711_STACKSIZE
	int "hx711 stack size"
	default DEFAULT_TASK_STACKSIZE

endif
```

## examples/i2sloop/Kconfig
```kconfig
#
# For a description of the syntax of this configuration file,
# see the file kconfig-language.txt in the NuttX tools repository.
#

config EXAMPLES_I2SLOOP
	tristate "I2S loopback test"
	default n
	depends on I2S && AUDIO && DRIVERS_AUDIO && AUDIO_I2SCHAR
	---help---
		Enable the I2S loopback test
```

## examples/igmp/Kconfig
```kconfig
#
# For a description of the syntax of this configuration file,
# see the file kconfig-language.txt in the NuttX tools repository.
#

config EXAMPLES_IGMP
	tristate "IGMP example"
	default n
	---help---
		Enable the IGMP example

if EXAMPLES_IGMP

config EXAMPLES_IGMP_IPADDR
	hex "Target IP address"
	default 0xc0a80a10

config EXAMPLES_IGMP_DRIPADDR
	hex "Default Router IP address (Gateway)"
	default 0xc0a80aFA

config EXAMPLES_IGMP_GRPADDR
	hex "Group address"
	default 0xE0000181

config EXAMPLES_IGMP_NETMASK
	hex "Network Mask"
	default 0xffffff00

endif
```

## examples/ina219/Kconfig
```kconfig
#
# For a description of the syntax of this configuration file,
# see the file kconfig-language.txt in the NuttX tools repository.
#

config EXAMPLES_INA219
	bool "INA219 example"
	default n
	---help---
		Enable the INA219 example

if EXAMPLES_INA219

config EXAMPLES_INA219_PROGNAME
	string "Program name"
	default "ina219"
	depends on BUILD_LOADABLE
	---help---
		This is the name of the program that will be use when the NSH ELF
		program is installed.

config EXAMPLES_INA219_PRIORITY
	int "INA219 task priority"
	default 100

config EXAMPLES_INA219_STACKSIZE
	int "INA219 stack size"
	default 2048

endif
```

## examples/ina226/Kconfig
```kconfig
#
# For a description of the syntax of this configuration file,
# see the file kconfig-language.txt in the NuttX tools repository.
#

config EXAMPLES_INA226
	tristate "INA226 example"
	default n
	---help---
		Enable the INA226 example

if EXAMPLES_INA226

config EXAMPLES_INA226_PROGNAME
	string "Program name"
	default "ina226"
	---help---
		This is the name of the program that will be used when the NSH ELF
		program is installed.

config INA226_SHUNTVAL
	int "Shunt resistor value in micro-ohms"
	default 5000
	---help---
		The shunt resistor value in micro-ohms.

config INA226_DEVICE_PATH
	string "INA226 device name"
	default "/dev/ina226"
	---help---
		This is the name of the timer device that will be tested.

config EXAMPLES_INA226_PRIORITY
	int "INA226 task priority"
	default 100

config EXAMPLES_INA226_STACKSIZE
	int "INA226 stack size"
	default DEFAULT_TASK_STACKSIZE

endif
```

## examples/ina260/Kconfig
```kconfig
#
# For a description of the syntax of this configuration file,
# see the file kconfig-language.txt in the NuttX tools repository.
#

config EXAMPLES_INA260
	tristate "INA260 example"
	default n
	depends on SENSORS_INA260
	---help---
		Enable the INA260 example

if EXAMPLES_INA260

config EXAMPLES_INA260_PROGNAME
	string "Program name"
	default "ina260"
	---help---
		This is the name of the program that will be used when the NSH ELF
		program is installed.

config INA260_DEVICE_PATH
	string "INA260 device name"
	default "/dev/ina260"
	---help---
		This is the device path for the INA260 sensor.

config EXAMPLES_INA260_PRIORITY
	int "INA260 task priority"
	default 100

config EXAMPLES_INA260_STACKSIZE
	int "INA260 stack size"
	default DEFAULT_TASK_STACKSIZE

endif
```

## examples/ini_dumper/Kconfig
```kconfig
#
# For a description of the syntax of this configuration file,
# see the file kconfig-language.txt in the NuttX tools repository.
#

if FSUTILS_INIH

config EXAMPLES_INI_DUMPER
	tristate "ini dumper example"
	default n
	---help---
		Enable ini dumper example program which uses inih

if EXAMPLES_INI_DUMPER

config EXAMPLES_INI_DUMPER_PROGNAME
	string "Program name"
	default "ini_dumper"
	---help---
		This is the name of the program that will be used when the NSH ELF
		program is installed.

config EXAMPLES_INI_DUMPER_PRIORITY
	int "ini dumper example task priority"
	default 100

config EXAMPLES_INI_DUMPER_STACKSIZE
	int "ini dumper example stack size"
	default DEFAULT_TASK_STACKSIZE

endif #EXAMPLES_INI_DUMPER
endif #SYSTEM_INI_DUMPER
```

## examples/ipcfg/Kconfig
```kconfig
#
# For a description of the syntax of this configuration file,
# see the file kconfig-language.txt in the NuttX tools repository.
#

config EXAMPLES_IPCFG
	tristate "IP Configuration file example"
	default n
	select FS_TMPFS
	depends on FSUTILS_IPCFG
	---help---
		Enable the IP Configuration file example

if EXAMPLES_IPCFG

config EXAMPLES_IPCFG_PROGNAME
	string "IPCFG Program name"
	default "ipcfg"
	---help---
		This is the name of the program that will be used when the NSH ELF
		program is installed.

config EXAMPLES_IPCFG_PRIORITY
	int "IPCFG task priority"
	default 100

config EXAMPLES_IPCFG_STACKSIZE
	int "IPCFG stack size"
	default DEFAULT_TASK_STACKSIZE

endif
```
