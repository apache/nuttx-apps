## examples/keyboard/Kconfig
```kconfig
#
# For a description of the syntax of this configuration file,
# see the file kconfig-language.txt in the NuttX tools repository.
#

config EXAMPLES_KEYBOARD
	tristate "Keyboard example"
	default n
	---help---
		Enable the keyboard example

if EXAMPLES_KEYBOARD

config EXAMPLES_KEYBOARD_DEVPATH
	string "Keyboard device path"
	default "/dev/kbd0"
	---help---
		The path to the keyboard device. Default: "/dev/kbd0"

endif
```

## examples/lcdrw/Kconfig
```kconfig
#
# For a description of the syntax of this configuration file,
# see misc/tools/kconfig-language.txt.
#

config EXAMPLES_LCDRW
	bool "LCD read/write example"
	default n
	depends on NX && NX_LCDDRIVER
	---help---
		Enable the LCD read/write example

if EXAMPLES_LCDRW

config EXAMPLES_LDCRW_DEVNO
	int "Video Device Number"
	default 0
	---help---
		The LCD device to select from the LCD driver for use in the test:
		Default: 0

config EXAMPLES_LCDRW_BPP
	int "Bits-Per-Pixel"
	default 16
	range 1 32
	depends on EXPERIMENTAL
	---help---
		Pixels per pixel to use.  Valid options include 1, 2, 4, 8, 16, 24,
		and 32.  Default is 16.

config EXAMPLES_LDCRW_XRES
	int "Horizontal display resolution (pixels)"
	default 240
	---help---
		Horizontal resolution of the display in pixels.  Default 240.

config EXAMPLES_LDCRW_YRES
	int "Vertical display resolution (rows)"
	default 320
	---help---
		Vertical resolution of the display in rows. Default 320.

endif
```

## examples/leds/Kconfig
```kconfig
#
# For a description of the syntax of this configuration file,
# see the file kconfig-language.txt in the NuttX tools repository.
#

config EXAMPLES_LEDS
	tristate "LED driver example"
	default n
	depends on USERLED
	---help---
		Enable the LED driversexample

if EXAMPLES_LEDS

config EXAMPLES_LEDS_PROGNAME
	string "Program name"
	default "leds"
	---help---
		This is the name of the program that will be used when the NSH ELF
		program is installed.

config EXAMPLES_LEDS_PRIORITY
	int "LED task priority"
	default 100

config EXAMPLES_LEDS_STACKSIZE
	int "LED stack size"
	default DEFAULT_TASK_STACKSIZE

config EXAMPLES_LEDS_DEVPATH
	string "LED device path"
	default "/dev/userleds"

config EXAMPLES_LEDS_LEDSET
	hex "Subset of LEDs to use"
	default 0x0f

endif # EXAMPLES_LEDS
```

## examples/leds_rust/Kconfig
```kconfig
#
# For a description of the syntax of this configuration file,
# see the file kconfig-language.txt in the NuttX tools repository.
#

config EXAMPLES_LEDS_RUST
	tristate "\"LEDs Rust\" example"
	default n
	depends on USERLED
	---help---
		Enable the \"LEDs Rust\" example

if EXAMPLES_LEDS_RUST

config EXAMPLES_LEDS_RUST_PROGNAME
	string "Program name"
	default "leds_rust"
	---help---
		This is the name of the program that will be used when the
		program is installed.

config EXAMPLES_LEDS_RUST_PRIORITY
	int "LEDs Rust task priority"
	default 100

config EXAMPLES_LEDS_RUST_STACKSIZE
	int "LEDs Rust stack size"
	default DEFAULT_TASK_STACKSIZE

endif
```

## examples/leds_zig/Kconfig
```kconfig
#
# For a description of the syntax of this configuration file,
# see the file kconfig-language.txt in the NuttX tools repository.
#

config EXAMPLES_LEDS_ZIG
	tristate "\"LEDs Zig\" example"
	default n
	depends on USERLED
	---help---
		Enable the \"LEDs Zig\" example

if EXAMPLES_LEDS_ZIG

config EXAMPLES_LEDS_ZIG_PROGNAME
	string "Program name"
	default "leds_zig"
	---help---
		This is the name of the program that will be used when the
		program is installed.

config EXAMPLES_LEDS_ZIG_PRIORITY
	int "LEDs Zig task priority"
	default 100

config EXAMPLES_LEDS_ZIG_STACKSIZE
	int "LEDs Zig stack size"
	default DEFAULT_TASK_STACKSIZE

endif
```

## examples/lely_master/Kconfig
```kconfig
#
# For a description of the syntax of this configuration file,
# see the file kconfig-language.txt in the NuttX tools repository.
#

config EXAMPLES_LELYMASTER
	tristate "Lely CANopen master example"
	default n
	depends on CANUTILS_LELYCANOPEN && CANUTILS_LELYCANOPEN_SDEV
	depends on CANUTILS_LELYCANOPEN_TIME && CANUTILS_LELYCANOPEN_OBJUPLOAD
	depends on CANUTILS_LELYCANOPEN_MASTER
	---help---
		Enable the Lely CANopen master (comaster) example application.

if EXAMPLES_LELYMASTER

choice
	prompt "CAN backend"
	default EXAMPLES_LELYMASTER_CHARDEV

config EXAMPLES_LELYMASTER_CHARDEV
	bool "CAN character driver"
	depends on CAN

config EXAMPLES_LELYMASTER_SOCKET
	bool "SocketCAN"
	depends on NET_CAN
	select NETUTILS_NETLIB

endchoice

config EXAMPLES_LELYMASTER_DEVPATH
	string "CAN character device path"
	default "/dev/can0"
	depends on EXAMPLES_LELYMASTER_CHARDEV

config EXAMPLES_LELYMASTER_INTF
	string "SocketCAN interface"
	default "can0"
	depends on EXAMPLES_LELYMASTER_SOCKET

config EXAMPLES_LELYMASTER_PRIORITY
	int "Task priority"
	default 100

config EXAMPLES_LELYMASTER_STACKSIZE
	int "Stack size"
	default DEFAULT_TASK_STACKSIZE

endif
```

## examples/lely_slave/Kconfig
```kconfig
#
# For a description of the syntax of this configuration file,
# see the file kconfig-language.txt in the NuttX tools repository.
#

config EXAMPLES_LELYSLAVE
	tristate "Lely CANopen slave example"
	default n
	depends on CANUTILS_LELYCANOPEN && CANUTILS_LELYCANOPEN_SDEV
	depends on CANUTILS_LELYCANOPEN_TIME && CANUTILS_LELYCANOPEN_OBJUPLOAD
	---help---
		Enable the Lely CANopen slave (coslave) example application.

if EXAMPLES_LELYSLAVE

choice
	prompt "CAN backend"
	default EXAMPLES_LELYSLAVE_CHARDEV

config EXAMPLES_LELYSLAVE_CHARDEV
	bool "CAN character driver"
	depends on CAN

config EXAMPLES_LELYSLAVE_SOCKET
	bool "SocketCAN"
	depends on NET_CAN
	select NETUTILS_NETLIB

endchoice

config EXAMPLES_LELYSLAVE_DEVPATH
	string "CAN character device path"
	default "/dev/can0"
	depends on EXAMPLES_LELYSLAVE_CHARDEV

config EXAMPLES_LELYSLAVE_INTF
	string "SocketCAN interface"
	default "can0"
	depends on EXAMPLES_LELYSLAVE_SOCKET

config EXAMPLES_LELYSLAVE_PRIORITY
	int "Task priority"
	default 100

config EXAMPLES_LELYSLAVE_STACKSIZE
	int "Stack size"
	default DEFAULT_TASK_STACKSIZE

endif
```

## examples/libtest/Kconfig
```kconfig
#
# For a description of the syntax of this configuration file,
# see the file kconfig-language.txt in the NuttX tools repository.
#

config EXAMPLES_LIBTEST
	bool "Static library Example"
	default n
	---help---
		Enable the static library example

if EXAMPLES_LIBTEST

config EXAMPLES_LIBTEST_CMDTOOL
	tristate "Static library Command Line Tool"
	default n
	---help---
		By default, static library example is build as only a library.
		If this option is selected than a simple command line tool that
		can be ran from NSH will also be generated.

config EXAMPLES_LIBTEST_PROGNAME
	string "Static library program name"
	default "libtest"
	---help---
		This is the name of the program that will be used when the NSH ELF
		program is installed.

config EXAMPLES_LIBTEST_PRIORITY
	int "Static library task priority"
	default 100

config EXAMPLES_LIBTEST_STACKSIZE
	int "Static library stack size"
	default DEFAULT_TASK_STACKSIZE

endif
```

## examples/lis3dsh_reader/Kconfig
```kconfig
#
# For a description of the syntax of this configuration file,
# see the file kconfig-language.txt in the NuttX tools repository.
#

config EXAMPLES_LIS3DSH_READER
	tristate "LIS3DSH acceleration reader example"
	default n
	depends on LIS3DSH
	depends on SPI_EXCHANGE
	---help---
		Enable the LIS3DSH reader example

if EXAMPLES_LIS3DSH_READER

config EXAMPLES_LIS3DSH_READER_PROGNAME
	string "Program name"
	default "lis3dsh_reader"
	---help---
		This is the name of the program that will be used when the NSH ELF
		program is installed.

endif # EXAMPLES_LIS3DSH_READER
```

## examples/litmus/Kconfig
```kconfig
#
# For a description of the syntax of this configuration file,
# see the file kconfig-language.txt in the NuttX tools repository.
#

config EXAMPLES_Litmus
	tristate "\"Litmus nuttx !\" example"
	default n
	---help---
		Enable the \"Litmus, Nuttx!\" example

if EXAMPLES_LITMUS

config EXAMPLES_LITMUS_PROGNAME
	string "Program name"
	default "litmus"
	---help---
		This is the name of the program that will be used when the NSH ELF
		program is installed.

config EXAMPLES_LITMUS_PRIORITY
	int "litmus task priority"
	default 100

config EXAMPLES_LITMUS_STACKSIZE
	int "litmus stack size"
	default DEFAULT_TASK_STACKSIZE
endif
```

## examples/lorawan_test/Kconfig
```kconfig
#
# For a description of the syntax of this configuration file,
# see the file kconfig-language.txt in the NuttX tools repository.
#

config EXAMPLES_LORAWAN_TEST
	tristate "LoRaWAN Test App"
	default n
	---help---
		Enable the LoRaWAN Test App

if EXAMPLES_LORAWAN_TEST

config EXAMPLES_LORAWAN_TEST_PROGNAME
	string "Program name"
	default "lorawan_test"
	---help---
		This is the name of the program that will be used when the NSH ELF
		program is installed.

config EXAMPLES_LORAWAN_TEST_PRIORITY
	int "LoRaWAN Test task priority"
	default 100

config EXAMPLES_LORAWAN_TEST_STACKSIZE
	int "LoRaWAN Test stack size"
	default DEFAULT_TASK_STACKSIZE

endif
```

## examples/lp503x/Kconfig
```kconfig
#
# For a description of the syntax of this configuration file,
# see the file kconfig-language.txt in the NuttX tools repository.
#

config EXAMPLES_LP503X
	tristate "LP503X PWM LED example"
	default n
	depends on LP503X
	---help---
		Enable the LP503X example

if EXAMPLES_LP503X

config EXAMPLES_LP503X_PROGNAME
	string "Program name"
	default "lp503x"
	---help---
		This is the name of the program that will be used when the NSH ELF
		program is installed.

config EXAMPLES_LP503X_DEVPATH
	string "LP503X device path"
	default "/dev/leddrv0"

config EXAMPLES_LP503X_PRIORITY
	int "lp503x task priority"
	default 100

config EXAMPLES_LP503X_STACKSIZE
	int "lp503x stack size"
	default DEFAULT_TASK_STACKSIZE

endif
```

## examples/lsm303_reader/Kconfig
```kconfig
#
# For a description of the syntax of this configuration file,
# see the file kconfig-language.txt in the NuttX tools repository.
#

config EXAMPLES_LSM303_READER
	bool "LSM303 reader example"
	default n
	depends on SENSORS_LSM303AGR
	---help---
		Enable the LSM303 reader example
```

## examples/lsm330spi_test/Kconfig
```kconfig
#
# For a description of the syntax of this configuration file,
# see the file kconfig-language.txt in the NuttX tools repository.
#

config EXAMPLES_LSM330SPI_TEST
	tristate "LSM330 SPI test program"
	default n
	---help---
		Enable the LSM330 sensor SPI test program.

if EXAMPLES_LSM330SPI_TEST

config EXAMPLES_LSM330SPI_TEST_PROGNAME
	string "Program name"
	default "lsm330spi_test"
	---help---
		This is the name of the program that will be used when the NSH ELF
		program is installed.

config EXAMPLES_LSM330SPI_TEST_PRIORITY
	int "lsm330spi_test task priority"
	default 100

config EXAMPLES_LSM330SPI_TEST_STACKSIZE
	int "lsm330spi_test stack size"
	default DEFAULT_TASK_STACKSIZE

endif
```

## examples/lsm6dsl_reader/Kconfig
```kconfig
#
# For a description of the syntax of this configuration file,
# see the file kconfig-language.txt in the NuttX tools repository.
#

config EXAMPLES_LSM6DSL_READER
	bool "LSM6DSL reader example"
	default n
	depends on SENSORS_LSM6DSL
	---help---
		Enable the LSM6DSL reader example
```

## examples/ltdc/Kconfig
```kconfig
#
# For a description of the syntax of this configuration file,
# see the file kconfig-language.txt in the NuttX tools repository.
#

config EXAMPLES_LTDC
	bool "STM32 LTDC framebuffer example"
	default n
	depends on STM32_LTDC
	---help---
		Enable the LTDC example
```

## examples/ltr308/Kconfig
```kconfig
#
# For a description of the syntax of this configuration file,
# see the file kconfig-language.txt in the NuttX tools repository.
#

config EXAMPLES_LTR308
	tristate "LTR308 ambient light sensor example"
	default n
	depends on SENSORS_LTR308
	---help---
		Enable the LTR308 example

if EXAMPLES_LTR308

config EXAMPLES_LTR308_PROGNAME
	string "Program name"
	default "ltr308"
	---help---
		This is the name of the program that will be used when the NSH ELF
		program is installed.

config EXAMPLES_LTR308_PRIORITY
	int "LTR308 task priority"
	default 100

config EXAMPLES_LTR308_STACKSIZE
	int "LTR308 stack size"
	default DEFAULT_TASK_STACKSIZE

endif
```

## examples/lua_module/Kconfig
```kconfig
#
# For a description of the syntax of this configuration file,
# see the file kconfig-language.txt in the NuttX tools repository.
#

config EXAMPLES_LUA_MODULE
	tristate "Lua module example"
	default n
	---help---
		Enable the Lua module example
```

## examples/lws_echo/Kconfig
```kconfig
#
# For a description of the syntax of this configuration file,
# see the file kconfig-language.txt in the NuttX tools repository.
#

config EXAMPLES_LWS_ECHO
	tristate "libwebsockets WebSocket echo server"
	default n
	depends on NETUTILS_LIBWEBSOCKETS && NETUTILS_LIBWEBSOCKETS_SERVER
	---help---
		Simple WebSocket echo server using libwebsockets without TLS.

if EXAMPLES_LWS_ECHO

config EXAMPLES_LWS_ECHO_PROGNAME
	string "Program name"
	default "lws_echo"

config EXAMPLES_LWS_ECHO_PRIORITY
	int "Task priority"
	default 100

config EXAMPLES_LWS_ECHO_STACKSIZE
	int "Stack size"
	default 16384

config EXAMPLES_LWS_ECHO_PORT
	int "WebSocket server TCP port"
	default 9000

endif
```

## examples/lzf/Kconfig
```kconfig
#
# For a description of the syntax of this configuration file,
# see the file kconfig-language.txt in the NuttX tools repository.
#

config EXAMPLES_LZF
	bool "\"LZF compression tool\" example"
	default n
	---help---
		Enable the \"LZF compression tool\" example

if EXAMPLES_LZF

config EXAMPLES_LZF_PROGNAME
	string "Program name"
	default "lzf"
	depends on BUILD_KERNEL
	---help---
		This is the name of the program that will be use when the NSH ELF
		program is installed.

config EXAMPLES_LZF_PRIORITY
	int "LZF task priority"
	default 100

config EXAMPLES_LZF_STACKSIZE
	int "LZF stack size"
	default 20480

endif
```

## examples/max31855/Kconfig
```kconfig
#
# For a description of the syntax of this configuration file,
# see the file kconfig-language.txt in the NuttX tools repository.
#

config EXAMPLES_MAX31855
	bool "\"max31855\" example"
	default n
	---help---
		Enable the \"max31855, World!\" example

if EXAMPLES_MAX31855

config EXAMPLES_MAX31855_PROGNAME
	string "Program name"
	default "max31855"
	depends on BUILD_LOADABLE
	---help---
		This is the name of the program that will be use when the NSH ELF
		program is installed.

config EXAMPLES_MAX31855_PRIORITY
	int "max31855 task priority"
	default 100

config EXAMPLES_MAX31855_STACKSIZE
	int "max31855 stack size"
	default 2048

endif
```

## examples/mcuboot/slot_confirm/Kconfig
```kconfig
#
# For a description of the syntax of this configuration file,
# see the file kconfig-language.txt in the NuttX tools repository.
#

config EXAMPLES_MCUBOOT_SLOT_CONFIRM
	tristate "MCUboot slot confirm example"
	default n
	select BOOT_MCUBOOT
	---help---
		Example application for confirming a newly installed application
		application firmware image using MCUboot public APIs.
		This application should be used as the OTA update package of the
		EXAMPLES_MCUBOOT_UPDATE_AGENT example.
```

## examples/mcuboot/swap_test/Kconfig
```kconfig
#
# For a description of the syntax of this configuration file,
# see the file kconfig-language.txt in the NuttX tools repository.
#

config EXAMPLES_MCUBOOT_SWAP_TEST
	tristate "MCUboot SWAP Test image example"
	default n
	select BOOT_MCUBOOT
	---help---
		Example application to demonstrate the firmware image swap
		and the image rollback processes of MCUboot using the boot
		swap and test method.
```
