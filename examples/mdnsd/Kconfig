## examples/mdnsd/Kconfig
```kconfig
#
# For a description of the syntax of this configuration file,
# see the file kconfig-language.txt in the NuttX tools repository.
#

config EXAMPLES_MDNSD
	tristate "MDNS daemon example"
	default n
	depends on NETUTILS_MDNS_DAEMON
	---help---
		Enable the MDNS daemon example

if EXAMPLES_MDNSD

config EXAMPLES_MDNS_SERVICE
	string "Name of the mdns service"
	default "_nuttx._tcp.local"
	---help---
		This is the name of the service to be advertised by this example.
		The format is _service.protocol.domain where
			- "service" identifies the type of service being advertised such as 
			  _http, or _printer
			- "protocol" as used by the service (e.g. _udp or _tcp)
			- "domain" which for mDNS is most likely _local

config EXAMPLES_MDNS_SERVICE_PORT
	string "The port that the advertised service uses"
	default "32000"
	---help---
		The port the advertised service uses. The default is randomly chosen.

endif
```

## examples/media/Kconfig
```kconfig
#
# For a description of the syntax of this configuration file,
# see the file kconfig-language.txt in the NuttX tools repository.
#

config EXAMPLES_MEDIA
	bool "Media test"
	default n
	---help---
		Enable the media test.  This test simply writes values onto the
		media hidden behind a character driver and verifies that the media
		can be successfully written and read.  This low level test is
		useful in the early phases of the bringup of a new block or mtd
		driver because it avoids the complexity of a file system.

		This test uses a character driver and cannot directly access block
		or mtd drivers.  This test is suitable for use EEPROM character
		drivers (see nuttx/drivers/eeprom), or with block drivers wrapped
		as character drivers (see nuttx/drivers/bch)

			int ret = bchdev_register(<path-to-block-dirver>,
			                          <path-to-character-driver>, false);

		MTD drivers need an additional wrapper layer, the FTL wrapper must
		first be used to convert the MTD driver to a block device:

			int ret = ftl_initialize(<N>, mtd);
			ret = bchdev_register(/dev/mtdblock<N>, <path-to-character-driver>,
			                      false);

if EXAMPLES_MEDIA

config EXAMPLES_MEDIA_DEVPATH
	string "Character driver path"
	default "/dev/mtd0"
	---help---
		This is the full path to the character driver that is used to
		access the media.  This test is suitable for use EEPROM character
		drivers (see nuttx/drivers/eeprom), or with block drivers wrapped as
		character drivers (see nuttx/drivers/bch)

			int ret = bchdev_register(<path-to-block-dirver>,
			                          <path-to-character-driver>, false);

		MTD drivers need an additional wrapper layer, the FTL wrapper must
		first be used to convert the MTD driver to a block device:

			int ret = ftl_initialize(<N>, mtd);
			ret = bchdev_register(/dev/mtdblock<N>, <path-to-character-driver>,
			                      false);

		NOTE: This drivr path can be overridden when the application is
		executed by providing a differ device path on the 'media' command line.

config EXAMPLES_MEDIA_BLOCKSIZE
	int "Block size"
	default 512
	---help---
		This test will attempt to determine the block size of the underlying
		block or MTD driver using ioctl calls.  This default value will only
		be used in the event that the test logic is unable to determine the
		underlying block size of the media.  This value should match the
		block/MTD device's (erase) block size.

config EXAMPLES_MEDIA_PROGNAME
	string "Program name"
	default "media"
	depends on BUILD_LOADABLE
	---help---
		This is the name of the program that will be use when the NSH ELF
		program is installed.

endif
```

## examples/microros_pub/Kconfig
```kconfig
#
# For a description of the syntax of this configuration file,
# see the file kconfig-language.txt in the NuttX tools repository.
#

config EXAMPLES_MICROROS_PUB
	tristate "micro-ROS int32 publisher example"
	default n
	depends on SYSTEM_MICROROS
	---help---
		Minimal micro-ROS publisher that creates a node and publishes
		an std_msgs/Int32 every second on the topic /nuttx_pub.  Used
		to validate the NuttX-native transport layer end-to-end with
		a micro-ROS agent.

if EXAMPLES_MICROROS_PUB

config EXAMPLES_MICROROS_PUB_PROGNAME
	string "Program name"
	default "microros_pub"

config EXAMPLES_MICROROS_PUB_PRIORITY
	int "micro-ROS pub task priority"
	default 100

config EXAMPLES_MICROROS_PUB_STACKSIZE
	int "micro-ROS pub stack size"
	default 8192

endif
```

## examples/microros_sub/Kconfig
```kconfig
#
# For a description of the syntax of this configuration file,
# see the file kconfig-language.txt in the NuttX tools repository.
#

config EXAMPLES_MICROROS_SUB
	tristate "micro-ROS int32 subscriber example"
	default n
	depends on SYSTEM_MICROROS
	---help---
		Minimal micro-ROS subscriber that creates a node, subscribes to
		the topic /nuttx_sub with std_msgs/Int32, and prints each
		received value.  Drives an rclc_executor spin loop and is used
		together with microros_pub (or any external publisher) to
		validate the NuttX-native transport in the receive direction.

if EXAMPLES_MICROROS_SUB

config EXAMPLES_MICROROS_SUB_PROGNAME
	string "Program name"
	default "microros_sub"

config EXAMPLES_MICROROS_SUB_PRIORITY
	int "micro-ROS sub task priority"
	default 100

config EXAMPLES_MICROROS_SUB_STACKSIZE
	int "micro-ROS sub stack size"
	default 8192

endif
```

## examples/microwindows/Kconfig
```kconfig
config EXAMPLES_MICROWINDOWS
	tristate "Microwindows example"
	default n
	depends on GRAPHICS_MICROWINDOWS
	---help---
		Enable the Microwindows example application

if EXAMPLES_MICROWINDOWS

config EXAMPLES_MICROWINDOWS_PROGNAME
	string "Program name"
	default "mwexample"
	---help---
		This is the name of the program that will be used when the NSH ELF
		program is installed.

config EXAMPLES_MICROWINDOWS_PRIORITY
	int "Microwindows task priority"
	default 100

config EXAMPLES_MICROWINDOWS_STACKSIZE
	int "Microwindows stack size"
	default 32768

endif
```

## examples/mld/Kconfig
```kconfig
#
# For a description of the syntax of this configuration file,
# see the file kconfig-language.txt in the NuttX tools repository.
#

config EXAMPLES_MLD
	tristate "MLD example"
	default n
	depends on NET_UDP && NET_MLD
	---help---
		Enable the MLD example

if EXAMPLES_MLD

config EXAMPLES_MLD_PROGNAME
	string "Program name"
	default "mld"
	---help---
		This is the name of the program that will be used when the NSH ELF
		program is installed.

config EXAMPLES_MLD_PRIORITY
	int "MLD example task priority"
	default 100

config EXAMPLES_MLD_STACKSIZE
	int "MLD example stack size"
	default DEFAULT_TASK_STACKSIZE

config EXAMPLES_MLD_INIT
	bool "Initialize network"
	default n if NSH_NETINIT
	default y if !NSH_NETINIT
	---help---
		Include logic to initialize the network.  This should not be done if
		the network is already initialized when nettest runs.  This is
		usually the case, for example, when nettest is run as an NSH built-
		in task.

if EXAMPLES_MLD_INIT

config EXAMPLES_MLD_IPADDR
	hex "Target Link-Local address"
	default 0x00000002
	range 0x0 0xffff
	---help---
		Last 16-bits of the target link-local, unicast in host order.  Given

			CONFIG_EXAMPLES_MLD_IPADDR=0xXXXX

		the full IPv6 link local address will be fe80::00ff:fe00:XXXX (host order)

config EXAMPLES_MLD_DRIPADDR
	hex "Default Router IP address (Gateway)"
	default 0x00000001
	range 0x0 0xffff
	---help---
		Last 16-bits of the default link-local, unicast in host order.  Given

			CONFIG_EXAMPLES_MLD_DRIPADDR=0xXXXX

		the full IPv6 link local address will be fe80::00ff:fe00:XXXX (host order)

config EXAMPLES_MLD_NOMAC
	bool "Use Canned MAC Address"
	default n

endif # EXAMPLES_MLD_INIT

config EXAMPLES_MLD_GRPADDR
	hex "Group address"
	default 0xE0000181
	range 0x0 0xffff
	---help---
		Last 16-bits of the group link-local, multicast address in host order.  Given

			CONFIG_EXAMPLES_MLD_GRPADDR=0xXXXX

		the full IPv6 link local address will be ff02::0000:0000:XXXX (host order)

endif
```

## examples/mlx90614/Kconfig
```kconfig
#
# For a description of the syntax of this configuration file,
# see the file kconfig-language.txt in the NuttX tools repository.
#

config EXAMPLES_MLX90614
	tristate "MLX90614 Test Example"
	default n
	select  LIBC_FLOATINGPOINT
	---help---
		Enable the MLX90614 example

if EXAMPLES_MLX90614

config EXAMPLES_MLX90614_PROGNAME
	string "Program name"
	default "MLX90614 Test Example"
	---help---
		This is the name of the program that will be used when the NSH ELF
		program is installed.

endif
```

## examples/mm/Kconfig
```kconfig
#
# For a description of the syntax of this configuration file,
# see the file kconfig-language.txt in the NuttX tools repository.
#

config EXAMPLES_MM
	tristate "Memory management example"
	default n
	---help---
		Enable the memory management example

if EXAMPLES_MM
endif
```

## examples/mml_parser/Kconfig
```kconfig
#
# For a description of the syntax of this configuration file,
# see the file kconfig-language.txt in the NuttX tools repository.
#

config EXAMPLES_MMLPARSER
	tristate "mml_parser example"
	default n
	---help---
		Enable the mml_parser example
```

## examples/modbusmaster/Kconfig
```kconfig
#
# For a description of the syntax of this configuration file,
# see the file kconfig-language.txt in the NuttX tools repository.
#

config EXAMPLES_MODBUSMASTER
	tristate "Modbus Master example"
	default n
	---help---
		Enable the Modbus Master example

if EXAMPLES_MODBUSMASTER

config EXAMPLES_MODBUSMASTER_PROGNAME
	string "Program name"
	default "modbusmaster"
	---help---
		This is the name of the program that will be used when the NSH ELF
		program is installed.

config EXAMPLES_MODBUSMASTER_PRIORITY
	int "Modbus Master task priority"
	default 100

config EXAMPLES_MODBUSMASTER_STACKSIZE
	int "Modbus Master stack size"
	default DEFAULT_TASK_STACKSIZE

config EXAMPLES_MODBUSMASTER_PORT
	int "Modbus Master port (1 for /dev/ttyS1)"
	default 1
	---help---
		Choose Modbus master communications port. 0 corresponds
		/dev/ttyS0, 1 -- /dev/ttyS1, etc.

config EXAMPLES_MODBUSMASTER_BAUDRATE
	int "Modbus Master port Baudrate"
	default 38400
	---help---
		Choose modbus master serial port baudrate.

config EXAMPLES_MODBUSMASTER_PARITY
	int "Modbus Master port Parity"
	default 2
	---help---
		Choose Modbus master serial port parity.
		0 = NONE ; 1 = ODD; 2 = EVEN

config EXAMPLES_MODBUSMASTER_SLAVEADDR
	int "Modbus Slave Address (master will query this slave)"
	default 1

config EXAMPLES_MODBUSMASTER_SLAVEREG
	int "Modbus Slave Holding Register address to query"
	default 1

config EXAMPLES_MODBUSMASTER_TESTCOUNT
	int "Reads count to perform"
	default 100

endif
```
