## examples/module/Kconfig
```kconfig
#
# For a description of the syntax of this configuration file,
# see the file kconfig-language.txt in the NuttX tools repository.
#

config EXAMPLES_MODULE
	tristate "Module Example"
	default n
	depends on MODULE && LIB_BOARDCTL
	select BOARDCTL_OS_SYMTAB
	---help---
		Enable the module example

if EXAMPLES_MODULE

config EXAMPLES_MODULE_BUILTINFS
	bool "Built-in File System"
	default y
	depends on (FS_ROMFS || FS_CROMFS) && BUILD_FLAT
	---help---
		This example supports a very, non-standard but also very convenient
		way of testing with example using CONFIG_EXAMPLES_MODULE_BUILTINFS.
		If this option is selected, the test modules will be built,
		installed in the module/lib/fsroot, then converted to a built-in
		ROMFS file system.

		When the test runs, it will automatically create the ROMFS block
		device and mount the test modules for testing.

		If this option is not selected, then the modules will be left in
		the fsroot/ directory.  You can then copy them to, say an SD card,
		for testing on the target.  That file system will need to be mounted
		such that CONFIG_EXAMPLES_MODULE_BINDIR refers to the directory
		containing the module binaries (unless the file system is auto-
		mounted)

		NOTE: This option can only be used in the FLAT build mode because
		it makes an illegal OS call to ramdisk_register().

choice
	prompt "Built-in file system type"
	default EXAMPLES_MODULE_ROMFS  if  FS_ROMFS
	default EXAMPLES_MODULE_CROMFS if !FS_ROMFS && FS_CROMFS
	depends on EXAMPLES_MODULE_BUILTINFS

config EXAMPLES_MODULE_ROMFS
	bool "ROMFS"
	depends on FS_ROMFS && BUILD_FLAT
	---help---
		 Automatically generates and mounts an internal ROMFS file
		 system

config EXAMPLES_MODULE_CROMFS
	bool "CROMFS"
	depends on FS_CROMFS && BUILD_FLAT
	 ---help---
		 Automatically generates and mounts an internal CROMFS file
		 system

endchoice # Built-in file system type

config EXAMPLES_MODULE_DEVMINOR
	int "ROMFS Minor Device Number"
	default 0
	depends on EXAMPLES_MODULE_ROMFS
	---help---
		The minor device number of the ROMFS block. For example, the N in /dev/ramN.
		Used for registering the RAM block driver that will hold the ROMFS file system
		containing the MODULE executables to be tested.  Default: 0

config EXAMPLES_MODULE_FSMOUNT
	bool "Mount external file system"
	default y
	depends on !EXAMPLES_MODULE_BUILTINFS
	---help---
		Automatically mount the external file system using the block
		device provided by CONFIG_EXAMPLES_MODULE_DEVPATH and the file
		system type specified by CONFIG_EXAMPLES_MODULE_FSTYPE.

config EXAMPLES_MODULE_FSREMOVEABLE
	bool "Removable file system"
	default n
	depends on EXAMPLES_MODULE_FSMOUNT
	---help---
		If the external file system is on removable media such as an
		SD card or a USB FLASH driver, then this option may be selected
		to build in logic to wait for the media to be installed and
		initialized before trying to mount it.

config EXAMPLES_MODULE_FSTYPE
	string "External file system type"
	default "vfat"
	depends on EXAMPLES_MODULE_FSMOUNT
	---help---
		The type of the external file system as will be used in the mount()
		command.  Default: "vfat"

config EXAMPLES_MODULE_DEVPATH
	string "Block driver device path"
	default "/dev/ram0" if EXAMPLES_MODULE_ROMFS
	default "/dev/mmcsd0" if EXAMPLES_MODULE_FSMOUNT
	depends on EXAMPLES_MODULE_ROMFS || EXAMPLES_MODULE_FSMOUNT
	---help---
		The path to the ROMFS/External block driver device.  This must match
		EXAMPLES_MODULE_DEVMINOR for the case of ROMFS.  Used for mounting the
		file system containing the ELF executables to be tested.  Default:
		"/dev/ram0" for ROMFS, "/dev/mmcsd0" for the external file system.

config EXAMPLES_MODULE_BINDIR
	string "Path to binaries"
	default "/mnt/moddata"
	depends on !EXAMPLES_MODULE_BUILTINFS && !EXAMPLES_MODULE_FSMOUNT
	---help---
		The full, absolte path to the location for the binaries can be
		located in a pre-mounted external file system.

config EXAMPLES_MODULE_NOSTRIP
	bool "Do not strip debug symbols"
	default n
	depends on DEBUG_SYMBOLS
	---help---
		 By default, if debug symbols are enabled (via CONFIG_DEBUG_SYMBOLS), then the
		 ELF executables will also retain debug symbols in the resulting ELF binaries.
		 Select this option if you do not want that behavior, this option will permit
		 debug symbols in the base code but will strip debug symbols out of the ELF
		 binaries for a smaller ROM file system image.

config EXAMPLES_MODULE_LIBC
	bool "Link with LIBC"
	default n
	depends on !BUILD_LOADABLE && EXPERIMENTAL
	---help---
		Link with the C library (and also math library if it was built).
		By default, all undefined symbols must be provided via a symbol
		table.  But if this option is selected, then each MODULE test program
		will link with the C library and will not require symbol table
		entries.  You probably will NOT want this option, however,
		because it will substantially increase the size of code.  For
		example, a separate copy of printf() would be linked with every
		program greatly increasing the total code size.  This option is
		primarily intended only for testing.

		WARNING:  Libc will not be built with -mlong-calls and this may
		result in runtime linking failures due to out-of-range functions
		calls.

config EXAMPLES_MODULE_LIBGCC
	bool "Link with LIBGCC"
	default n
	depends on !BUILD_LOADABLE && EXPERIMENTAL

endif
```

## examples/mount/Kconfig
```kconfig
#
# For a description of the syntax of this configuration file,
# see the file kconfig-language.txt in the NuttX tools repository.
#

config EXAMPLES_MOUNT
	tristate "File system mount example"
	default n
	select LIB_BOARDCTL if !EXAMPLES_MOUNT_BLOCKDEVICE
	select BOARDCTL_MKRD if !EXAMPLES_MOUNT_BLOCKDEVICE
	---help---
		Enable the file system mount example

if EXAMPLES_MOUNT

config EXAMPLES_MOUNT_BLOCKDEVICE
	bool "Use block device"
	default n
	---help---
		Use an existing block device to mount. If EXAMPLES_MOUNT_BLOCKDEVICE
		is not selected, then a RAM disk will be configured for the test.

if EXAMPLES_MOUNT_BLOCKDEVICE

config EXAMPLES_MOUNT_DEVNAME
	string "Block device name"
	default "/dev/mtdblock0"
	---help---
		The name of the user-provided block device to mount.  Must be
		provided if EXAMPLES_MOUNT_BLOCKDEVICE is selected.

endif # EXAMPLES_MOUNT_BLOCKDEVICE

if !EXAMPLES_MOUNT_BLOCKDEVICE

config EXAMPLES_MOUNT_NSECTORS
	int "RAM disk number of sectors"
	default 2048
	---help---
		The number of "sectors" in the RAM disk used when
		EXAMPLES_MOUNT_BLOCKDEVICE is not selected.

config EXAMPLES_MOUNT_SECTORSIZE
	int "RAM disk sector size"
	default 512
	---help---
		The size of each sectors in the RAM disk used when
		EXAMPLES_MOUNT_BLOCKDEVICE is not selected.

config EXAMPLES_MOUNT_RAMDEVNO
	int "RAM disk device number"
	default 0
	---help---
		The RAM device minor number used to mount the RAM disk used when
		EXAMPLES_MOUNT_BLOCKDEVICE is not selected.  The default is zero
		(meaning that "/dev/ram0" will be used).

endif # !EXAMPLES_MOUNT_BLOCKDEVICE
endif # EXAMPLES_MOUNT
```

## examples/mqttc/Kconfig
```kconfig
#
# For a description of the syntax of this configuration file,
# see the file kconfig-language.txt in the NuttX tools repository.
#

config EXAMPLES_MQTTC
	tristate "Enable MQTT-C Example"
	default n
	depends on NETUTILS_MQTTC
	---help---
		Enable a simple MQTT-C publisher example

if EXAMPLES_MQTTC

config EXAMPLES_MQTTC_PROGNAME
	string "Program name"
	default "mqttc_pub"

config EXAMPLES_MQTTC_SUB
	bool "Enable MQTT-C Subscriber Client"
	default n
	---help---
		Enable a simple MQTT-C subscriber example alongside publisher

config EXAMPLES_MQTTC_SUB_PROGNAME
	string "Subscriber program name"
	default "mqttc_sub"
	depends on EXAMPLES_MQTTC_SUB

config EXAMPLES_MQTTC_STACKSIZE
	int "Task's stack size"
	default 8192

config EXAMPLES_MQTTC_TXSIZE
	int "TX Buffer size"
	default 256

config EXAMPLES_MQTTC_RXSIZE
	int "RX Buffer size"
	default 256

config MQTT_USE_MBEDTLS
	bool
	default n

config EXAMPLES_MQTTC_MBEDTLS
	bool "Enable MQTT over TLS (mbedTLS)"
	default n
	depends on NETUTILS_MQTTC_WITH_MBEDTLS
	select MQTT_USE_MBEDTLS
	---help---
		Enable TLS/SSL support for MQTT connections using mbedTLS.
		Requires NETUTILS_MQTTC_WITH_MBEDTLS to be enabled.

config EXAMPLES_MQTTC_ALLOW_UNVERIFIED_TLS
	bool "Allow unverified TLS"
	default n
	---help---
		Do not fail TLS connection if certificate verification fails. Usually
		this is useful during development when connection to server with
		self-signed certificates

endif
```

## examples/mqttc_mbedtls/Kconfig
```kconfig
#
# For a description of the syntax of this configuration file,
# see the file kconfig-language.txt in the NuttX tools repository.
#

config EXAMPLES_MQTTC_MBEDTLS
	tristate "Enable MQTT-C Example with MbedTLS support"
	default n
	depends on NETUTILS_MQTTC_WITH_MBEDTLS
	---help---
		Enable a MQTT-C publisher example with MbedTLS support

if EXAMPLES_MQTTC_MBEDTLS

config EXAMPLES_MQTTC_MBEDTLS_PROGNAME
	string "Program name"
	default "mqttc_mbedtls_pub"

config EXAMPLES_MQTTC_MBEDTLS_STACKSIZE
	int "Task's stack size"
	default 8192

config EXAMPLES_MQTTC_MBEDTLS_TXSIZE
	int "TX Buffer size"
	default 256

config EXAMPLES_MQTTC_MBEDTLS_RXSIZE
	int "RX Buffer size"
	default 256

endif
```

## examples/mtdrwb/Kconfig
```kconfig
#
# For a description of the syntax of this configuration file,
# see the file kconfig-language.txt in the NuttX tools repository.
#

config EXAMPLES_MTDRWB
	tristate "MTD R/W buffer test"
	default n
	depends on (MTD_WRBUFFER || MTD_READAHEAD) && BUILD_FLAT
	---help---
		Enable the MTD R/W buffer test example.

		NOTE: This example uses some internal NuttX interfaces and, hence,
		is not available in the kernel build.

if EXAMPLES_MTDRWB

config EXAMPLES_MTDRWB_PROGNAME
	string "Program name"
	default "mtdrwb"
	---help---
		This is the name of the program that will be used when the NSH ELF
		program is installed.

config EXAMPLES_MTDRWB_ARCHINIT
	bool "Architecture-specific initialization"
	default n
	---help---
		The default is to use the RAM MTD device at drivers/mtd/rammtd.c.
		But an architecture-specific MTD driver can be used instead by
		defining EXAMPLES_MTDRWB_ARCHINIT.  In this case, the
		initialization logic will call mtdrwb_archinitialize() to obtain
		the MTD driver instance.

if !EXAMPLES_MTDRWB_ARCHINIT

config EXAMPLES_MTDRWB_ERASESIZE
	int "Size of one erase blocks (simulated)"
	default 4096
	depends on !EXAMPLES_MTDRWB_ARCHINIT
	---help---
		When EXAMPLES_MTDRWB_ARCHINIT is not defined, this test will use
		the RAM MTD device at drivers/mtd/rammtd.c to simulate FLASH.  In
		this case, this value must be provided to give the size of one erase
		simulated erase blocks one MTD RAM device.

		The size of the allocated RAM drive will be:

			EXAMPLES_MTDRWB_ERASESIZE * EXAMPLES_MTDRWB_NEBLOCKS

config EXAMPLES_MTDRWB_NEBLOCKS
	int "Number of erase blocks (simulated)"
	default 32
	depends on !EXAMPLES_MTDRWB_ARCHINIT
	---help---
		When EXAMPLES_MTDRWB_ARCHINIT is not defined, this test will use
		the RAM MTD device at drivers/mtd/rammtd.c to simulate FLASH.  In
		this case, this value must be provided to give the number of erase
		blocks in MTD RAM device.

		The size of the allocated RAM drive will be:

			EXAMPLES_MTDRWB_ERASESIZE * EXAMPLES_MTDRWB_NEBLOCKS

endif # EXAMPLES_MTDRWB_ARCHINIT
endif # EXAMPLES_MTDRWB
```

## examples/netlink_route/Kconfig
```kconfig
#
# For a description of the syntax of this configuration file,
# see the file kconfig-language.txt in the NuttX tools repository.
#

config EXAMPLES_NETLINK_ROUTE
	tristate "Netlink NETLINK_ROUTE test"
	default n
	depends on NETLINK_ROUTE
	---help---
		Enable the Netlink NETLINK_ROUTE test

if EXAMPLES_NETLINK_ROUTE

config EXAMPLES_NETLINK_ROUTE_PROGNAME
	string "Program name"
	default "netlink_route"
	---help---
		This is the name of the program that will be used when the NSH ELF
		program is installed.

config EXAMPLES_NETLINK_ROUTE_PRIORITY
	int "Task priority"
	default 100

config EXAMPLES_NETLINK_ROUTE_STACKSIZE
	int "Stack size"
	default DEFAULT_TASK_STACKSIZE

endif
```

## examples/netloop/Kconfig
```kconfig
#
# For a description of the syntax of this configuration file,
# see the file kconfig-language.txt in the NuttX tools repository.
#

config EXAMPLES_NETLOOP
	tristate "Local loopback example"
	default n
	depends on NET_LOOPBACK && NET_TCP && NET_TCPBACKLOG && NET_TCP_WRITE_BUFFERS && NET_IPv4
	---help---
		Enable the local loopback example

if EXAMPLES_NETLOOP

config EXAMPLES_NETLOOP_KEEPALIVE
	bool "Enable TCP KeepAlive test"
	default n
	depends on NET_TCP_KEEPALIVE

config EXAMPLES_NETLOOP_STACKSIZE
	int "Loopback test stack size"
	default DEFAULT_TASK_STACKSIZE

config EXAMPLES_NETLOOP_PRIORITY
	int "Loopback test task priority"
	default 100

endif # EXAMPLES_NETLOOP
```

## examples/netpkt/Kconfig
```kconfig
#
# For a description of the syntax of this configuration file,
# see the file kconfig-language.txt in the NuttX tools repository.
#

config EXAMPLES_NETPKT
	tristate "Network packet socket example"
	default n
	depends on NET_PKT
	---help---
		Enable the network packet socket example

if EXAMPLES_NETPKT
endif
```
