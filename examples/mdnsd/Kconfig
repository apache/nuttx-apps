## examples/nimble/Kconfig
```kconfig
#
# For a description of the syntax of this configuration file,
# see the file kconfig-language.txt in the NuttX tools repository.
#

config EXAMPLES_NIMBLE
	tristate "NimBLE example"
	default n
	---help---
		Enable the nimble example

if EXAMPLES_NIMBLE

config EXAMPLES_NIMBLE_PROGNAME
	string "Program name"
	default "nimble"
	---help---
		This is the name of the program that will be used when the NSH ELF
		program is installed.

config EXAMPLES_NIMBLE_PRIORITY
	int "NimBLE task priority"
	default 100

config EXAMPLES_NIMBLE_STACKSIZE
	int "NimBLE stack size"
	default DEFAULT_TASK_STACKSIZE

endif # EXAMPLES_NIMBLE
```

## examples/nimble_blecent/Kconfig
```kconfig
#
# For a description of the syntax of this configuration file,
# see the file kconfig-language.txt in the NuttX tools repository.
#

config EXAMPLES_NIMBLE_BLECENT
	tristate "NimBLE central"
	default n
	---help---
		Enable the nimble central example

if EXAMPLES_NIMBLE_BLECENT

config EXAMPLES_NIMBLE_BLECENT_PROGNAME
	string "Program name"
	default "blecent"
	---help---
		This is the name of the program that will be used when the NSH ELF
		program is installed.

config EXAMPLES_NIMBLE_BLECENT_PRIORITY
	int "NimBLE task priority"
	default 100

config EXAMPLES_NIMBLE_BLECENT_STACKSIZE
	int "NimBLE stack size"
	default DEFAULT_TASK_STACKSIZE

endif # EXAMPLES_NIMBLE_BLECENT
```

## examples/nimble_bleprph/Kconfig
```kconfig
#
# For a description of the syntax of this configuration file,
# see the file kconfig-language.txt in the NuttX tools repository.
#

config EXAMPLES_NIMBLE_BLEPRPH
	tristate "NimBLE peripheral"
	default n
	---help---
		Enable the nimble peripheral example

if EXAMPLES_NIMBLE_BLEPRPH

config EXAMPLES_NIMBLE_BLEPRPH_PROGNAME
	string "Program name"
	default "bleprph"
	---help---
		This is the name of the program that will be used when the NSH ELF
		program is installed.

config EXAMPLES_NIMBLE_BLEPRPH_PRIORITY
	int "NimBLE task priority"
	default 100

config EXAMPLES_NIMBLE_BLEPRPH_STACKSIZE
	int "NimBLE stack size"
	default DEFAULT_TASK_STACKSIZE

endif # EXAMPLES_NIMBLE_BLEPRPH
```

## examples/nng_test/Kconfig
```kconfig
#
# For a description of the syntax of this configuration file,
# see the file kconfig-language.txt in the NuttX tools repository.
#

config EXAMPLES_NNG_TEST
	bool "NNG pubsub program"
	default n
	---help---
		Enable the NNG pubsub program

if EXAMPLES_NNG_TEST

config EXAMPLES_NNG_TEST_STACKSIZE
	int "NNG pubsub stack size"
	default DEFAULT_TASK_STACKSIZE

config EXAMPLES_NNG_TEST_PRIORITY
	int "NNG pubsub task priority"
	default 50

endif
```

## examples/notedump/Kconfig
```kconfig
#
# For a description of the syntax of this configuration file,
# see the file kconfig-language.txt in the NuttX tools repository.
#

config EXAMPLES_NOTEDUMP
	tristate "Note dump example"
	default n
	depends on SCHED_INSTRUMENTATION_DUMP && NET_UDP
	---help---
		Enable the Note dump example

if EXAMPLES_NOTEDUMP

config EXAMPLES_NOTEDUMP_PROGNAME
	string "Program name"
	default "notedump"
	---help---
		This is the name of the program that will be used when the NSH ELF
		program is installed.

config EXAMPLES_NOTEDUMP_PRIORITY
	int "Note dump task priority"
	default 100

config EXAMPLES_NOTEDUMP_STACKSIZE
	int "Note dump stack size"
	default DEFAULT_TASK_STACKSIZE

endif
```

## examples/noteprintf/Kconfig
```kconfig
#
# For a description of the syntax of this configuration file,
# see the file kconfig-language.txt in the NuttX tools repository.
#

config EXAMPLES_NOTEPRINTF
	tristate "\"Note printf!\" example"
	default n
	depends on SCHED_INSTRUMENTATION_DUMP
	---help---
		Enable the \"Note printf!\" example

if EXAMPLES_NOTEPRINTF

config EXAMPLES_NOTEPRINTF_PROGNAME
	string "Program name"
	default "noteprintf"
	---help---
		This is the name of the program that will be used when the NSH ELF
		program is installed.

config EXAMPLES_NOTEPRINTF_PRIORITY
	int "Note printf task priority"
	default 100

config EXAMPLES_NOTEPRINTF_STACKSIZE
	int "Note printf stack size"
	default DEFAULT_TASK_STACKSIZE

endif
```
