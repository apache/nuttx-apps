## examples/nrf24l01_btle/Kconfig
```kconfig
#
# For a description of the syntax of this configuration file,
# see the file kconfig-language.txt in the NuttX tools repository.
#

config EXAMPLES_NRF24L01_BTLE
	tristate "Use nRF24L01 emulates a nRF8001 temperature beacon"
	default n
	depends on DRIVERS_WIRELESS
	---help---
		Emulates a nRF8001 temperature beacon,reads temperature
		from a DHT11 and sends it via BTLE.Compatible with Nordic
		Semiconductor apps such as nRF Master Control Panel or
		nRF Temp 2.0.

if EXAMPLES_NRF24L01_BTLE

config EXAMPLES_NRF24L01_BTLE_PROGNAME
	string "Program name"
	default "btle"
	---help---
		This is the name of the program that will be used when the NSH ELF
		program is installed.

config EXAMPLES_NRF24L01_BTLE_PRIORITY
	int "Dhtxx task priority"
	default 100

config EXAMPLES_NRF24L01_BTLE_STACKSIZE
	int "Dhtxx stack size"
	default DEFAULT_TASK_STACKSIZE

config EXAMPLES_NRF24L01_BTLE_RAND_MAC
	bool "Use the Rand() to generate MAC"
	default n

config NRF24L01_BTLE_DHT11
	tristate "Use the DHTxx humidity/temperature sensor."
	default n
	depends on SENSORS_DHTXX
	---help---
	    Enable driver support for the DHTxx humidity/temperature sensor.

endif
```

## examples/nrf24l01_term/Kconfig
```kconfig
#
# For a description of the syntax of this configuration file,
# see the file kconfig-language.txt in the NuttX tools repository.
#

config EXAMPLES_NRF24L01TERM
	tristate "Basic nRF24L01 terminal"
	default n
	depends on DRIVERS_WIRELESS

if EXAMPLES_NRF24L01TERM
endif
```

## examples/nsh/Kconfig
```kconfig
#
# For a description of the syntax of this configuration file,
# see the file kconfig-language.txt in the NuttX tools repository.
#

config EXAMPLES_NSH
	bool "NuttShell (NSH) example"
	default n
	select NSH_LIBRARY
	select SYSTEM_READLINE
	---help---
		Enable the NuttShell (NSH) example

if EXAMPLES_NSH

config EXAMPLES_NSH_SYMTAB
	bool "Register symbol table"
	default n
	depends on LIBC_EXECFUNCS && LIB_BOARDCTL && !EXECFUNCS_HAVE_SYMTAB
	select BOARDCTL_APP_SYMTAB
	---help---
		Enable logic to automatically register an application symbol table
		as part of NSH initialization.  If enabled, then application logic
		must provide the following:

			const struct symtab_s g_exports[];
			const int g_nexports;

		Where g_exports is the name of the exported application symbol table
		and g_nexports holds the number of entries in the application symbol
		table.

config EXAMPLES_NSH_PROGNAME
	string "Program name"
	default "nsh"
	depends on BUILD_KERNEL
	---help---
		This is the name of the program that will be use when the NSH ELF
		program is installed.

config EXAMPLES_NSH_CXXINITIALIZE
	bool "C++ Initialization"
	default n
	depends on HAVE_CXX && HAVE_CXXINITIALIZE
	---help---
		If HAVE_CXX and HAVE_CXXINITIALIZE are slected, then this NSH
		example can be configured to initialize C++ constructors when it
		is started.  NSH does not use C++ and, by default, assumes that
		constructors are initialized elsewhere.  However, you can force
		NSH to initialize constructors by setting this option.

endif
```

## examples/null/Kconfig
```kconfig
#
# For a description of the syntax of this configuration file,
# see the file kconfig-language.txt in the NuttX tools repository.
#

config EXAMPLES_NULL
	tristate "NULL example"
	default n
	---help---
		Enable the NULL example

if EXAMPLES_NULL
endif
```

## examples/nunchuck/Kconfig
```kconfig
#
# For a description of the syntax of this configuration file,
# see the file kconfig-language.txt in the NuttX tools repository.
#

config EXAMPLES_NUNCHUCK
	tristate "Nunchuck joystick example"
	default n
	depends on INPUT_NUNCHUCK
	---help---
		Enable the nunchuck joystick example

if EXAMPLES_NUNCHUCK

config EXAMPLES_NUNCHUCK_DEVNAME
	string "Joystick device name"
	default "/dev/nunchuck0"

endif
```

## examples/nxconsole/Kconfig
```kconfig
#
# For a description of the syntax of this configuration file,
# see misc/tools/kconfig-language.txt.
#

config EXAMPLES_NXTERM
	bool "NxConsole example"
	default n
	---help---
		Enable the NxConsole example

if EXAMPLES_NXTERM
endif
```

## examples/nxdemo/Kconfig
```kconfig
#
# For a description of the syntax of this configuration file,
# see the file kconfig-language.txt in the NuttX tools repository.
#

config EXAMPLES_NXDEMO
	bool "NX Demo \"Graphic test\" example"
	default n
	---help---
		Enable the NX graphics \"Demo Test\" example

if EXAMPLES_NXDEMO

config EXAMPLES_NXDEMO_VPLANE
	int "Video Plane"
	default 0
	---help---
		The plane to select from the framebuffer driver for use in the test.
		Default: 0

config EXAMPLES_NXDEMO_DEVNO
	int "Video Device Number"
	default 0
	---help---
		The LCD device to select from the LCD driver for use in the test:
		Default: 0

config EXAMPLES_NXDEMO_BPP
	int "Bits-Per-Pixel"
	default 1
	---help---
		Pixels per pixel to use.  Valid options include 1, 2, 4, 8, 16, 24,
		and 32.  Default is 32.


comment "Example Color Configuration"

config EXAMPLES_NXDEMO_DEFAULT_COLORS
	bool "Use Default Colors"
	default y

if !EXAMPLES_NXDEMO_DEFAULT_COLORS

config EXAMPLES_NXDEMO_BGCOLOR
	hex "Background color"
	default 0x0
	---help---
		The color of the background.  Default depends on config
		EXAMPLES_NXDEMO_BPP.

endif

config EXAMPLES_NXDEMO_EXTERNINIT
	bool "External Device Initialization"
	default n
	depends on LIB_BOARDCTL
	select BOARDCTL_GRAPHICS
	---help---
		The driver for the graphics device on this platform requires some
		unusual initialization.  This is the case, for example, for SPI LCD/OLED
		devices.  If this configuration is selected, then the platform code
		must provide an LCD initialization function with a prototype like:

		#ifdef CONFIG_NX_LCDDRIVER
		FAR struct lcd_dev_s *board_graphics_setup(unsigned int devno);
		#else
		FAR struct fb_vtable_s *board_graphics_setup(unsigned int devno);
		#endif

		and must also define: CONFIG_LIB_BOARDCTL=y and
		CONFIG_BOARDCTL_GRAPHICS=y so that the boardctl() interface
		will be available in order to access this function.

endif
```

## examples/nxffs/Kconfig
```kconfig
#
# For a description of the syntax of this configuration file,
# see misc/tools/kconfig-language.txt.
#

config EXAMPLES_NXFFS
	bool "NXFFS file system example"
	default n
	---help---
		Enable the NXFFS file system example

if EXAMPLES_NXFFS

config EXAMPLES_NXFFS_ARCHINIT
	bool "Architecture-specific initialization"
	default n
	---help---
		The default is to use the RAM MTD device at drivers/mtd/rammtd.c.
		But an architecture-specific MTD driver can be used instead by
		defining EXAMPLES_NXFFS_ARCHINIT.  In this case, the
		initialization logic will call mtdpart_archinitialize() to obtain
		the MTD driver instance.

config EXAMPLES_NXFFS_NEBLOCKS
	int "Number of erase blocks (simulated)"
	default 32
	depends on !EXAMPLES_NXFFS_ARCHINIT
	---help---
		When EXAMPLES_NXFFS_ARCHINIT is not defined, this test will use
		the RAM MTD device at drivers/mtd/rammtd.c to simulate FLASH.  In
		this case, this value must be provided to give the nubmer of erase
		blocks in MTD RAM device.

		The size of the allocated RAM drive will be:

			RAMMTD_ERASESIZE * EXAMPLES_NXFFS_NEBLOCKS

config EXAMPLES_NXFFS_MAXNAME
	int "Max name size"
	default 128
	range 1 255
	---help---
		Determines the maximum size of names used in the filesystem

	config EXAMPLES_NXFFS_MAXFILE
	int "Max file size"
	default 8192
	---help---
		Determines the maximum size of a file

config EXAMPLES_NXFFS_MAXIO
	int "Max I/O"
	default 347

config EXAMPLES_NXFFS_MAXOPEN
	int "Max open files"
	default 512

config EXAMPLES_NXFFS_MOUNTPT
	string "NXFFS mountpoint"
	default "/mnt/nxffs"

config EXAMPLES_NXFFS_NLOOPS
	int "Number of test loops"
	default 100

config EXAMPLES_NXFFS_VERBOSE
	bool "Verbose output"
	default n

endif
```

## examples/nxflat/Kconfig
```kconfig
#
# For a description of the syntax of this configuration file,
# see the file kconfig-language.txt in the NuttX tools repository.
#

config EXAMPLES_NXFLAT
	tristate "NXFLAT example"
	default n
	select LIBC_EXECFUNCS
	depends on NXFLAT
	---help---
		Enable the NXFLAT example

if EXAMPLES_NXFLAT
endif
```

## examples/nxhello/Kconfig
```kconfig
#
# For a description of the syntax of this configuration file,
# see the file kconfig-language.txt in the NuttX tools repository.
#

config EXAMPLES_NXHELLO
	bool "NX graphics \"Hello, World!\" example"
	default n
	depends on NX
	select LIB_BOARDCTL
	---help---
		Enable the NX graphics \"Hello, World!\" example

if EXAMPLES_NXHELLO

config EXAMPLES_NXHELLO_PROGNAME
	string "NX Hello Program name"
	default "nxhello"
	depends on BUILD_LOADABLE
	---help---
		This is the name of the program that will be use when the NSH ELF
		program is installed.

config EXAMPLES_NXHELLO_PRIORITY
	int "NX Hello task priority"
	default 100

config EXAMPLES_NXHELLO_STACKSIZE
	int "NX Hello stack size"
	default 2048

config EXAMPLES_NXHELLO_BPP
	int "Bits-Per-Pixel"
	default 32
	---help---
		Pixels per pixel to use.  Valid options include 1, 2, 4, 8, 16, 24,
		and 32.  Default is 32.

comment "Example Color Configuration"

config EXAMPLES_NXHELLO_DEFAULT_COLORS
	bool "Use Default Colors"
	default y

if !EXAMPLES_NXHELLO_DEFAULT_COLORS

config EXAMPLES_NXHELLO_BGCOLOR
	hex "Background color"
	default 0x0
	---help---
		The color of the background.  Default depends on config
		EXAMPLES_NXHELLO_BPP.

config EXAMPLES_NXHELLO_FONTCOLOR
	hex "Background font color"
	default 0x0
	---help---
		The color of the fonts used in the background window. Default
		depends on config EXAMPLES_NXHELLO_BPP.

endif

comment "Example Font Configuration"

config EXAMPLES_NXHELLO_DEFAULT_FONT
	bool "Use Default Font"
	default y

if !EXAMPLES_NXHELLO_DEFAULT_FONT

config EXAMPLES_NXHELLO_FONTID
	int "Background font ID"
	default 0
	---help---
		Selects the font used in the background window (see font ID numbers
		in include/nuttx/nx/nxfonts.h)

endif

comment "NX Server Options"

config EXAMPLES_NXHELLO_LISTENER_STACKSIZE
	int "NX Server/Listener Stack Size"
	default 2048
	---help---
		The stacksize to use when creating the NX server.  Default 2048

config EXAMPLES_NXHELLO_CLIENTPRIO
	int "Client Priority"
	default 100
	---help---
		The client priority.  Default: 100

config EXAMPLES_NXHELLO_SERVERPRIO
	int "Server Priority"
	default 120
	---help---
		The server priority.  Default: 120

config EXAMPLES_NXHELLO_LISTENERPRIO
	int "Listener Priority"
	default 80
	---help---
		The priority of the event listener thread. Default 80.

config EXAMPLES_NXHELLO_NOTIFYSIGNO
	int "Notify Signal Number"
	default 4
	---help---
		The signal number to use with nx_eventnotify().  Default: 4

endif
```

## examples/nximage/Kconfig
```kconfig
#
# For a description of the syntax of this configuration file,
# see the file kconfig-language.txt in the NuttX tools repository.
#

config EXAMPLES_NXIMAGE
	bool "NX graphics image example"
	default n
	depends on NX
	select LIB_BOARDCTL
	---help---
		Enable the X graphics image example

if EXAMPLES_NXIMAGE

config EXAMPLES_NXIMAGE_PROGNAME
	string "NX Image Program name"
	default "nxhello"
	depends on BUILD_LOADABLE
	---help---
		This is the name of the program that will be use when the NSH ELF
		program is installed.

config EXAMPLES_NXIMAGE_PRIORITY
	int "NX Image task priority"
	default 100

config EXAMPLES_NXIMAGE_STACKSIZE
	int "NX Image stack size"
	default 2048

config EXAMPLES_NXIMAGE_BPP
	int "Bits-Per-Pixel"
	default 32
	---help---
		Pixels per pixel to use.  Valid options include 1, 2, 4, 8, 16, 24,
		and 32.  Default is 32.

config EXAMPLES_NXIMAGE_GREYSCALE
	bool "Greyscale (vs RGB)"
	default n
	---help---
		Select to use a greyscale vs RGB color image.  This option is ignored if
		CONFIG_EXAMPLES_NXIMAGE_BPP > 8

config EXAMPLES_NXIMAGE_XSCALEp5
	bool "Scale X by 50%"
	default n
	---help---
		Reduce image scale by 50% of its original size.

config EXAMPLES_NXIMAGE_XSCALE1p0
	bool "Don't scale image."
	default y
	---help---
		Keep original image size.

config EXAMPLES_NXIMAGE_XSCALE1p5
	bool "Scale X by 150%"
	default n
	---help---
		Increase image scale by 50% of its original size.

config EXAMPLES_NXIMAGE_XSCALE2p0
	bool "Scale X by 200%"
	default n
	---help---
		Increase image scale by 200% of its original size.

config EXAMPLES_NXIMAGE_YSCALEp5
	bool "Scale Y by 50%"
	default n
	---help---
		Reduce image scale by 50% of its original size.

config EXAMPLES_NXIMAGE_YSCALE1p0
	bool "Don't scale image."
	default y
	---help---
		Keep original image size.

config EXAMPLES_NXIMAGE_YSCALE1p5
	bool "Scale Y by 150%"
	default n
	---help---
		Increase image scale by 50% of its original size.

config EXAMPLES_NXIMAGE_YSCALE2p0
	bool "Scale Y by 200%"
	default n
	---help---
		Increase image scale by 200% of its original size.

comment "NX Server Options"

config EXAMPLES_NXIMAGE_LISTENER_STACKSIZE
	int "NX Server/Listener Stack Size"
	default 2048
	---help---
		The stacksize to use when creating the NX server.  Default 2048

config EXAMPLES_NXIMAGE_CLIENTPRIO
	int "Client Priority"
	default 100
	---help---
		The client priority.  Default: 100

config EXAMPLES_NXIMAGE_SERVERPRIO
	int "Server Priority"
	default 120
	---help---
		The server priority.  Default: 120

config EXAMPLES_NXIMAGE_LISTENERPRIO
	int "Listener Priority"
	default 80
	---help---
		The priority of the event listener thread. Default 80.

config EXAMPLES_NXIMAGE_NOTIFYSIGNO
	int "Notify Signal Number"
	default 4
	---help---
		The signal number to use with nx_eventnotify().  Default: 4

endif
```
