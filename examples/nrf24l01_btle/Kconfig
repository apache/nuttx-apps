## examples/nxlines/Kconfig
```kconfig
#
# For a description of the syntax of this configuration file,
# see the file kconfig-language.txt in the NuttX tools repository.
#

config EXAMPLES_NXLINES
	bool "NX graphics lines example"
	default n
	depends on NX
	select LIB_BOARDCTL
	---help---
		Enable the X graphics lines example

if EXAMPLES_NXLINES

config EXAMPLES_NXLINES_PROGNAME
	string "NX lines program name"
	default "nxhello"
	depends on BUILD_LOADABLE
	---help---
		This is the name of the program that will be use when the NSH ELF
		program is installed.

config EXAMPLES_NXLINES_PRIORITY
	int "NX lines task priority"
	default 100

config EXAMPLES_NXLINES_STACKSIZE
	int "NX lines stack size"
	default 2048

config EXAMPLES_NXLINES_DEFAULT_COLORS
	bool "Use default colors"
	default y
	---help---
		Select this option to let the NXLINES example pick the colors.  Otherwise,
		you may select the exact colors to use in hex format.

config EXAMPLES_NXLINES_BGCOLOR
	hex "Background Color"
	default 0x00
	depends on !EXAMPLES_NXLINES_DEFAULT_COLORS
	---help---
		The color of the background.  Default depends on EXAMPLES_NXLINES_BPP.

config EXAMPLES_NXLINES_LINEWIDTH
	int "Line Width"
	default 16
	---help---
		Selects the width of the lines in pixels (default: 16)

config EXAMPLES_NXLINES_LINECOLOR
	hex "Line Color"
	default 0x00
	depends on !EXAMPLES_NXLINES_DEFAULT_COLORS
	---help---
		The color of the central lines drawn in the background window. Default
		depends on EXAMPLES_NXLINES_BPP (there really is no meaningful default).

config EXAMPLES_NXLINES_BORDERWIDTH
	int "Border Width"
	default 16
	---help---
		The width of the circular border drawn in the background window. (default: 16).

config EXAMPLES_NXLINES_BORDERCOLOR
	hex "Border Color"
	default 0x00
	depends on !EXAMPLES_NXLINES_DEFAULT_COLORS
	---help---
		The color of the circular border drawn in the background window. Default
		depends on EXAMPLES_NXLINES_BPP (there really is no meaningful default).

config EXAMPLES_NXLINES_CIRCLECOLOR
	hex "Circle Color"
	default 0x00
	depends on !EXAMPLES_NXLINES_DEFAULT_COLORS
	---help---
		The color of the circular region filled in the background window. Default
		depends on EXAMPLES_NXLINES_BPP (there really is no meaningful default).

config EXAMPLES_NXLINES_BPP
	int "Bits Per Pixel"
	default 8
	---help---
		Pixels per pixel to use.  Valid options include 2, 4, 8, 16, 24, and 32.
		Default is 16.

comment "NX Server Options"

config EXAMPLES_NXLINES_LISTENER_STACKSIZE
	int "NX Server/Listener Stack Size"
	default 2048
	---help---
		The stacksize to use when creating the NX server.  Default 2048

config EXAMPLES_NXLINES_CLIENTPRIO
	int "Client Priority"
	default 100
	---help---
		The client priority.  Default: 100

config EXAMPLES_NXLINES_SERVERPRIO
	int "Server Priority"
	default 120
	---help---
		The server priority.  Default: 120

config EXAMPLES_NXLINES_LISTENERPRIO
	int "Listener Priority"
	default 80
	---help---
		The priority of the event listener thread. Default 80.

config EXAMPLES_NXLINES_NOTIFYSIGNO
	int "Notify Signal Number"
	default 4
	---help---
		The signal number to use with nx_eventnotify().  Default: 4

endif
```

## examples/nxmbserver/Kconfig
```kconfig
#
# For a description of the syntax of this configuration file,
# see the file kconfig-language.txt in the NuttX tools repository.
#

config EXAMPLES_NXMBSERVER
	tristate "NxModbus Server Example"
	default n
	depends on NXMODBUS_SERVER
	---help---
		Enable the NxModbus server example. This example demonstrates
		how to create a Modbus server (slave) that responds to client
		requests. Supports RTU, ASCII, and TCP transports with simulated
		register data.

if EXAMPLES_NXMBSERVER

config EXAMPLES_NXMBSERVER_PROGNAME
	string "Program name"
	default "nxmbserver"
	---help---
		This is the name of the program that will be used when the NSH ELF
		program is installed.

config EXAMPLES_NXMBSERVER_PRIORITY
	int "NxModbus server task priority"
	default 100

config EXAMPLES_NXMBSERVER_STACKSIZE
	int "NxModbus server stack size"
	default DEFAULT_TASK_STACKSIZE

endif # EXAMPLES_NXMBSERVER
```

## examples/nxscope/Kconfig
```kconfig
#
# For a description of the syntax of this configuration file,
# see the file kconfig-language.txt in the NuttX tools repository.
#

config EXAMPLES_NXSCOPE
	tristate "nxscope example"
	default n
	depends on LOGGING_NXSCOPE
	---help---
		Enable the nxscope example

if EXAMPLES_NXSCOPE

config EXAMPLES_NXSCOPE_PROGNAME
	string "Program name"
	default "nxscope"

config EXAMPLES_NXSCOPE_PRIORITY
	int "nxscope task priority"
	default 100

config EXAMPLES_NXSCOPE_STACKSIZE
	int "nxscope stack size"
	default DEFAULT_TASK_STACKSIZE

if LOGGING_NXSCOPE_INTF_SERIAL

config EXAMPLES_NXSCOPE_SERIAL_PATH
	string "nxscope serial path"
	default "/dev/ttyUSB0"

config EXAMPLES_NXSCOPE_SERIAL_BAUD
	int "nxscope serial baud"
	default 115200
	---help---
		Ignored if set to 0 (for example for RTT interface)

config EXAMPLES_NXSCOPE_CDCACM
	bool "nxscope CDCACM device support"
	depends on CDCACM
	default n

endif # LOGGING_NXSCOPE_INTF_SERIAL

config EXAMPLES_NXSCOPE_FORCE_ENABLE
	bool "nxscope force enable"
	default n

config EXAMPLES_NXSCOPE_STREAMBUF_LEN
	int "nxscope stream buffer length"
	default 512

config EXAMPLES_NXSCOPE_RXBUF_LEN
	int "nxscope RX buffer length"
	default 32

config EXAMPLES_NXSCOPE_CHARLOG
	bool "nxscope send text message over channel 19"
	default n

config EXAMPLES_NXSCOPE_CRIBUF_LEN
	int "nxscope critical channels buffer length"
	default 32
	depends on LOGGING_NXSCOPE_CRICHANNELS

config EXAMPLES_NXSCOPE_RX_PADDING
	int "nxscope RX padding"
	default 0

config EXAMPLES_NXSCOPE_TIMER
	bool "nxscope use timer to wake up samples thread"
	default n

config EXAMPLES_NXSCOPE_MAIN_INTERVAL
	int "nxscope main interval (microseconds)"
	default 100000
	---help---
		This value is responsible for the frequency at which stream
		frames will be sent and incoming frames will be received.

if EXAMPLES_NXSCOPE_TIMER

config EXAMPLES_NXSCOPE_TIMER_PATH
	string "nxscope timer path"
	default "/dev/timer0"

config EXAMPLES_NXSCOPE_TIMER_SIGNO
	int "nxscope notification signal number"
	default 32

config EXAMPLES_NXSCOPE_TIMER_INTERVAL
	int "nxscope timer interval (microseconds)"
	default 100

endif # EXAMPLES_NXSCOPE_TIMER

endif
```

## examples/nxtext/Kconfig
```kconfig
#
# For a description of the syntax of this configuration file,
# see the file kconfig-language.txt in the NuttX tools repository.
#

config EXAMPLES_NXTEXT
	tristate "NX graphics text example"
	default n
	depends on NX
	---help---
		Enable the NX graphics text example

if EXAMPLES_NXTEXT

comment "Basic Configuration of the example"

config EXAMPLES_NXTEXT_BPP
	int "Bits-Per-Pixel"
	default 32
	---help---
		Pixels per pixel to use.  Valid options include 2, 4, 8, 16, 24,
		and 32.  Default is 32.

config EXAMPLES_NXTEXT_BMCACHE
	int "Character cache size"
	default 128
	---help---
		Size of the character cache.

config EXAMPLES_NXTEXT_GLCACHE
	int "Glyph cache size"
	default 16
	---help---
		Size of the glyph cache.

config EXAMPLES_NXTEXT_LINESPACING
	int "Line spacing"
	default 2
	range 0 4
	---help---
		The vertical distance between lines is the sum of (1) the vertical
		bounding box dimension of the font, and (2) this additional line
		space.  This value may be zero, but not negative.

comment "Example Color Configuration"

config EXAMPLES_NXTEXT_DEFAULT_COLORS
	bool "Use Default Colors"
	default y

if !EXAMPLES_NXTEXT_DEFAULT_COLORS

config EXAMPLES_NXTEXT_BGCOLOR
	hex "Background color"
	default 0x0
	---help---
		The color of the background.  Default depends on config
		EXAMPLES_NXTEXT_BPP.

config EXAMPLES_NXTEXT_BGFONTCOLOR
	hex "Background font color"
	default 0x0
	---help---
		The color of the fonts used in the background window. Default
		depends on config EXAMPLES_NXTEXT_BPP.

config EXAMPLES_NXTEXT_PUCOLOR
	hex "Pop-up color"
	default 0x0
	---help---
		The color of the pop-up window.  Default depends on config
		EXAMPLES_NXTEXT_BPP.

config EXAMPLES_NXTEXT_PUFONTCOLOR
	hex "Pop-up font color"
	default 0x0
	---help---
		The color of the fonts used in the pop-up window. Default
		depends on config EXAMPLES_NXTEXT_BPP.

endif # !EXAMPLES_NXTEXT_DEFAULT_COLORS

comment "Example Font Configuration"

config EXAMPLES_NXTEXT_DEFAULT_FONT
	bool "Use Default Font"
	default y

if !EXAMPLES_NXTEXT_DEFAULT_FONT

config EXAMPLES_NXTEXT_BGFONTID
	int "Background font ID"
	default 0
	---help---
		Selects the font used in the background window (see font ID numbers
		in include/nuttx/nx/nxfonts.h)

config EXAMPLES_NXTEXT_PUFONTID
	int "Pop-up font ID"
	default 0
	---help---
		Selects the font used in the pop-up window (see font ID numbers
		in include/nuttx/nx/nxfonts.h)

endif # !EXAMPLES_NXTEXT_DEFAULT_FONT

comment "NX Server Options"

config EXAMPLES_NXTEXT_STACKSIZE
	int "Listener Stack Size"
	default DEFAULT_TASK_STACKSIZE
	---help---
		The stacksize to use when starting the NX listener.  Default 2048

config EXAMPLES_NXTEXT_LISTENERPRIO
	int "Listener Priority"
	default 80
	---help---
		The priority of the event listener thread. Default 100.

config EXAMPLES_NXTEXT_CLIENTPRIO
	int "Client Priority"
	default 100
	---help---
		The client priority.  Default: 100

endif # EXAMPLES_NXTEXT
```

## examples/obd2/Kconfig
```kconfig
#
# For a description of the syntax of this configuration file,
# see the file kconfig-language.txt in the NuttX tools repository.
#

config EXAMPLES_OBD2
	tristate "OBD-II application example"
	default n
	select CANUTILS_LIBOBD2
	---help---
		Enable the OBD-II application example.

if EXAMPLES_OBD2

endif
```

## examples/oneshot/Kconfig
```kconfig
#
# For a description of the syntax of this configuration file,
# see the file kconfig-language.txt in the NuttX tools repository.
#

config EXAMPLES_ONESHOT
	tristate "Oneshot timer example"
	default n
	depends on ONESHOT
	---help---
		Enable the oneshot timer driver example

if EXAMPLES_ONESHOT

config EXAMPLES_ONESHOT_DEVNAME
	string "Oneshot time device name"
	default "/dev/oneshot"
	---help---
		This is the default name of the timer device that will be tested if
		one is not specified on the command line.

config EXAMPLES_ONESHOT_DELAY
	int "Sample delay (microseconds)"
	default 2000000
	---help---
		This is the default delay samples in microseconds if one is not
		specified on the command line

config EXAMPLES_ONESHOT_SIGNO
	int "Signal number"
	default 13
	---help---
		This is the number of the signal that will be used in the oneshot
		notification.

config EXAMPLES_ONESHOT_STACKSIZE
	int "Oneshot timer stack size"
	default DEFAULT_TASK_STACKSIZE
	---help---
		This is the stack size allocated when the oneshot timer task runs

config EXAMPLES_ONESHOT_PRIORITY
	int "Oneshot timer task priority"
	default 100
	---help---
		This is the priority of the oneshot timer task

config EXAMPLES_ONESHOT_PROGNAME
	string "Oneshot timer program name"
	default "oneshot"
	---help---
		This is the name of the program that will be used when the NSH ELF
		program is installed.

endif
```

## examples/optee/Kconfig
```kconfig
#
# For a description of the syntax of this configuration file,
# see the file kconfig-language.txt in the NuttX tools repository.
#

config EXAMPLES_OPTEE
	tristate "OP-TEE client example"
	default n
	---help---
		Enable the OP-TEE client example

if EXAMPLES_OPTEE

config EXAMPLES_OPTEE_PROGNAME
	string "Program name"
	default "optee"
	---help---
		This is the name of the program that will be used when the NSH ELF
		program is installed.

config EXAMPLES_OPTEE_PRIORITY
	int "OP-TEE task priority"
	default 100

config EXAMPLES_OPTEE_STACKSIZE
	int "OP-TEE stack size"
	default DEFAULT_TASK_STACKSIZE

endif
```

## examples/optee_gp/Kconfig
```kconfig
#
# For a description of the syntax of this configuration file,
# see the file kconfig-language.txt in the NuttX tools repository.
#

config EXAMPLES_OPTEE_GP
	tristate "OP-TEE GP API client example"
	depends on LIBTEEC
	default n
	---help---
		Enable the OP-TEE GP API client example which uses libteec

if EXAMPLES_OPTEE_GP

config EXAMPLES_OPTEE_GP_PROGNAME
	string "Program name"
	default "optee_gp"
	---help---
		This is the name of the program that will be used when the NSH ELF
		program is installed.

config EXAMPLES_OPTEE_GP_PRIORITY
	int "OP-TEE GP task priority"
	default 100

config EXAMPLES_OPTEE_GP_STACKSIZE
	int "OP-TEE GP stack size"
	default DEFAULT_TASK_STACKSIZE

endif
```

## examples/ostest/Kconfig
```kconfig
#
# For a description of the syntax of this configuration file,
# see the file kconfig-language.txt in the NuttX tools repository.
#

config EXAMPLES_OSTEST
	tristate "OS test example"
	default n
	depends on !DISABLE_SIGNALS
	---help---
		Enable the OS test example

if EXAMPLES_OSTEST

config EXAMPLES_OSTEST_LOOPS
	int "OS test loop"
	default 1
	---help---
		Used to control the number of executions of the test.  If undefined, the test
		executes one time.  If defined to be zero, the test runs forever.

config EXAMPLES_OSTEST_STACKSIZE
	int "OS test stack size"
	default 8192
	---help---
		Size of the stack used to create the ostest task.  Default is 8192.

config EXAMPLES_OSTEST_NBARRIER_THREADS
	int "Number of barrier threads"
	default 8
	---help---
		Specifies the number of threads to create in the barrier test.  The default
		is 8 but a smaller number may be needed on systems without sufficient memory
		to start so many threads.

config EXAMPLES_OSTEST_AIO
	bool "Asynchronous I/O Tests"
	default n
	depends on FS_AIO && FS_WRITABLE
	---help---
		Enables test of asynchronous I/O.  You must have a mounted, writable
		directory in place to use this test.

if EXAMPLES_OSTEST_AIO

config EXAMPLES_OSTEST_AIOPATH
	string "Scratch file path"
	default "/tmp"
	---help---
		This is the location of a directory in a mounted file system that
		the AIO test can write into.

endif

config EXAMPLES_OSTEST_RR_RANGE
	int "Round-robin test - end of search range"
	default 10000
	range 1 32767
	---help---
		During round-robin scheduling test two threads are created. Each of the threads
		searches for prime numbers in the configurable range, doing that configurable
		number of times.

		This value specifies the end of search range and together with number of runs
		allows to configure the length of this test - it should last at least a few
		tens of seconds. Allowed values [1; 32767], default 10000

config EXAMPLES_OSTEST_RR_RUNS
	int "Round-robin test - number of runs"
	default 10
	range 1 32767
	---help---
		During round-robin scheduling test two threads are created. Each of the threads
		searches for prime numbers in the configurable range, doing that configurable
		number of times.

		This value specifies the number of times the thread searches the range for
		prime numbers and together with end of search range allows to configure the
		length of this test - it should last at least a few tens of seconds. Allowed
		values [1; 32767], default 10

if ARCH_FPU && SCHED_WAITPID

config EXAMPLES_OSTEST_FPUTESTDISABLE
	bool "Disable FPU test"
	default n

if !EXAMPLES_OSTEST_FPUTESTDISABLE

config EXAMPLES_OSTEST_FPUSIZE
	int "Size of floating point register save area"

config EXAMPLES_OSTEST_FPULOOPS
	int "Number of FPU test loops"
	default 16

config EXAMPLES_OSTEST_FPUMSDELAY
	int "FPU test delay (MSec)"
	default 750

config EXAMPLES_OSTEST_FPUPRIORITY
	int "FPU test thread priority"
	default 100

config EXAMPLES_OSTEST_FPUSTACKSIZE
	int "FPU test thread stack size"
	default 2048

endif # !EXAMPLES_OSTEST_FPUTESTDISABLE
endif # ARCH_FPU && SCHED_WAITPID && !DISABLE_SIGNALS

config EXAMPLES_OSTEST_WAITRESULT
	bool "Wait and return test result"
	default y
	depends on SCHED_WAITPID

config EXAMPLES_OSTEST_POWEROFF
	bool "Terminate on test completion"
	default n
	depends on BOARDCTL_POWEROFF && EXAMPLES_OSTEST_WAITRESULT

endif # EXAMPLES_OSTEST
```
