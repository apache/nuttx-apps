## examples/pashello/Kconfig
```kconfig
#
# For a description of the syntax of this configuration file,
# see the file kconfig-language.txt in the NuttX tools repository.
#

config EXAMPLES_PASHELLO
	tristate "Pascal \"Hello, World!\" example"
	default n
	depends on INTERPRETERS_PCODE
	select INTERPRETERS_PRUN
	---help---
		Enable the Pascal \"Hello, World!\" example

if EXAMPLES_PASHELLO

config EXAMPLES_PASHELLO_VARSTACKSIZE
	int "P-Code variable stack size"
	default 1024
	---help---
		This size of the P-Code variable storage area to be allocated by the
		P-Code runtime.

config EXAMPLES_PASHELLO_STRSTACKSIZE
	int "P-Code string stack size"
	default 128
	---help---
		This size of the P-Code string stack area to be allocated by the
		P-Code runtime.

endif
```

## examples/pca9635/Kconfig
```kconfig
#
# For a description of the syntax of this configuration file,
# see the file kconfig-language.txt in the NuttX tools repository.
#

config EXAMPLES_PCA9635
	tristate "PCA9635 PWM LED example"
	default n
	---help---
		Enable the PCA9635 example

if EXAMPLES_PCA9635

config EXAMPLES_PCA9635_PROGNAME
	string "Program name"
	default "pca9635"
	depends on BUILD_LOADABLE
	---help---
		This is the name of the program that will be use when the NSH ELF
		program is installed.

endif
```

## examples/pdcurses/Kconfig
```kconfig
#
# For a description of the syntax of this configuration file,
# see the file kconfig-language.txt in the NuttX tools repository.
#

config EXAMPLES_PDCURSES
	tristate "pdcurses demos"
	default n
	---help---
		Enable build the pdcurses demo programs

if EXAMPLES_PDCURSES

config EXAMPLES_PDCURSES_PRIORITY
	int "pdcurses task priority"
	default 100

config EXAMPLES_PDCURSES_STACKSIZE
	int "pdcurses stack size"
	default DEFAULT_TASK_STACKSIZE

endif
```

## examples/pf_ieee802154/Kconfig
```kconfig
#
# For a description of the syntax of this configuration file,
# see the file kconfig-language.txt in the NuttX tools repository.
#

config EXAMPLES_PFIEEE802154
	tristate "PF_IEEE802154 example"
	default n
	depends on NET_IEEE802154
	---help---
		Enable the PF_IEEE802154 socket example

if EXAMPLES_PFIEEE802154

config EXAMPLES_PFIEEE802154_PROGNAME1
	string "Target1 program name"
	default "pfserver"
	---help---
		This is the name of the Target1 program that will be used when the
		NSH ELF program is installed.

config EXAMPLES_PFIEEE802154_PRIORITY1
	int "Target1 task priority"
	default 100

config EXAMPLES_PFIEEE802154_STACKSIZE1
	int "Target1 stack size"
	default DEFAULT_TASK_STACKSIZE

config EXAMPLES_PFIEEE802154_PROGNAME2
	string "Target2 program name"
	default "pfclient"
	---help---
		This is the name of the Target2 program that will be used when the
		NSH ELF program is installed.

config EXAMPLES_PFIEEE802154_PRIORITY2
	int "Target2 task priority"
	default 100

config EXAMPLES_PFIEEE802154_STACKSIZE2
	int "Target2 stack size"
	default DEFAULT_TASK_STACKSIZE

endif # EXAMPLES_PFIEEE802154
```

## examples/pipe/Kconfig
```kconfig
#
# For a description of the syntax of this configuration file,
# see the file kconfig-language.txt in the NuttX tools repository.
#

config EXAMPLES_PIPE
	tristate "Pipe example"
	default n
	depends on PIPES
	---help---
		Enable the pipe example

if EXAMPLES_PIPE
endif
```
