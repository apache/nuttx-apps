## examples/pwm/Kconfig
```kconfig
#
# For a description of the syntax of this configuration file,
# see the file kconfig-language.txt in the NuttX tools repository.
#

config EXAMPLES_PWM
	tristate "Pulse width modulation (PWM) example"
	default n
	depends on PWM && NSH_BUILTIN_APPS
	---help---
		Enable the Pulse width modulation (PWM) example

if EXAMPLES_PWM

config EXAMPLES_PWM_DEVPATH
	string "PWM device path"
	default "/dev/pwm0"
	---help---
		The path to the PWM device.  Default: /dev/pwm0

config EXAMPLES_PWM_FREQUENCY
	int "Default PWM frequency"
	default 100
	---help---
		The default PWM frequency.  Default: 100 Hz

config EXAMPLES_PWM_DURATION
	int "Default PWM duration"
	default 5
	---help---
		The default PWM pulse train duration in seconds.  Used only if the current
		pulse count is zero (pulse count is only supported if PWM_PULSECOUNT
		is not defined).  Default: 5 seconds

if PWM_MULTICHAN

config EXAMPLES_PWM_DUTYPCT1
	int "First PWM duty percentage"
	default 50
	range 1 99
	---help---
		The first PWM duty as a percentage.  Default: 50%

config EXAMPLES_PWM_CHANNEL1
	int "First PWM channel number"
	default 1
	range 1 6
	---help---
		The first PWM channel number.  Default: 1

if PWM_NCHANNELS = 2 || PWM_NCHANNELS = 3 || PWM_NCHANNELS = 4 || PWM_NCHANNELS = 5 || PWM_NCHANNELS = 6

config EXAMPLES_PWM_DUTYPCT2
	int "Second PWM duty percentage"
	default 50
	range 1 99
	---help---
		The second PWM duty as a percentage.  Default: 50%

config EXAMPLES_PWM_CHANNEL2
	int "Second PWM channel number"
	default 2
	range 1 6
	---help---
		The second PWM channel number.  Default: 2

endif

if PWM_NCHANNELS = 3 || PWM_NCHANNELS = 4 || PWM_NCHANNELS = 5 || PWM_NCHANNELS = 6

config EXAMPLES_PWM_DUTYPCT3
	int "Third PWM duty percentage"
	default 50
	range 1 99
	---help---
		The third PWM duty as a percentage.  Default: 50%

config EXAMPLES_PWM_CHANNEL3
	int "Third PWM channel number"
	default 3
	range 1 6
	---help---
		The third PWM channel number.  Default: 3

endif

if PWM_NCHANNELS = 4 || PWM_NCHANNELS = 5 || PWM_NCHANNELS = 6

config EXAMPLES_PWM_DUTYPCT4
	int "Fourth PWM duty percentage"
	default 50
	range 1 99
	---help---
		The fourth PWM duty as a percentage.  Default: 50%

config EXAMPLES_PWM_CHANNEL4
	int "Fourth PWM channel number"
	default 4
	range 1 6
	---help---
		The fourth PWM channel number.  Default: 4

endif

if PWM_NCHANNELS = 5 || PWM_NCHANNELS = 6

config EXAMPLES_PWM_DUTYPCT5
	int "Fifth PWM duty percentage"
	default 50
	range 1 99
	---help---
		The fifth PWM duty as a percentage.  Default: 50%

config EXAMPLES_PWM_CHANNEL5
	int "Fifth PWM channel number"
	default 5
	range 1 6
	---help---
		The fifth PWM channel number.  Default: 5

endif

if PWM_NCHANNELS = 6

config EXAMPLES_PWM_DUTYPCT6
	int "Sixth PWM duty percentage"
	default 50
	range 1 99
	---help---
		The sixth PWM duty as a percentage.  Default: 50%

config EXAMPLES_PWM_CHANNEL5
	int "Sixth PWM channel number"
	default 6
	range 1 6
	---help---
		The sixth PWM channel number.  Default: 6

endif

endif

if !PWM_MULTICHAN

config EXAMPLES_PWM_DUTYPCT
	int "Default PWM duty percentage"
	default 50
	range 1 99
	---help---
		The default PWM duty as a percentage.  Default: 50%

config EXAMPLES_PWM_PULSECOUNT
	int "Default pulse count"
	default 0
	depends on PWM_PULSECOUNT
	---help---
		The initial PWM pulse count.  This option is only available if
		PWM_PULSECOUNT is defined.  Default: 0 (i.e., use the duration, not
		the count).

endif

endif
```

## examples/qencoder/Kconfig
```kconfig
#
# For a description of the syntax of this configuration file,
# see the file kconfig-language.txt in the NuttX tools repository.
#

config EXAMPLES_QENCODER
	tristate "Quadrature encoder example"
	default n
	depends on SENSORS_QENCODER
	---help---
		Enable the quadrature encoder example

if EXAMPLES_QENCODER

config EXAMPLES_QENCODER_DEVPATH
	string "QE device path"
	default "/dev/qe0"
	---help---
		The default path to the QE device

config EXAMPLES_QENCODER_NSAMPLES
	int "Number of samples"
	default 0
	---help---
		This number of samples is collected and the program
		terminates. If the value is 0, samples are collected indefinitely.

config EXAMPLES_QENCODER_DELAY
	int "Delay between samples"
	default 100
	---help---
		This value provides the delay (in milliseconds) between each sample.
		If CONFIG_NSH_BUILTIN_APPS is defined, then this value is the default
		delay if no other delay is provided on the command line.

config EXAMPLES_QENCODER_HAVE_MAXPOS
	bool "Enable the maximum encoder position"
	default n

config EXAMPLES_QENCODER_MAXPOS
	int "Maximum encoder position"
	default 0
	depends on EXAMPLES_QENCODER_HAVE_MAXPOS

endif
```

## examples/random/Kconfig
```kconfig
#
# For a description of the syntax of this configuration file,
# see the file kconfig-language.txt in the NuttX tools repository.
#

config EXAMPLES_RANDOM
	tristate "/dev/random test"
	default n
	depends on DEV_RANDOM
	---help---
		Enable a simple test of /dev/random

if EXAMPLES_RANDOM

config EXAMPLES_MAXSAMPLES
	int "I/O buffer size"
	default 64
	---help---
		This is the size of the /dev/random I/O buffer in units of 32-bit
		samples.  Careful!  This buffer is allocated on the stack as needed!

config EXAMPLES_NSAMPLES
	int "Default samples"
	default 8
	---help---
		When you execute the rand command, a number of samples ranging from
		1 to EXAMPLES_MAXSAMPLES may be specified.  If no argument is
		specified, this is the default number of samples that will be
		collected and displayed.

endif
```

## examples/relays/Kconfig
```kconfig
#
# For a description of the syntax of this configuration file,
# see the file kconfig-language.txt in the NuttX tools repository.
#

config EXAMPLES_RELAYS
	tristate "wget JSON Example"
	default n
	depends on NETUTILS_JSON
	---help---
		Enable the wget JSON example

if EXAMPLES_RELAYS

config EXAMPLES_RELAYS_NRELAYS
	int "Number of Relays"
	default 2
	depends on ARCH_RELAYS

endif
```

## examples/rfid_readuid/Kconfig
```kconfig
#
# For a description of the syntax of this configuration file,
# see the file kconfig-language.txt in the NuttX tools repository.
#

config EXAMPLES_RFID_READUID
	bool "RFID Read UID example"
	default n
	---help---
		Enable the RFID READUID example

if EXAMPLES_RFID_READUID

config EXAMPLES_RFID_READUID_PROGNAME
	string "Program name"
	default "rfid_readuid"
	depends on BUILD_LOADABLE
	---help---
		This is the name of the program that will be use when the NSH ELF
		program is installed.

config EXAMPLES_RFID_READUID_PRIORITY
	int "RFID Read UID task priority"
	default 100

config EXAMPLES_RFID_READUID_STACKSIZE
	int "RFID Read UID stack size"
	default 2048

endif
```

## examples/rgbled/Kconfig
```kconfig
#
# For a description of the syntax of this configuration file,
# see the file kconfig-language.txt in the NuttX tools repository.
#

config EXAMPLES_RGBLED
	tristate "RGB LED Test"
	default n
	---help---
		Enable the RGB LED example

if EXAMPLES_RGBLED

config EXAMPLES_RGBLED_DEVNAME
	string "RGB LED device name"
	default "/dev/rgbled0"

config EXAMPLES_RGBLED_PROGNAME
	string "Program name"
	default "rgbled"
	---help---
		This is the name of the program that will be used when the NSH ELF
		program is installed.

config EXAMPLES_RGBLED_PRIORITY
	int "RGBLED task priority"
	default 100

config EXAMPLES_RGBLED_STACKSIZE
	int "RGBLED stack size"
	default DEFAULT_TASK_STACKSIZE

endif # EXAMPLES_RGBLED
```

## examples/rgmp/Kconfig
```kconfig
#
# For a description of the syntax of this configuration file,
# see the file kconfig-language.txt in the NuttX tools repository.
#

config EXAMPLES_RGMP
	bool "RGMP example"
	default n
	---help---
		Enable the RGMP example

if EXAMPLES_RGMP
endif
```

## examples/rmtchar/Kconfig
```kconfig
#
# For a description of the syntax of this configuration file,
# see the file kconfig-language.txt in the NuttX tools repository.
#

config EXAMPLES_RMTCHAR
	tristate "RMT character driver test"
	default n
	depends on RMT
	---help---
		Enable the RMT character driver test

if EXAMPLES_RMTCHAR

config EXAMPLES_RMTCHAR_TX
	bool "Use RMT transmitter"
	default n
	---help---
		This should be set if the RMT device supports a transmitter.

if EXAMPLES_RMTCHAR_TX

config EXAMPLES_RMTCHAR_TX_DEVPATH
	string "RMT transmitter character device path"
	default "/dev/rmt0"
	---help---
		The default path to the RMT transmitter character device.
		Default: /dev/rmt0

config EXAMPLES_RMTCHAR_TXSTACKSIZE
	int "Transmitter thread stack size"
	default DEFAULT_TASK_STACKSIZE
	---help---
		This is the stack size to use when starting the transmitter thread.

endif # EXAMPLES_RMTCHAR_TX

config EXAMPLES_RMTCHAR_RX
	bool "Use RMT receiver"
	default n
	---help---
		This should be set if the RMT device supports a receiver.

if EXAMPLES_RMTCHAR_RX

config EXAMPLES_RMTCHAR_RX_DEVPATH
	string "RMT receiver character device path"
	default "/dev/rmt1"
	---help---
		The default path to the RMT receiver character device.
		Default: /dev/rmt1

config EXAMPLES_RMTCHAR_RXSTACKSIZE
	int "Receiver thread stack size"
	default DEFAULT_TASK_STACKSIZE
	---help---
		This is the stack size to use when starting the receiver thread.

endif # EXAMPLES_RMTCHAR_RX

config EXAMPLES_RMTCHAR_ITEMS
	int "Number of words to transmit or receive"
	default 64
	---help---
		This is the total amount of words to be transmitted or
		received by the RMT RX device.

endif
```

## examples/rng90/Kconfig
```kconfig
#
# For a description of the syntax of this configuration file,
# see the file kconfig-language.txt in the NuttX tools repository.
#

config EXAMPLES_RNG90
	tristate "Microchip RNG90 TRNG example"
	default n
	depends on DEV_RNG90
	---help---
		Enable the RNG90 example.  It opens the RNG90 character device,
		runs the built-in self-test and reads random bytes from it.

if EXAMPLES_RNG90

config EXAMPLES_RNG90_PROGNAME
	string "Program name"
	default "rng90"
	---help---
		This is the name of the program that will be used when the NSH ELF
		program is installed.

config EXAMPLES_RNG90_DEVPATH
	string "RNG90 device path"
	default "/dev/rng0"
	---help---
		The default path of the RNG90 character device.

config EXAMPLES_RNG90_PRIORITY
	int "RNG90 task priority"
	default 100

config EXAMPLES_RNG90_STACKSIZE
	int "RNG90 stack size"
	default DEFAULT_TASK_STACKSIZE

endif
```

## examples/romfs/Kconfig
```kconfig
#
# For a description of the syntax of this configuration file,
# see the file kconfig-language.txt in the NuttX tools repository.
#

config EXAMPLES_ROMFS
	tristate "ROMFS example"
	default n
	depends on FS_ROMFS && BUILD_FLAT && BOARDCTL_ROMDISK
	---help---
		Enable the ROMFS example

if EXAMPLES_ROMFS

config EXAMPLES_ROMFS_RAMDEVNO
	int "ROMFS example ramdevno"
	default 10
	---help---
		Custom RAMDisk number

endif
```

## examples/rpmsgsocket/Kconfig
```kconfig
#
# For a description of the syntax of this configuration file,
# see the file kconfig-language.txt in the NuttX tools repository.
#

config EXAMPLES_RPMSGSOCKET
	tristate "Rpmsg scoekt example"
	depends on NET_RPMSG
	default n
	---help---
		Enable the rpmsg socket test example
```

## examples/rust/slint/Kconfig
```kconfig
#
# For a description of the syntax of this configuration file,
# see the file kconfig-language.txt in the NuttX tools repository.
#

config EXAMPLES_RUST_SLINT
	tristate "Slint Basic Example"
	default n
	---help---
		Enable the basic Slint example.

if EXAMPLES_RUST_SLINT

config EXAMPLES_RUST_SLINT_PROGNAME
	string "Program name"
	default "slint"
	---help---
		This is the name of the program that will be used when the
		program is installed.

config EXAMPLES_RUST_SLINT_PRIORITY
	int "Task priority"
	default 100

config EXAMPLES_RUST_SLINT_STACKSIZE
	int "Stack size"
	default DEFAULT_TASK_STACKSIZE

endif
```

## examples/rust_test/Kconfig
```kconfig
#
# For a description of the syntax of this configuration file,
# see the file kconfig-language.txt in the NuttX tools repository.
#

config EXAMPLES_RUST_TEST
	tristate "Rust Test App"
	default n
	---help---
		Enable the Rust Test App

if EXAMPLES_RUST_TEST

config EXAMPLES_RUST_TEST_PROGNAME
	string "Program name"
	default "rust_test"
	---help---
		This is the name of the program that will be used when the NSH ELF
		program is installed.

config EXAMPLES_RUST_TEST_PRIORITY
	int "Rust Test App task priority"
	default 100

config EXAMPLES_RUST_TEST_STACKSIZE
	int "Rust Test App stack size"
	default DEFAULT_TASK_STACKSIZE

endif
```

## examples/scd41/Kconfig
```kconfig
#
# For a description of the syntax of this configuration file,
# see the file kconfig-language.txt in the NuttX tools repository.
#

config EXAMPLES_SCD41
	tristate "SCD41 CO2 sensor example"
	default n
	depends on SENSORS_SCD41
	---help---
		Enable the SCD41 CO2 sensor example

if EXAMPLES_SCD41

config EXAMPLES_SCD41_PROGNAME
	string "Program name"
	default "scd41"
	---help---
		This is the name of the program that will be used when the NSH ELF
		program is installed.

config EXAMPLES_SCD41_DEVPATH
	string "Device path"
	default "/dev/co2"
	---help---
		The device path

config EXAMPLES_SCD41_PRIORITY
	int "scd41 task priority"
	default 100

config EXAMPLES_SCD41_STACKSIZE
	int "scd41 stack size"
	default DEFAULT_TASK_STACKSIZE

endif
```

## examples/sendmail/Kconfig
```kconfig
#
# For a description of the syntax of this configuration file,
# see the file kconfig-language.txt in the NuttX tools repository.
#

config EXAMPLES_SENDMAIL
	tristate "Sendmail example"
	default n
	depends on NET_IPv4
	depends on NET_TCP
	select NETUTILS_SMTP
	---help---
		Enable the sendmail example

if EXAMPLES_SENDMAIL

config EXAMPLES_SENDMAIL_NOMAC
	bool "Use Canned MAC Address"
	default n
	---help---
		If the hardware has no MAC address of its own, define this =y to
		provide a bogus address for testing.

config EXAMPLES_SENDMAIL_IPADDR
	hex "Target IP address"
	default 0x0a000002
	---help---
		The target IP address.  Default 10.0.0.2 (0x0a000002)

config EXAMPLES_SENDMAIL_DRIPADDR
	hex "Default Router IP address (Gateway)"
	default 0x0a000001
	---help---
		The default router address. Default 10.0.0.1 (0x0a000001)

config EXAMPLES_SENDMAIL_SERVERADDR
	hex "SMTP Server address"
	default 0x0a000003
	---help---
		The SMTP Server address. Default 10.0.0.3 (0x0a000003)

config EXAMPLES_SENDMAIL_NETMASK
	hex "Network Mask"
	default 0xffffff00
	---help---
		The network mask.  Default: 255.255.255.0 (0xffffff00)

config EXAMPLES_SENDMAIL_PORT
	int "Server Port"
	default 25
	---help---
		The SMTP server's port.  Default 25.

config EXAMPLES_SENDMAIL_RECIPIENT
	string "Recipient email"
	default "Jane Doe <jane.doe@janedoemail.com>"

config EXAMPLES_SENDMAIL_SENDER
	string "Sender email"
	default "John Doe <john.doe@johndoemail.com>"

config EXAMPLES_SENDMAIL_SUBJECT
	string "Subject"
	default "Test"

config EXAMPLES_SENDMAIL_BODY
	string "Mail Body"
	default "This is a test"

endif
```
