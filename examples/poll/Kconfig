## examples/poll/Kconfig
```kconfig
#
# For a description of the syntax of this configuration file,
# see the file kconfig-language.txt in the NuttX tools repository.
#

config EXAMPLES_POLL
	tristate "Poll example"
	default n
	depends on !NSH_BUILTIN_APPS && PIPES
	---help---
		Enable the poll example

if EXAMPLES_POLL

config EXAMPLES_POLL_NOMAC
	bool "Use Canned MAC Address"
	default n

config EXAMPLES_POLL_IPADDR
	hex "Target IP address"
	default 0x0a000002

config EXAMPLES_POLL_DRIPADDR
	hex "Default Router IP address (Gateway)"
	default 0x0a000001

config EXAMPLES_POLL_NETMASK
	hex "Network Mask"
	default 0xffffff00

endif # EXAMPLES_POLL
```

## examples/popen/Kconfig
```kconfig
#
# For a description of the syntax of this configuration file,
# see the file kconfig-language.txt in the NuttX tools repository.
#

config EXAMPLES_POPEN
	tristate "popen() example"
	default n
	depends on SYSTEM_POPEN
	---help---
		Enable the popen() example

if EXAMPLES_POPEN

config EXAMPLES_POPEN_PROGNAME
	string "Program name"
	default "popen"
	---help---
		This is the name of the program that will be used when the NSH ELF
		program is installed.

config EXAMPLES_POPEN_PRIORITY
	int "Popen task priority"
	default 100

config EXAMPLES_POPEN_STACKSIZE
	int "Popen stack size"
	default DEFAULT_TASK_STACKSIZE

endif
```

## examples/posix_stdio/Kconfig
```kconfig
#
# For a description of the syntax of this configuration file,
# see the file kconfig-language.txt in the NuttX tools repository.
#

config EXAMPLES_POSIX_STDIO
	bool "Posix stdio example"
	default n
	---help---
		Enable POSIX stdio example that shows how to use open(), write() and
		close() via /dev/console.

config EXAMPLES_POSIX_STDIO_PROGNAME
	string "Program name"
	default "posix_stdio"
	depends on EXAMPLES_POSIX_STDIO

config EXAMPLES_POSIX_STDIO_PRIORITY
	int "POSIX_STDIO priority"
	default 100
	depends on EXAMPLES_POSIX_STDIO

config EXAMPLES_POSIX_STDIO_STACKSIZE
	int "POSIX_STDIO stack size"
	default DEFAULT_TASK_STACKSIZE
	depends on EXAMPLES_POSIX_STDIO
```

## examples/powerled/Kconfig
```kconfig
#
# For a description of the syntax of this configuration file,
# see the file kconfig-language.txt in the NuttX tools repository.
#

config EXAMPLES_POWERLED
	tristate "Powerled example"
	default n
	---help---
		Enable the powerled driver example

if EXAMPLES_POWERLED

config EXAMPLES_POWERLED_DEVPATH
  string "Powerled device path"
	default "dev/powerled0"
	---help---
		The default path to the Powerled device. Default: /dev/powerled0

config EXAMPLES_POWERLED_CURRENT_LIMIT
	int "LED current limit (mA)"
	default 50
	---help---
		Current limit for LED driver in mA. This current value is used to achieve maximum LED brightness.
		Make sure it does not exceed LED maximum forward current!

endif
```

## examples/powermonitor/Kconfig
```kconfig
#
# For a description of the syntax of this configuration file,
# see the file kconfig-language.txt in the NuttX tools repository.
#

config EXAMPLES_POWERMONITOR
	tristate "LTC4151 powermonitor example"
	default n
	depends on SENSORS_LTC4151

if EXAMPLES_POWERMONITOR
endif # EXAMPLES_POWERMONITOR
```

## examples/pppd/Kconfig
```kconfig
#
# For a description of the syntax of this configuration file,
# see the file kconfig-language.txt in the NuttX tools repository.
#

config EXAMPLES_PPPD
	tristate "pppd client example"
	select NETUTILS_PPPD
	default n
	---help---
		Enable the pppd client example

if EXAMPLES_PPPD

config EXAMPLES_PPPD_STACKSIZE
	int "pppd example stack stack size"
	default DEFAULT_TASK_STACKSIZE

endif
```

## examples/pty_test/Kconfig
```kconfig
#
# For a description of the syntax of this configuration file,
# see the file kconfig-language.txt in the NuttX tools repository.
#

config EXAMPLES_PTYTEST
	tristate "Pseudo Terminal test example"
	default n
	depends on PSEUDOTERM
	select PSEUDOTERM_SUSV1
	---help---
		Enable the PTY example

if EXAMPLES_PTYTEST

config EXAMPLES_PTYTEST_PROGNAME
	string "Program name"
	default "pts"
	---help---
		This is the name of the program that will be used when the NSH ELF
		program is installed.

config EXAMPLES_PTYTEST_POLL
	bool "Test poll() with data transfers"
	default n

config EXAMPLES_PTYTEST_SERIALDEV
	string "Test serial device"
	default "/dev/ttyS1"

config EXAMPLES_PTYTEST_PRIORITY
	int "PTY_Test task priority"
	default 100

config EXAMPLES_PTYTEST_STACKSIZE
	int "PTYTest stack size"
	default DEFAULT_TASK_STACKSIZE

config EXAMPLES_PTYTEST_DAEMONPRIO
	int "PTY_Test daemon task priority"
	default 100

config EXAMPLES_PTYTEST_WAIT_CONNECTED
  bool "Keep retrying open serial device"
  ---help---
     For USB based serial devices, open will fail
     if the other end is not connected (USB cable unplugged).
     Enabling this option will retry the open() call every second
     until connected.

endif
```

## examples/pulsecount/Kconfig
```kconfig
#
# For a description of the syntax of this configuration file,
# see the file kconfig-language.txt in the NuttX tools repository.
#

config EXAMPLES_PULSECOUNT
	tristate "pulsecount example"
	default n
	depends on PULSECOUNT
	---help---
		Enable the finite pulsecount example

if EXAMPLES_PULSECOUNT

config EXAMPLES_PULSECOUNT_DEVPATH
	string "pulsecount device path"
	default "/dev/pulsecount0"
	---help---
		The path to the pulsecount device.  Default: /dev/pulsecount0

config EXAMPLES_PULSECOUNT_HIGH_NS
	int "Default pulsecount high time"
	default 5000000
	---help---
		The default pulsecount high time in nanoseconds.
		Default: 5000000 ns

config EXAMPLES_PULSECOUNT_LOW_NS
	int "Default pulsecount low time"
	default 5000000
	---help---
		The default pulsecount low time in nanoseconds.
		Default: 5000000 ns

config EXAMPLES_PULSECOUNT_COUNT
	int "Default pulsecount count"
	default 100
	range 1 2147483647
	---help---
		The default number of pulses to generate.

endif
```

## examples/pwfb/Kconfig
```kconfig
#
# For a description of the syntax of this configuration file,
# see the file kconfig-language.txt in the NuttX tools repository.
#

config EXAMPLES_PWFB
	tristate "NX Per-Window Framebuffer Text Example"
	default n
	depends on NX
	select LIB_BOARDCTL
	select NX_RAMBACKED
	---help---
		Enable the NX per-window framebuffer example

		WARNING:  Verbose graphics debug output interferes with this
		test because it introduces some weird timing.  The test probably
		should use nx_synchronize() to keep syncrhonization even with the
		added delays.

if EXAMPLES_PWFB

config EXAMPLES_PWFB_NWINDOWS
	int "Number of Windows"
	default 3
	range 0 3 if NX_SWCURSOR
	range 1 3 if !NX_SWCURSOR

config EXAMPLES_PWFB_DEFAULT_COLORS
	bool "Use Default Colors"
	default y

if !EXAMPLES_PWFB_DEFAULT_COLORS

config EXAMPLES_PWFB_BGCOLOR
	hex "Background Color"
	---help---
		The color of the background.  Default depends on config EXAMPLES_PWFB_BPP.

config EXAMPLES_PWFB_COLOR1
	hex "Color of Window 1"
	---help---
		The color of window 1. Default depends on config EXAMPLES_PWFB_BPP.

config EXAMPLES_PWFB_COLOR2
	hex "Color of Window 2"
	---help---
		The color of window 2. Default depends on config EXAMPLES_PWFB_BPP.

config EXAMPLES_PWFB_COLOR3
	hex "Color of Window 3"
	---help---
		The color of window 3. Default depends on config EXAMPLES_PWFB_BPP.

config EXAMPLES_PWFB_TBCOLOR
	hex "Toolbar Color"
	---help---
		The color of the toolbar. Default depends on config EXAMPLES_PWFB_BPP.

config EXAMPLES_PWFB_FONTCOLOR
	hex "Font Color"
	---help---
		The color of the fonts. Default depends on config EXAMPLES_PWFB_BPP.

endif

config EXAMPLES_PWFB_DEFAULT_FONT
	bool "Use Default Font"
	default y

config EXAMPLES_PWFB_FONTID
	int "Font ID"
	depends on !EXAMPLES_PWFB_DEFAULT_FONT
	---help---
		Selects the font (see font ID numbers in include/nuttx/nx/nxfonts.h)

config EXAMPLES_PWFB_BPP
	int "Bits-Per-Pixel"
	default 32
	---help---
		Pixels per pixel to use.  Valid options include 2, 4, 8, 16, 24,
		and 32.  Default is 32.

config EXAMPLES_PWFB_RATECONTROL
	int "Frame rate control"
	default 100
	range 0 1000
	---help---
		This is the inter-frame period in milliseconds that is used to
		control the framerate.  A value of zero will disable frame controls
		and the rendering will occur as fast as is possible.

		If you run this example with high frame rates, it becomes unstable.
		This is probably a bug in the example:  It may not be accounting
		for for some asynchronous behaviors.

config EXAMPLES_PWFB_VERBOSE
	bool "Verbose output"
	default n

comment "Tasking options"

config EXAMPLES_PWFB_PROGNAME
	string "Program name"
	default "pwfb"
	---help---
		This is the name of the program that will be used when the NSH ELF
		program is installed.

config EXAMPLES_PWFB_CLIENT_STACKSIZE
	int "Example Main Stack Size"
	default DEFAULT_TASK_STACKSIZE
	---help---
		The stacksize to use when starting the example main().
		Default 2048

config EXAMPLES_PWFB_CLIENT_PRIO
	int "Client Priority"
	default 90
	---help---
		The priority to use when staring the example main().  This priority
		should be lower than both the listener and server priorities (See
		CONFIG_NXSTART_SERVERPRIO).  Default: 90

config EXAMPLES_PWFB_LISTENER_STACKSIZE
	int "Listener Stack Size"
	default DEFAULT_TASK_STACKSIZE
	---help---
		The stacksize to use when creating the NX server.  Default 2048

config EXAMPLES_PWFB_LISTENER_PRIO
	int "Listener Priority"
	default 100
	---help---
		The priority of the event listener thread.  This priority should be
		above the client priority but below the server priority (See
		CONFIG_NXSTART_SERVERPRIO).  Default 100.

endif
```

## examples/pwlines/Kconfig
```kconfig
#
# For a description of the syntax of this configuration file,
# see the file kconfig-language.txt in the NuttX tools repository.
#

config EXAMPLES_PWLINES
	tristate "NX Per-Window Framebuffer Graphics Example"
	default n
	depends on NX
	select BOARDCTL
	select NX_RAMBACKED
	---help---
		Enable the NX per-window framebuffer example

if EXAMPLES_PWLINES

config EXAMPLES_PWLINES_DEFAULT_COLORS
	bool "Use Default Colors"
	default y

if !EXAMPLES_PWLINES_DEFAULT_COLORS

config EXAMPLES_PWLINES_BGCOLOR
	hex "Background Color"
	---help---
		The color of the background.  Default depends on config EXAMPLES_PWLINES_BPP.

config EXAMPLES_PWLINES_COLOR1
	hex "Color of Window 1"
	---help---
		The color of window 1. Default depends on config EXAMPLES_PWLINES_BPP.

config EXAMPLES_PWLINES_COLOR2
	hex "Color of Window 2"
	---help---
		The color of window 2. Default depends on config EXAMPLES_PWLINES_BPP.

config EXAMPLES_PWLINES_COLOR3
	hex "Color of Window 3"
	---help---
		The color of window 3. Default depends on config EXAMPLES_PWLINES_BPP.

config EXAMPLES_PWLINES_BORDERCOLOR
	hex "Circle border Color"
	---help---
		The color of the circular border drawn in the window.  Default depends
		on EXAMPLES_PWLINES_BPP.

config EXAMPLES_PWLINES_FACECOLOR
	hex "Circle face Color"
	---help---
		The color of the circular region filled in the window. Default depends
		on EXAMPLES_PWLINES_BPP.

config EXAMPLES_PWLINES_LINECOLOR
	hex "Line Color"
	---help---
		The color of the central lines drawn in the window.  Default depends
		on EXAMPLES_PWLINES_BPP.

endif

config EXAMPLES_PWLINES_BPP
	int "Bits-Per-Pixel"
	default 32
	---help---
		Pixels per pixel to use.  Valid options include 2, 4, 8, 16, 24,
		and 32.  Default is 32.

config EXAMPLES_PWLINES_LINEWIDTH
	int "Line Width"
	default 8
	---help---
		Selects the width of the lines in pixels (default: 16)

config EXAMPLES_PWLINES_BORDERWIDTH
	int "Border Width"
	default 8
	---help---
		The width of the circular border drawn in the background window. (default: 16).

config EXAMPLES_PWLINES_RATECONTROL
	int "Frame rate control"
	default 100
	range 0 1000
	---help---
		This is the inter-frame period in milliseconds that is used to
		control the framerate.  A value of zero will disable frame controls
		and the rendering will occur as fast as is possible.

		If you run this example with high frame rates, it becomes unstable.
		This is probably a bug in the example:  It may not be accounting
		for for some asynchronous behaviors.

config EXAMPLES_PWLINES_VERBOSE
	bool "Verbose output"
	default n

comment "Tasking options"

config EXAMPLES_PWLINES_PROGNAME
	string "Program name"
	default "pwlines"
	---help---
		This is the name of the program that will be used when the NSH ELF
		program is installed.

config EXAMPLES_PWLINES_CLIENT_STACKSIZE
	int "Example Main Stack Size"
	default DEFAULT_TASK_STACKSIZE
	---help---
		The stacksize to use when starting the example main().
		Default 2048

config EXAMPLES_PWLINES_CLIENT_PRIO
	int "Client Priority"
	default 90
	---help---
		The priority to use when staring the example main().  This priority
		should be lower than both the listener and server priorities (See
		CONFIG_NXSTART_SERVERPRIO).  Default: 90

config EXAMPLES_PWLINES_LISTENER_STACKSIZE
	int "Listener Stack Size"
	default DEFAULT_TASK_STACKSIZE
	---help---
		The stacksize to use when creating the NX server.  Default 2048

config EXAMPLES_PWLINES_LISTENER_PRIO
	int "Listener Priority"
	default 100
	---help---
		The priority of the event listener thread.  This priority should be
		above the client priority but below the server priority (See
		CONFIG_NXSTART_SERVERPRIO).  Default 100.

endif
```
