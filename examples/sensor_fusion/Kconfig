## examples/spi_test2/Kconfig
```kconfig
#
# For a description of the syntax of this configuration file,
# see the file kconfig-language.txt in the NuttX tools repository.
#

config EXAMPLES_SPI_TEST2
	tristate "\"Spi_test2, World!\" example"
	default n
	---help---
		Enable the \"Spi_test2, World!\" example

if EXAMPLES_SPI_TEST2

config EXAMPLES_SPI_TEST2_PROGNAME
	string "Program name"
	default "spi_test2"
	---help---
		This is the name of the program that will be used when the NSH ELF
		program is installed.

config EXAMPLES_SPI_TEST2_PRIORITY
	int "Spi_test2 task priority"
	default 100

config EXAMPLES_SPI_TEST2_STACKSIZE
	int "Spi_test2 stack size"
	default DEFAULT_TASK_STACKSIZE

endif
```

## examples/spislv_test/Kconfig
```kconfig
#
# For a description of the syntax of this configuration file,
# see the file kconfig-language.txt in the NuttX tools repository.
#

config EXAMPLES_SPISLV
	tristate "\"SPI Slave Test\" example"
	default n
	---help---
		Enable the "SPI Slave Test" example. 
		This tool can be used together with the SPI tool to validate communication between two devices.

if EXAMPLES_SPISLV

config EXAMPLES_SPISLV_PROGNAME
	string "Program name"
	default "spislv"
	---help---
		This is the name of the program that will be used when the NSH ELF
		program is installed.

config EXAMPLES_SPISLV_PRIORITY
	int "Spislv task priority"
	default 100

config EXAMPLES_SPISLV_STACKSIZE
	int "Spislv stack size"
	default DEFAULT_TASK_STACKSIZE

endif
```

## examples/stat/Kconfig
```kconfig
#
# For a description of the syntax of this configuration file,
# see the file kconfig-language.txt in the NuttX tools repository.
#

config EXAMPLES_STAT
	tristate "Test of stat(), fstat(), and statfs()"
	default n
	---help---
		Enable the test of stat(), fstat(), and statfs().

if EXAMPLES_STAT

config EXAMPLES_STAT_PROGNAME
	string "Program name"
	default "stat"
	---help---
		This is the name of the program that will be used when the NSH ELF
		program is installed.

config EXAMPLES_STAT_PRIORITY
	int "Stat task priority"
	default 100

config EXAMPLES_STAT_STACKSIZE
	int "Stat stack size"
	default DEFAULT_TASK_STACKSIZE

endif
```

## examples/stepper/Kconfig
```kconfig
#
# For a description of the syntax of this configuration file,
# see the file kconfig-language.txt in the NuttX tools repository.
#

config EXAMPLES_STEPPER
	tristate "Stepper controller test"
	default n
	---help---
		Enable the stepper controller test
```

## examples/sx1262_test/Kconfig
```kconfig
#
# For a description of the syntax of this configuration file,
# see the file kconfig-language.txt in the NuttX tools repository.
#

config EXAMPLES_SPI_TEST
	tristate "\"Spi_test, World!\" example"
	default n
	---help---
		Enable the \"Spi_test, World!\" example

if EXAMPLES_SPI_TEST

config EXAMPLES_SPI_TEST_PROGNAME
	string "Program name"
	default "spi_test"
	---help---
		This is the name of the program that will be used when the NSH ELF
		program is installed.

config EXAMPLES_SPI_TEST_PRIORITY
	int "Spi_test task priority"
	default 100

config EXAMPLES_SPI_TEST_STACKSIZE
	int "Spi_test stack size"
	default DEFAULT_TASK_STACKSIZE

endif
```

## examples/sx127x_demo/Kconfig
```kconfig
#
# For a description of the syntax of this configuration file,
# see the file kconfig-language.txt in the NuttX tools repository.
#

config EXAMPLES_SX127X
	tristate "SX127x example"
	default n
	depends on LPWAN_SX127X

if EXAMPLES_SX127X

config EXAMPLES_SX127X_RFFREQ
	int "SX127x RF frequency"
	default 930000000

config EXAMPLES_SX127X_TXPOWER
	int "SX127x TX power"
	default 14

config EXAMPLES_SX127X_TXDATA
	int "SX127x TX data length"
	default 5

config EXAMPLES_SX127X_TIME
	int "SX127x demo time, 0 for infinity"
	default 0

config EXAMPLES_SX127X_INTERVAL
	int "SX127x time interval for modem operations"
	default 5

endif
```

## examples/system/Kconfig
```kconfig
#
# For a description of the syntax of this configuration file,
# see the file kconfig-language.txt in the NuttX tools repository.
#

config EXAMPLES_SYSTEM
	bool "System() example"
	default n
	depends on SYSTEM_SYSTEM
	---help---
		Enable the system() example

if EXAMPLES_SYSTEM

config EXAMPLES_SYSTEM_PROGNAME
	string "Program name"
	default "system"
	depends on BUILD_LOADABLE
	---help---
		This is the name of the program that will be use when the NSH ELF
		program is installed.

config EXAMPLES_SYSTEM_PRIORITY
	int "System task priority"
	default 100

config EXAMPLES_SYSTEM_STACKSIZE
	int "System stack size"
	default 2048

endif
```

## examples/tcp_ipc_client/Kconfig
```kconfig
#
# For a description of the syntax of this configuration file,
# see the file kconfig-language.txt in the NuttX tools repository.
#

config EXAMPLES_TCP_IPC_CLIENT
	bool "Client for TCP IPC NuttX"
	default n
	select ARCH_HAVE_NET
	select ARCH_HAVE_NETDEV_STATISTICS
	select NET_READAHEAD
	select NET_TCP
	select NET
	select NET_SOCKOPTS
	select NET_LOOPBACK
	select NETDEV_LATEINIT
	select SCHED_HPWORK
	---help---
		Enable the Client for TCP IPC NuttX example

config EXAMPLES_TCP_IPC_CLIENT_PROGNAME
	string "Program name"
	default "CLIENT"
	depends on EXAMPLES_TCP_IPC_CLIENT
	---help---
		This is the name of the program that will be used when the NSH ELF
		program is installed.

config EXAMPLES_TCP_IPC_CLIENT_PRIORITY
	int "CLIENT task priority"
	default 100
	depends on EXAMPLES_TCP_IPC_CLIENT

config EXAMPLES_TCP_IPC_CLIENT_STACKSIZE
	int "CLIENT stack size"
	default 8192
	depends on EXAMPLES_TCP_IPC_CLIENT
```

## examples/tcp_ipc_server/Kconfig
```kconfig
#
# For a description of the syntax of this configuration file,
# see the file kconfig-language.txt in the NuttX tools repository.
#

config EXAMPLES_TCP_IPC_SERVER
	bool "Server for TCP IPC NuttX"
	default n
	select ARCH_HAVE_NET
	select ARCH_HAVE_NETDEV_STATISTICS
	select NET_READAHEAD
	select NET_TCP
	select NET
	select NET_SOCKOPTS
	select NET_LOOPBACK
	select NETDEV_LATEINIT
	select SCHED_HPWORK
	---help---
		Enable the TCP SERVER example

config EXAMPLES_TCP_IPC_SERVER_PROGNAME
	string "Program name"
	default "SERVER"
	depends on EXAMPLES_TCP_IPC_SERVER
	---help---
		This is the name of the program that will be used when the NSH ELF
		program is installed.

config EXAMPLES_TCP_IPC_SERVER_PRIORITY
	int "SERVER task priority"
	default 100
	depends on EXAMPLES_TCP_IPC_SERVER

config EXAMPLES_TCP_IPC_SERVER_STACKSIZE
	int "SERVER stack size"
	default DEFAULT_TASK_STACKSIZE
	depends on EXAMPLES_TCP_IPC_SERVER
```
