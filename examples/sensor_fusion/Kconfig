## examples/sensor_fusion/Kconfig
```kconfig
#
# For a description of the syntax of this configuration file,
# see the file kconfig-language.txt in the NuttX tools repository.
#

config EXAMPLES_SENSOR_FUSION
	bool "Sensor Fusion Example"
	default n
	---help---
		Sensor fusion example that combines gyro and accelerometer data
		using the Madgwick algorithm to provide yaw, pitch and roll angles.

if EXAMPLES_SENSOR_FUSION

config EXAMPLES_SENSOR_FUSION_SAMPLES
	int "Number of samples to acquire"
	default 100

config EXAMPLES_SENSOR_FUSION_SAMPLE_RATE
	int "Sample rate in ms"
	default 100

config EXAMPLES_SENSOR_FUSION_PROGNAME
	string "Program name"
	default "sensor_fusion"
	---help---
		This is the name of the program that will be used when the NSH ELF
		program is installed.

config EXAMPLES_SENSOR_FUSION_PRIORITY
	int "Sensor Fusion task priority"
	default 100

config EXAMPLES_SENSOR_FUSION_STACKSIZE
	int "Sensor Fusion stack size"
	default DEFAULT_TASK_STACKSIZE

endif
```

## examples/serialblaster/Kconfig
```kconfig
#
# For a description of the syntax of this configuration file,
# see the file kconfig-language.txt in the NuttX tools repository.
#

config EXAMPLES_SERIALBLASTER
    tristate "Serial Blaster example"
    default n
    ---help---
        Enable the serial blaster example

if EXAMPLES_SERIALBLASTER

config EXAMPLES_SERIALBLASTER_STACKSIZE
	int "CPU hog stack size"
	default 2048

config EXAMPLES_SERIALBLASTER_PRIORITY
	int "CPU hog task priority"
	default 50

endif
```

## examples/serialrx/Kconfig
```kconfig
#
# For a description of the syntax of this configuration file,
# see the file kconfig-language.txt in the NuttX tools repository.
#

config EXAMPLES_SERIALRX
	tristate "Serial RX example"
	default n
	---help---
		Enable the serial RX example

if EXAMPLES_SERIALRX

config EXAMPLES_SERIALRX_STACKSIZE
	int "Serial RX stack size"
	default DEFAULT_TASK_STACKSIZE

config EXAMPLES_SERIALRX_PRIORITY
	int "Serial RX task priority"
	default 50

config EXAMPLES_SERIALRX_BUFFERED
	bool "Buffered I/O"
	default n
	---help---
		Use buffered I/O

config EXAMPLES_SERIALRX_BUFSIZE
	int "Buffer size"
	default 11520
	---help---
		Specifies the default buffer size

config EXAMPLES_SERIALRX_DEVPATH
	string "Serial device path"
	default "/dev/ttyS0"
	---help---
		The default path to the serial device

choice
	prompt "Output method"
	default EXAMPLES_SERIALRX_PRINTHYPHEN

config EXAMPLES_SERIALRX_PRINTHYPHEN
	bool "Hyphen"
	---help---
		Print a hyphen after receiving a full buffer

config EXAMPLES_SERIALRX_PRINTHEX
	bool "Hexadecimal"
	---help---
		Print the bytes received in hexadecimal

config EXAMPLES_SERIALRX_PRINTSTR
	bool "String"
	---help---
		Print the bytes received as a string

endchoice

endif
```

## examples/serloop/Kconfig
```kconfig
#
# For a description of the syntax of this configuration file,
# see the file kconfig-language.txt in the NuttX tools repository.
#

config EXAMPLES_SERLOOP
	tristate "Serial loopback example"
	default n
	---help---
		Enable the serial loopback example

if EXAMPLES_SERLOOP
endif
```

## examples/settings/Kconfig
```kconfig
#
# For a description of the syntax of this configuration file,
# see the file kconfig-language.txt in the NuttX tools repository.
#

config EXAMPLES_SETTINGS
	tristate "Settings example"
	default n
	---help---
		Enable the "settings" example. This uses the functions provided in
		system/settings to test the storage and retrieval of various
		configurable parameters

if EXAMPLES_SETTINGS

config EXAMPLES_SETTINGS_PROGNAME
	string "Program name"
	default "settings"
	---help---
		This is the name of the program that will be used when the NSH ELF
		program is installed.

config EXAMPLES_SETTINGS_PRIORITY
	int "settings task priority"
	default 100

config EXAMPLES_SETTINGS_STACKSIZE
	int "settings stack size"
	default DEFAULT_TASK_STACKSIZE

choice
	prompt "Select settings storage location"
	default EXAMPLES_SETTINGS_USE_TMPFS

config EXAMPLES_SETTINGS_USE_TMPFS
	bool "Use TMPFS"
	select FS_TMPFS
	---help---
		TMPFS will be enabled and used

config EXAMPLES_SETTINGS_USE_OTHER
	bool "Use existing/other storage media"

endchoice # Select settings storage location

if EXAMPLES_SETTINGS_USE_OTHER

config EXAMPLES_SETTINGS_EXISTING_STORAGE
	string "Path to existing storage media"
	default "/mnt/mmcsd0"

endif # EXAMPLES_SETTINGS_USE_OTHER

config EXAMPLES_SETTINGS_FILENAME
	string "Filename"
	default "settings"
	---help---
		filename to be used. This append will append .txt and .bin
		to this name to use/create two settings files.

endif # EXAMPLES_SETTINGS
```

## examples/shm_test/Kconfig
```kconfig
#
# For a description of the syntax of this configuration file,
# see the file kconfig-language.txt in the NuttX tools repository.
#

config EXAMPLES_SHM
	tristate "SHM example"
	default n
	depends on FS_SHMFS
	---help---
		Enable the SHM example which has an shm producer and consumer

if EXAMPLES_SHM

config EXAMPLES_SHM_PROGNAME
	string "Program name"
	default "shm_test"
	---help---
		This is the name of the program that will be used when the NSH ELF
		program is installed.

config EXAMPLES_SHM_PRIORITY
	int "SHM task priority"
	default 100

config EXAMPLES_SHM_STACKSIZE
	int "SHM stack size"
	default DEFAULT_TASK_STACKSIZE

endif
```

## examples/sht3x/Kconfig
```kconfig
#
# For a description of the syntax of this configuration file,
# see the file kconfig-language.txt in the NuttX tools repository.
#

config EXAMPLES_SHT3X
	tristate "SHT3x sensor example"
	default n
	depends on SENSORS_SHT3X
	---help---
		Enable the SHT3x sensor example

if EXAMPLES_SHT3X

config EXAMPLES_SHT3X_PROGNAME
	string "Program name"
	default "sht3x"
	---help---
		This is the name of the program that will be used when the NSH ELF
		program is installed.

config EXAMPLES_SHT3X_PRIORITY
	int "SHT3x task priority"
	default 100

config EXAMPLES_SHT3X_STACKSIZE
	int "SHT3X stack size"
	default DEFAULT_TASK_STACKSIZE

endif
```

## examples/shv-nxboot-updater/Kconfig
```kconfig
#
# For a description of the syntax of this configuration file,
# see the file kconfig-language.txt in the NuttX tools repository.
#

menuconfig EXAMPLES_SHV_NXBOOT_UPDATER
	bool "Silicon Heaven Firmware updates for NXBoot"
	depends on NETUTILS_LIBSHVC
	default n
	---help---
		Enable the shv-nxboot-updater application.

if EXAMPLES_SHV_NXBOOT_UPDATER

config EXAMPLES_SHV_NXBOOT_UPDATER_PROGNAME
	string "shv-nxboot-updater App Name"
	default "shv_nxboot_updater"
	---help---
		This is the name of the program that will be used when the NSH ELF
		program is installed.

config EXAMPLES_SHV_NXBOOT_UPDATER_PRIORITY
	int "shv-nxboot-updater task priority"
	default 100

config EXAMPLES_SHV_NXBOOT_UPDATER_STACKSIZE
	int "shv-nxboot-updater task stack size"
	default 4096

endif # EXAMPLES_NX_SHV_FWUPDATER
```

## examples/shv-test/Kconfig
```kconfig
#
# For a description of the syntax of this configuration file,
# see the file kconfig-language.txt in the NuttX tools repository.
#

menuconfig EXAMPLES_SHV_TEST
	bool "Silicon Heaven Protocol showcase"
	depends on NETUTILS_LIBSHVC
	default n
	---help---
		Enable the shv-test application, to show off the capabilities of the SHV protocol.

if EXAMPLES_SHV_TEST

config EXAMPLES_SHV_TEST_PROGNAME
	string "shv-test App Name"
	default "shv_test"
	---help---
		This is the name of the program that will be used when the NSH ELF
		program is installed.

config EXAMPLES_SHV_TEST_PRIORITY
	int "shv-test task priority"
	default 100

config EXAMPLES_SHV_TEST_STACKSIZE
	int "shv-test task stack size"
	default 4096

endif # EXAMPLES_NX_SHV_FWUPDATER
```

## examples/slcd/Kconfig
```kconfig
#
# For a description of the syntax of this configuration file,
# see misc/tools/kconfig-language.txt.
#

config EXAMPLES_SLCD
	bool "Segment LCD test"
	default n
	---help---
		Enables a simple test of an alphanumer, segment LCD

if EXAMPLES_SLCD

config EXAMPLES_SLCD_DEVNAME
	string "SLCD device path"
	default "/dev/slcd"
	---help---
		The full path to the SLCD device to be tested

config EXAMPLES_SLCD_BUFSIZE
	int "I/O buffer size"
	default 64
	---help---
		The size of the I/O buffer to use in the test (not a critical setting)

endif
```

## examples/smart_test/Kconfig
```kconfig
#
# For a description of the syntax of this configuration file,
# see the file kconfig-language.txt in the NuttX tools repository.
#

config EXAMPLES_SMART_TEST
	tristate "SMART filesystem test tool"
	default n
	depends on NSH_BUILTIN_APPS
	---help---
		Performs a file-based test on a SMART (or any) filesystem. Validates
		seek, append and seek-with-write operations.  This test can be built
		only as an NSH command

if EXAMPLES_SMART_TEST
endif
```

## examples/smf/Kconfig
```kconfig
#
# For a description of the syntax of this configuration file,
# see the file kconfig-language.txt in the NuttX tools repository.
#

config EXAMPLES_SMF
  tristate "State Machine Framework PSICC2 demo (HSM)"
  default n
  depends on NSH_BUILTIN_APPS
  depends on SYSTEM_SMF
  depends on SYSTEM_SMF_ANCESTOR_SUPPORT
  depends on SYSTEM_SMF_INITIAL_TRANSITION

if EXAMPLES_SMF

config EXAMPLES_SMF_PROGNAME
  string "Program name"
  default "hsm_psicc2"

config EXAMPLES_SMF_PRIORITY
  int "Priority"
  default 100

config EXAMPLES_SMF_STACKSIZE
  int "Stack size"
  default 2048

config EXAMPLES_SMF_EVENT_QUEUE_SIZE
  int "Event queue size"
  default 10

config EXAMPLES_SMF_MQ_NAME
  string "Message queue name"
  default "/hsm_psicc2_mq"

endif
```

## examples/smp/Kconfig
```kconfig
#
# For a description of the syntax of this configuration file,
# see the file kconfig-language.txt in the NuttX tools repository.
#

config EXAMPLES_SMP
	tristate "SMP example"
	default n
	---help---
		Enable the SMP example.  This example basically extracts the pthread
		barrier test from apps/examples/ostest and adds some instrumentation
		useful for debugging SMP implementations.

if EXAMPLES_SMP

config EXAMPLES_SMP_NBARRIER_THREADS
	int "Number of barrier threads"
	default 8
	---help---
		Specifies the number of threads to create in the SMP test.  The default
		is 8 but a smaller number may be needed on systems without sufficient memory
		to start so many threads.

config EXAMPLES_SMP_PROGNAME
	string "Program name"
	default "smp"
	depends on BUILD_LOADABLE
	---help---
		This is the name of the program that will be use when the NSH ELF
		program is installed.

config EXAMPLES_SMP_PRIORITY
	int "SMP task priority"
	default 100

config EXAMPLES_SMP_STACKSIZE
	int "SMP stack size"
	default 2048

endif
```

## examples/smps/Kconfig
```kconfig
#
# For a description of the syntax of this configuration file,
# see the file kconfig-language.txt in the NuttX tools repository.
#

config EXAMPLES_SMPS
	tristate "Smps example"

if EXAMPLES_SMPS

config EXAMPLES_SMPS_DEVPATH
	string "Smps device path"
	default "dev/smps0"
	---help---
		The default path to the Smps device. Default: /dev/smps0

config EXAMPLES_SMPS_TIME_DEFAULT
	int "SMPS example run time default (sec)"
	default 0

config EXAMPLES_SMPS_OUT_VOLTAGE_DEFAULT
	int "SMPS Output voltage default (mV)"
	default 0

config EXAMPLES_SMPS_OUT_CURRENT_DEFAULT
	int "SMPS Output current default (mA)"
	default 0

config EXAMPLES_SMPS_OUT_POWER_DEFAULT
	int "SMPS Output power default (mW)"
	default 0

config EXAMPLES_SMPS_IN_CURRENT_LIMIT
	int "SMPS Input Current limit (mA)"
	default 0
	---help---
		Input current limit for the SMPS driver in mA. Not used if 0

config EXAMPLES_SMPS_OUT_CURRENT_LIMIT
	int "SMPS Output Current limit (mA)"
	default 0
	---help---
		Output current limit for the SMPS driver in mA. Not used if 0

config EXAMPLES_SMPS_IN_VOLTAGE_LIMIT
	int "SMPS Input Voltage limit (mV)"
	default 0
	---help---
		Input voltage limit for the SMPS driver in mV. Not used if 0

config EXAMPLES_SMPS_OUT_VOLTAGE_LIMIT
	int "SMPS Output Voltage limit (mV)"
	default 0
	---help---
		Output voltage limit for the SMPS driver in mV. Not used if 0

config EXAMPLES_SMPS_IN_POWER_LIMIT
	int "SMPS Input Power limit (mW)"
	default 0
	---help---
		Input power limit for the SMPS driver in mW. Not used if 0

config EXAMPLES_SMPS_OUT_POWER_LIMIT
	int "SMPS Output Power limit (mW)"
	default 0
	---help---
		Output power limit for the SMPS driver in mW. Not used if 0

endif
```

## examples/sotest/Kconfig
```kconfig
#
# For a description of the syntax of this configuration file,
# see the file kconfig-language.txt in the NuttX tools repository.
#

config EXAMPLES_SOTEST
	tristate "Shared Library Example"
	default n
	depends on LIBC_DLLFCN
	---help---
		Enable the shared library example

if EXAMPLES_SOTEST

config EXAMPLES_SOTEST_BUILTINFS
	bool "Built-in File System"
	default y
	depends on FS_ROMFS && BUILD_FLAT
	---help---
		This example supports a very, non-standard but also very convenient
		way of testing with example using CONFIG_EXAMPLES_SOTEST_BUILTINFS.
		If this option is selected, the test shared libraries will be built,
		installed in the sotest/lib/fsroot, then converted to a built-in
		ROMFS file system.

		When the test runs, it will automatically create the ROMFS block
		device and mount the test shared libraries for testing.

		If this option is not selected, then the shared libraries will be
		left in the fsroot/ directory.  You can then copy them to, say an SD
		card, for testing on the target.

		NOTE: This option can only be used in the FLAT build mode because
		it makes an illegal OS call to ramdisk_register().

if EXAMPLES_SOTEST_BUILTINFS

config EXAMPLES_SOTEST_DEVMINOR
	int "ROMFS Minor Device Number"
	default 0
	---help---
		The minor device number of the ROMFS block. For example, the N in /dev/ramN.
		Used for registering the RAM block driver that will hold the ROMFS file system
		containing the SOTEST executables to be tested.  Default: 0

config EXAMPLES_SOTEST_DEVPATH
	string "ROMFS Device Path"
	default "/dev/ram0"
	---help---
		The path to the ROMFS block driver device.  This must match EXAMPLES_SOTEST_DEVMINOR.
		Used for registering the RAM block driver that will hold the ROMFS file system
		containing the SOTEST executables to be tested.  Default: "/dev/ram0"

endif # EXAMPLES_SOTEST_BUILTINFS

if !EXAMPLES_SOTEST_BUILTINFS

config EXAMPLES_SOTEST_BINDIR
	string "Path to Test Shared Libraries"
	default "/mnt/sdcard"
	---help---
		The path to the directoy on the mounted volume where the test shared
		libraries can found at runtime.

endif # !EXAMPLES_SOTEST_BUILTINFS

config EXAMPLES_SOTEST_LIBC
	bool "Link with LIBC"
	default n
	depends on !BUILD_LOADABLE && EXPERIMENTAL
	---help---
		Link with the C library (and also math library if it was built).
		By default, all undefined symbols must be provided via a symbol
		table.  But if this option is selected, then each SOTEST test program
		will link with the SYSCALL library and will interface with the OS
		system calls.  You probably will NOT want this option, however,
		because it will substantially increase the size of code.  For
		example, a separate copy of printf() would be linked with every
		program greatly increasing the total code size.  This option is
		primarily intended only for testing.

		WARNING:  Libc will not be built with -mlong-calls and this may
		result in runtime linking failures due to out-of-range functions
		calls.

config EXAMPLES_SOTEST_LIBGCC
	bool "Link with LIBGCC"
	default n
	depends on !BUILD_LOADABLE && EXPERIMENTAL

endif
```
