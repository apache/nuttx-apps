## examples/tcpecho/Kconfig
```kconfig
#
# For a description of the syntax of this configuration file,
# see the file kconfig-language.txt in the NuttX tools repository.
#

config EXAMPLES_TCPECHO
	tristate "Simple TCP echo server"
	default n
	---help---
		Simple single threaded, poll based TCP echo server. This example
		implements the TCP Echo Server from W. Richard Stevens
		UNIX Network Programming Book.

config EXAMPLES_TCPECHO_PORT
	int "Server Port"
	default 80
	depends on EXAMPLES_TCPECHO

config EXAMPLES_TCPECHO_BACKLOG
	int "Listen Backlog"
	default 8
	depends on EXAMPLES_TCPECHO

config EXAMPLES_TCPECHO_NCONN
	int "Number of Connections"
	default 8
	depends on EXAMPLES_TCPECHO

config EXAMPLES_TCPECHO_DHCPC
	bool "DHCP Client"
	default n
	depends on EXAMPLES_TCPECHO && !NSH_NETINIT
	select NETUTILS_DHCPC
	select NETDB_DNSCLIENT

config EXAMPLES_TCPECHO_NOMAC
	bool "Use Canned MAC Address"
	default n
	depends on EXAMPLES_TCPECHO && !NSH_NETINIT

config EXAMPLES_TCPECHO_IPADDR
	hex "Target IP address"
	default 0x0a000002
	depends on EXAMPLES_TCPECHO && !NSH_NETINIT && !EXAMPLES_TCPECHO_DHCPC

config EXAMPLES_TCPECHO_DRIPADDR
	hex "Default Router IP address (Gateway)"
	default 0x0a000001
	depends on EXAMPLES_TCPECHO && !NSH_NETINIT

config EXAMPLES_TCPECHO_NETMASK
	hex "Network Mask"
	default 0xffffff00
	depends on EXAMPLES_TCPECHO && !NSH_NETINIT
```

## examples/termios/Kconfig
```kconfig
#
# For a description of the syntax of this configuration file,
# see the file kconfig-language.txt in the NuttX tools repository.
#

config EXAMPLES_TERMIOS
	tristate "Termios example"
	default n
	---help---
		Enable the Termios example. This example
		shows how to change serial parameters like baud rate,
		stop bits, data length and parity using the termios interface.

if EXAMPLES_TERMIOS

config EXAMPLES_TERMIOS_PRIORITY
	int "Termios task priority"
	default 100

config EXAMPLES_TERMIOS_STACKSIZE
	int "Termios stack size"
	default DEFAULT_TASK_STACKSIZE

config EXAMPLES_TERMIOS_DIS_HW_FC
	bool "Disable HW flow control"
	default n
	---help---
		Disable HW flow control using TERMIOS.

endif
```

## examples/thttpd/Kconfig
```kconfig
#
# For a description of the syntax of this configuration file,
# see the file kconfig-language.txt in the NuttX tools repository.
#

config EXAMPLES_THTTPD
	tristate "THTTPD web server example"
	default n
	depends on FS_ROMFS && BUILD_FLAT
	---help---
		Enable the THTTPD web server example

if EXAMPLES_THTTPD

config EXAMPLES_THTTPD_NOMAC
	bool "Use Canned MAC Address"
	default n
	---help---
		May be defined to use a hard-coded, software assigned MAC of
		00:0e:de:ad:be:ef

config EXAMPLES_THTTPD_DRIPADDR
	hex "Default Router IP address (Gateway)"
	default 0x0a000001

config EXAMPLES_THTTPD_NETMASK
	hex "Network Mask"
	default 0xffffff00

endif
```

## examples/timer/Kconfig
```kconfig
#
# For a description of the syntax of this configuration file,
# see the file kconfig-language.txt in the NuttX tools repository.
#

config EXAMPLES_TIMER
	tristate "Timer example"
	default n
	depends on TIMER
	---help---
		Enable the timer example

if EXAMPLES_TIMER

config EXAMPLES_TIMER_DEVNAME
	string "Timer device name"
	default "/dev/timer0"
	---help---
		This is the name of the timer device that will be tested.

config EXAMPLES_TIMER_INTERVAL
	int "Timer interval (microseconds)"
	default 1000000
	---help---
		This is the timer interval in microseconds.

config EXAMPLES_TIMER_DELAY
	int "Sample delay (microseconds)"
	default 100000
	---help---
		This is the delay between timer samples in microseconds

config EXAMPLES_TIMER_NSAMPLES
	int "Number of samples"
	default 20
	---help---
		This is the number of timer samples that will be collected

config EXAMPLES_TIMER_SIGNO
	int "Notification signal number"
	default 17
	---help---
		This is the signal number that is used to notify the test of
		timer expiration events.

config EXAMPLES_TIMER_STACKSIZE
	int "Timer stack size"
	default DEFAULT_TASK_STACKSIZE
	---help---
		This is the stack size allocated when the timer task runs

config EXAMPLES_TIMER_PRIORITY
	int "Timer task priority"
	default 100
	---help---
		This is the priority of the timer task

config EXAMPLES_TIMER_PROGNAME
	string "Timer program name"
	default "timer"
	---help---
		This is the name of the program that will be used when the NSH ELF
		program is installed.

endif
```

## examples/timer_gpio/Kconfig
```kconfig
#
# For a description of the syntax of this configuration file,
# see the file kconfig-language.txt in the NuttX tools repository.
#

config EXAMPLES_TIMER_GPIO
	tristate "Timer GPIO example"
	default n
	depends on TIMER && DEV_GPIO
	---help---
		Enable the timer-gpio example. This example uses the timer interrupt
		to periodically change the state of a digital output. The digital
		output may be a relay, a led or anything else. This example can be
		very useful to validate timer drivers by using a logic analyzer
		connected to the digital output. This example differs from the timer
		example because it waits on a sigwaitinfo() instead of using a signal
		handler. This approach ensures a deterministic wake-up time when the
		signal occurs. 

if EXAMPLES_TIMER_GPIO

config EXAMPLES_TIMER_GPIO_TIM_DEVNAME
	string "Timer device name"
	default "/dev/timer0"
	---help---
		This is the name of the timer device that will be used.

config EXAMPLES_TIMER_GPIO_GPIO_DEVNAME
	string "GPIO device name"
	default "/dev/gpio0"
	---help---
		This is the name of the gpio device that will be used.

config EXAMPLES_TIMER_GPIO_INTERVAL
	int "Timer interval (microseconds)"
	default 1000000
	---help---
		This is the timer interval in microseconds.

config EXAMPLES_TIMER_GPIO_SIGNO
	int "Notification signal number"
	default 17
	---help---
		This is the signal number that is used to notify that a timer
		interrupt occurred.

config EXAMPLES_TIMER_GPIO_STACKSIZE
	int "Timer stack size"
	default DEFAULT_TASK_STACKSIZE
	---help---
		This is the stack size allocated when the timer task runs.

config EXAMPLES_TIMER_GPIO_PRIORITY
	int "Timer task priority"
	default 255
	---help---
		This is the priority of the timer task.

config EXAMPLES_TIMER_GPIO_PROGNAME
	string "Timer GPIO program name"
	default "timer_gpio"
	---help---
		This is the name of the program that will be used from the nsh.

endif
```

## examples/timer_gpout/Kconfig
```kconfig
#
# For a description of the syntax of this configuration file,
# see the file kconfig-language.txt in the NuttX tools repository.
#

config EXAMPLES_TIMER_GPOUT
	tristate "Timer GPOUT example"
	default n
	depends on TIMER && DEV_GPIO
	---help---
		Enable the timer-gpout example.
		This example uses the timer interrupt to periodically
		change the state of a digital output.
		The digital output may be a relay, a led or anything else.
		This example can be very useful to validate timer drivers
		by using a logic analyzer connected to the digital output.
		This example, differs from the timer example because it
		waits on a sigwaitinfo() instead of using a signal handler.
		This approach ensures a deterministic wake-up time when
		the signal occurs. 

if EXAMPLES_TIMER_GPOUT

config EXAMPLES_TIMER_GPOUT_TIM_DEVNAME
	string "Timer device name"
	default "/dev/timer0"
	---help---
		This is the name of the timer device that will be used.

config EXAMPLES_TIMER_GPOUT_GPOUT_DEVNAME
	string "GPOUT device name"
	default "/dev/gpout0"
	---help---
		This is the name of the gpout device that will be used.

config EXAMPLES_TIMER_GPOUT_INTERVAL
	int "Timer interval (microseconds)"
	default 1000000
	---help---
		This is the timer interval in microseconds.

config EXAMPLES_TIMER_GPOUT_SIGNO
	int "Notification signal number"
	default 17
	---help---
		This is the signal number that is used to notify that a timer
		interrupt occurred.

config EXAMPLES_TIMER_GPOUT_STACKSIZE
	int "Timer stack size"
	default DEFAULT_TASK_STACKSIZE
	---help---
		This is the stack size allocated when the timer task runs.

config EXAMPLES_TIMER_GPOUT_PRIORITY
	int "Timer task priority"
	default 255
	---help---
		This is the priority of the timer task.

config EXAMPLES_TIMER_GPOUT_PROGNAME
	string "Timer GPOUT program name"
	default "timer_gpout"
	---help---
		This is the name of the program that will be used from the nsh.

endif
```

## examples/tlpi/Kconfig
```kconfig
#
# For a description of the syntax of this configuration file,
# see the file kconfig-language.txt in the NuttX tools repository.
#

config EXAMPLES_TLPI
	tristate "The Linux Programming Interface Example"
	default n
	depends on ALLOW_GPL_COMPONENTS
	---help---
		Enable the tlpi

if EXAMPLES_TLPI

config EXAMPLES_TLPI_PRIORITY
	int "Task priority"
	default 100

config EXAMPLES_TLPI_STACKSIZE
	int "Stack size"
	default DEFAULT_TASK_STACKSIZE

endif
```

## examples/tmp112/Kconfig
```kconfig
#
# For a description of the syntax of this configuration file,
# see the file kconfig-language.txt in the NuttX tools repository.
#

config EXAMPLES_TMP112
	tristate "TMP112 temperature sensor example"
	default n
	depends on SENSORS_TMP112
	---help---
		Enable the TMP112 example

if EXAMPLES_TMP112

config EXAMPLES_TMP112_PROGNAME
	string "Program name"
	default "tmp112"
	---help---
		This is the name of the program that will be used when the NSH ELF
		program is installed.

config EXAMPLES_TMP112_PRIORITY
	int "TMP112 task priority"
	default 100

config EXAMPLES_TMP112_STACKSIZE
	int "TMP112 stack size"
	default DEFAULT_TASK_STACKSIZE

config EXAMPLES_TMP112_DEVPATH
	string "TMP112 device path"
	default "/dev/temp0"
	---help---
		The default path to the TMP112 temperature sensor device

endif
```

## examples/touchscreen/Kconfig
```kconfig
#
# For a description of the syntax of this configuration file,
# see the file kconfig-language.txt in the NuttX tools repository.
#

config EXAMPLES_TOUCHSCREEN
	tristate "Touchscreen example"
	default n
	---help---
		Enable the touchscreen example

if EXAMPLES_TOUCHSCREEN

config EXAMPLES_TOUCHSCREEN_MINOR
	int "Touchscreen minor device number"
	default 0
	---help---
		The minor device number.  Minor=N corresponds to touchscreen device
		/dev/inputN.  Note this value must with EXAMPLES_TOUCHSCREEN_DEVPATH.
		Default 0.

config EXAMPLES_TOUCHSCREEN_DEVPATH
	string "Touchscreen device path"
	default "/dev/input0"
	---help---
		The path to the touchscreen device.  This must be consistent with
		EXAMPLES_TOUCHSCREEN_MINOR. Default: "/dev/input0"

config EXAMPLES_TOUCHSCREEN_NSAMPLES
	int "Number of samples"
	default 0
	---help---
		This number of samples is collected and the program.
		terminates.  Default:  Zero (Samples are collected indefinitely).

config EXAMPLES_TOUCHSCREEN_MOUSE
	bool "Mouse interface"
	default n
	---help---
		The touchscreen test can also be configured to work with a mouse
		driver by setting this option.

endif
```

## examples/txmorse/Kconfig
```kconfig
#
# For a description of the syntax of this configuration file,
# see the file kconfig-language.txt in the NuttX tools repository.
#

config EXAMPLES_TXMORSE
	tristate "txmorse (Morse code transmitter)"
	default n
	depends on AUDIOUTILS_MORSEY
	---help---
		Enable the Morse code transmission example.

if EXAMPLES_TXMORSE

config EXAMPLES_TXMORSE_PROGNAME
	string "Program name"
	default "txmorse"
	---help---
		This is the name of the program that will be used when the NSH ELF
		program is installed.

config EXAMPLES_TXMORSE_PRIORITY
	int "txmorse task priority"
	default 100

config EXAMPLES_TXMORSE_STACKSIZE
	int "txmorse stack size"
	default DEFAULT_TASK_STACKSIZE

endif
```

## examples/uavcan/Kconfig
```kconfig
#
# For a description of the syntax of this configuration file,
# see the file kconfig-language.txt in the NuttX tools repository.
#

config EXAMPLES_UAVCAN
	bool "UAVCAN example"
	default n
	depends on CANUTILS_LIBUAVCAN
	---help---
		Enable the UAVCAN example

if EXAMPLES_UAVCAN

config EXAMPLES_UAVCAN_NODE_MEM_POOL_SIZE
	int "Node Memory Pool Size"
	default 4096
	---help---
		Specifies the node's memory pool size

config EXAMPLES_UAVCAN_NODE_ID
	int "Node ID"
	default 1
	range 1 127
	---help---
		Specifies the node's ID

config EXAMPLES_UAVCAN_NODE_NAME
	string "Node Name"
	default "org.nuttx.apps.examples.uavcan"
	---help---
		Specifies the node's name

endif
```

## examples/ubloxmodem/Kconfig
```kconfig
#
# For a description of the syntax of this configuration file,
# see the file kconfig-language.txt in the NuttX tools repository.
#


menuconfig EXAMPLES_UBLOXMODEM
	bool "u-blox modem configuration tool"
	default n
	---help---
		Enable the u-blox modem configuration tool.

if EXAMPLES_UBLOXMODEM

config EXAMPLES_UBLOXMODEM_TTY_DEVNODE
	string "u-blox modem TTY device node"
	default "/dev/ttyS1"
	---help---
		TTY device node associated to the u-blox modem UART.

config EXAMPLES_UBLOXMODEM_DEVNODE
	string "u-blox modem device node"
	default "/dev/ubxmdm"
	---help---
		Device node created by the u-blox modem driver.

endif
```

## examples/udgram/Kconfig
```kconfig
#
# For a description of the syntax of this configuration file,
# see the file kconfig-language.txt in the NuttX tools repository.
#

config EXAMPLES_UDGRAM
	tristate "Unix domain datagram example"
	default n
	depends on NET_LOCAL
	---help---
		Enable the Unix domain SOCK_DGRAM test example

if EXAMPLES_UDGRAM

config EXAMPLES_UDGRAM_ADDR
	string "Unix domain address"
	default "/dev/fifo"

config EXAMPLES_UDGRAM_SERVER_STACKSIZE
	int "Server stack size"
	default 4096
	---help---
		This is the stack size allocated when the server task runs

config EXAMPLES_UDGRAM_SERVER_PRIORITY
	int "Server task priority"
	default 100
	---help---
		This is the priority of the server task

config EXAMPLES_UDGRAM_SERVER_PROGNAME
	string "Server program name"
	default "server"
	---help---
		This is the name of the program that will be used when the NSH ELF
		server program is installed.

config EXAMPLES_UDGRAM_CLIENT_STACKSIZE
	int "Client stack size"
	default 4096
	---help---
		This is the stack size allocated when the client task runs

config EXAMPLES_UDGRAM_CLIENT_PRIORITY
	int "Client task priority"
	default 100
	---help---
		This is the priority of the client task

config EXAMPLES_UDGRAM_CLIENT_PROGNAME
	string "Client program name"
	default "client"
	---help---
		This is the name of the program that will be used when the NSH ELF
		client program is installed.

endif # EXAMPLES_UDGRAM
```
