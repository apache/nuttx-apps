## examples/usbmsc/Kconfig
```kconfig
#
# For a description of the syntax of this configuration file,
# see misc/tools/kconfig-language.txt.
#

config EXAMPLES_USBMSC
	bool "USB mass storage class example"
	default n
	---help---
		Enable the USB mass storage class example

if EXAMPLES_USBMSC

config EXAMPLES_USBMSC_NLUNS
	int "Number of LUNs"
	default 1
	---help---
		Defines the number of logical units (LUNs) exported by the USB
		storage driver.  Each LUN corresponds to one exported block driver
		(or partition of a block driver).  May be 1, 2, or 3.  Default is 1.

config EXAMPLES_USBMSC_DEVMINOR1
	int "LUN1 Minor Device Number"
	default 0
	---help---
		The minor device number of the block driver for the first LUN. For
		example, N in /dev/mmcsdN.  Used for registering the block driver.
		Default is zero.

config EXAMPLES_USBMSC_DEVPATH1
	string "LUN1 Device Path"
	default "/dev/mmcsd0"
	---help---
		The full path to the registered block driver.  Default is
		"/dev/mmcsd0"

config EXAMPLES_USBMSC_DEVMINOR2
	int "LUN2 Minor Device Number"
	default 1
	---help---
		The minor device number of the block driver for the second LUN. For
		example, N in /dev/mmcsdN.  Used for registering the block driver.
		Ignored if EXAMPLES_USBMSC_NLUNS < 2. Default is one.

config EXAMPLES_USBMSC_DEVPATH2
	string "LUN2 Device Path"
	default "/dev/mmcsd1"
	---help---
		The full path to the registered block driver.  Ignored if
		EXAMPLES_USBMSC_NLUNS < 2. Default is "/dev/mmcsd1"

config EXAMPLES_USBMSC_DEVMINOR3
	int "LUN3 Minor Device Number"
	default 2
	---help---
		The minor device number of the block driver for the third LUN. For
		example, N in /dev/mmcsdN.  Used for registering the block driver.
		Ignored if EXAMPLES_USBMSC_NLUNS < 2. Default is two.

config EXAMPLES_USBMSC_DEVPATH3
	string "LUN3 Device Path"
	default "/dev/mmcsd2"
	---help---
		The full path to the registered block driver.  Ignored if
		EXAMPLES_USBMSC_NLUNS < 2. Default is "/dev/mmcsd2"

config EXAMPLES_USBMSC_DEBUGMM
	bool "USB MSC MM Debug"
	default n
	---help---
		Enables some debug tests to check for memory usage and memory leaks.

config EXAMPLES_USBMSC_TRACE
	bool "Trace USB activity"
	default n
	depends on (USBDEV_TRACE || DEBUG_USB) && !NSH_BUILTIN_APPS
	---help---
		If this example is built as a standalone task and if USB device tracing is
		enabled, then this example can be configured to unobtrusively monitor
		USB activity by selecting this option.

if EXAMPLES_USBMSC_TRACE

config EXAMPLES_USBMSC_TRACEINIT
	bool "USB Trace Initialization"
	default n
	---help---
		If USBDEV_TRACE is enabled (or DEBUG and DEBUG_USB),
		then the example code will also manage the USB trace output.  The
		amount of trace output can be controlled this configuration value:
		This setting will show USB initialization events

config EXAMPLES_USBMSC_TRACECLASS
	bool "USB Trace Class"
	default n
	---help---
		If USBDEV_TRACE is enabled (or DEBUG and DEBUG_USB),
		then the example code will also manage the USB trace output.  The
		amount of trace output can be controlled this configuration value:
		This setting will show USB class driver events

config EXAMPLES_USBMSC_TRACETRANSFERS
	bool "USB Trace Transfers"
	default n
	---help---
		If USBDEV_TRACE is enabled (or DEBUG and DEBUG_USB),
		then the example code will also manage the USB trace output.  The
		amount of trace output can be controlled this configuration value:
		This setting will show USB data transfer events

config EXAMPLES_USBMSC_TRACECONTROLLER
	bool "USB Trace Device Controller Events"
	default n
	---help---
		If USBDEV_TRACE is enabled (or DEBUG and DEBUG_USB),
		then the example code will also manage the USB trace output.  The
		amount of trace output can be controlled this configuration value:
		This setting will show USB device controller events

config EXAMPLES_USBMSC_TRACEINTERRUPTS
	bool "USB Trace Device Controller Interrupt Events"
	default n
	---help---
		If USBDEV_TRACE is enabled (or DEBUG and DEBUG_USB),
		then the example code will also manage the USB trace output.  The
		amount of trace output can be controlled this configuration value:
		This setting will show USB device controller interrupt-related events.

endif # EXAMPLES_USBMSC_TRACE

if NSH_BUILTIN_APPS

config EXAMPLES_USBMSC_CMD_STACKSIZE
	int "Stacksize of msconn and msdis commands"
	default 768
	---help---
		Size of the stack used by the small 'msconn' and 'msdis' command
		applications.  Warning, just because the applications are small,
		the stack usage could still be deep!

config EXAMPLES_USBMSC_CMD_PRIORITY
	int "Priority of the msconn and msdis commands"
	default 100
	---help---
		Priority of the small 'msconn' and 'msdis' command applications.

config EXAMPLES_USBMSC_DAEMON_STACKSIZE
	int "Stacksize of msconn daemon"
	default 2048
	---help---
		To avoid threading entanglements, the USB MSC class is initialized
		on a daemon thread.  This permits the msconn application to return
		to the NSH command line immediately.  This is the stack used for
		that short-lived USB MSC initialization daemon.

config EXAMPLES_USBMSC_DAEMON_PRIORITY
	int "Priority of the msconn daemon"
	default 100
	---help---
		To avoid threading entanglements, the USB MSC class is initialized
		on a daemon thread.  This permits the msconn application to return
		to the NSH command line immediately.  This is the priority used for
		that short-lived USB MSC initialization daemon.

endif # NSH_BUILTIN_APPS
endif # EXAMPLES_USBMSC
```

## examples/usbserial/Kconfig
```kconfig
#
# For a description of the syntax of this configuration file,
# see the file kconfig-language.txt in the NuttX tools repository.
#

config EXAMPLES_USBSERIAL
	tristate "USB serial test example"
	default n
	depends on BOARDCTL
	select BOARDCTL_USBDEVCTRL
	---help---
		Enable the USB serial test example

if EXAMPLES_USBSERIAL

config EXAMPLES_USBSERIAL_BUFSIZE
	int "Target I/O Buffer Size"
	default 512
	---help---
		The size of the array that is used as an I/O buffer for USB serial
		data transfers.

choice
	prompt "USB serial transfer"
	default EXAMPLES_USBSERIAL_INANDOUT
	---help---
		Select usb serial transfer in or out

config EXAMPLES_USBSERIAL_INANDOUT
	bool "in and out"

config EXAMPLES_USBSERIAL_INONLY
	bool "in only"

config EXAMPLES_USBSERIAL_OUTONLY
	bool "out only"

endchoice # USBSERIAL in or out

config EXAMPLES_USBSERIAL_CONFIG_WAIT
	bool "Config waiting time"
	default n
	---help---
		Config waiting time after transfer

if EXAMPLES_USBSERIAL_CONFIG_WAIT

config EXAMPLES_USBSERIAL_IN_WAITING_TIME
	int "In waiting time (ms)"
	default 100

config EXAMPLES_USBSERIAL_OUT_WAITING_TIME
	int "Out waiting time (ms)"
	default 100

endif # USERSERIAL config wait

choice
	prompt "USB serial message"
	default EXAMPLES_USBSERIAL_SMALLANDBIG
	---help---
		Select usb serial small or big message

config EXAMPLES_USBSERIAL_SMALLANDBIG
	bool "small and big"

config EXAMPLES_USBSERIAL_ONLYSMALL
	bool "only small"

config EXAMPLES_USBSERIAL_ONLYBIG
	bool "only big"

endchoice # USBSERIAL small or big message

config EXAMPLES_USBSERIAL_TRACEINIT
	bool "USB Trace Initialization"
	default n
	depends on USBDEV_TRACE || DEBUG_USB
	---help---
		If USBDEV_TRACE is enabled (or CONFIG_DEBUG_FEATURES and CONFIG_DEBUG_USB),
		then the example code will also manage the USB trace output.  The
		amount of trace output can be controlled this configuration value:
		This setting will show USB initialization events

config EXAMPLES_USBSERIAL_TRACECLASS
	bool "USB Trace Class"
	default n
	depends on USBDEV_TRACE || DEBUG_USB
	---help---
		If USBDEV_TRACE is enabled (or CONFIG_DEBUG_FEATURES and CONFIG_DEBUG_USB),
		then the example code will also manage the USB trace output.  The
		amount of trace output can be controlled this configuration value:
		This setting will show USB class driver events

config EXAMPLES_USBSERIAL_TRACETRANSFERS
	bool "USB Trace Transfers"
	default n
	depends on USBDEV_TRACE || DEBUG_USB
	---help---
		If USBDEV_TRACE is enabled (or CONFIG_DEBUG_FEATURES and CONFIG_DEBUG_USB),
		then the example code will also manage the USB trace output.  The
		amount of trace output can be controlled this configuration value:
		This setting will show USB data transfer events

config EXAMPLES_USBSERIAL_TRACECONTROLLER
	bool "USB Trace Device Controller Events"
	default n
	depends on USBDEV_TRACE || DEBUG_USB
	---help---
		If USBDEV_TRACE is enabled (or CONFIG_DEBUG_FEATURES and CONFIG_DEBUG_USB),
		then the example code will also manage the USB trace output.  The
		amount of trace output can be controlled this configuration value:
		This setting will show USB device controller events

config EXAMPLES_USBSERIAL_TRACEINTERRUPTS
	bool "USB Trace Device Controller Interrupt Events"
	default n
	depends on USBDEV_TRACE || DEBUG_USB
	---help---
		If USBDEV_TRACE is enabled (or CONFIG_DEBUG_FEATURES and CONFIG_DEBUG_USB),
		then the example code will also manage the USB trace output.  The
		amount of trace output can be controlled this configuration value:
		This setting will show USB device controller interrupt-related events.

endif
```

## examples/usbterm/Kconfig
```kconfig
#
# For a description of the syntax of this configuration file,
# see the file kconfig-language.txt in the NuttX tools repository.
#

config EXAMPLES_USBTERM
	bool "USB serial terminal example"
	default n
	---help---
		Enable the USB serial terminal example

if EXAMPLES_USBTERM

config EXAMPLES_USBTERM_TRACEINIT
	bool "USB Trace Initialization"
	default n
	depends on USBDEV_TRACE || DEBUG_USB
	---help---
		If USBDEV_TRACE is enabled (or DEBUG and DEBUG_USB),
		then the example code will also manage the USB trace output.  The
		amount of trace output can be controlled this configuration value:
		This setting will show USB initialization events

config EXAMPLES_USBTERM_TRACECLASS
	bool "USB Trace Class"
	default n
	depends on USBDEV_TRACE || DEBUG_USB
	---help---
		If USBDEV_TRACE is enabled (or DEBUG and DEBUG_USB),
		then the example code will also manage the USB trace output.  The
		amount of trace output can be controlled this configuration value:
		This setting will show USB class driver events

config EXAMPLES_USBTERM_TRACETRANSFERS
	bool "USB Trace Transfers"
	default n
	depends on USBDEV_TRACE || DEBUG_USB
	---help---
		If USBDEV_TRACE is enabled (or DEBUG and DEBUG_USB),
		then the example code will also manage the USB trace output.  The
		amount of trace output can be controlled this configuration value:
		This setting will show USB data transfer events

config EXAMPLES_USBTERM_TRACECONTROLLER
	bool "USB Trace Device Controller Events"
	default n
	depends on USBDEV_TRACE || DEBUG_USB
	---help---
		If USBDEV_TRACE is enabled (or DEBUG and DEBUG_USB),
		then the example code will also manage the USB trace output.  The
		amount of trace output can be controlled this configuration value:
		This setting will show USB device controller events

config EXAMPLES_USBTERM_TRACEINTERRUPTS
	bool "USB Trace Device Controller Interrupt Events"
	default n
	depends on USBDEV_TRACE || DEBUG_USB
	---help---
		If USBDEV_TRACE is enabled (or DEBUG and DEBUG_USB),
		then the example code will also manage the USB trace output.  The
		amount of trace output can be controlled this configuration value:
		This setting will show USB device controller interrupt-related events.

endif
```

## examples/userfs/Kconfig
```kconfig
#
# For a description of the syntax of this configuration file,
# see the file kconfig-language.txt in the NuttX tools repository.
#

config EXAMPLES_USERFS
	tristate "UserFS test"
	default n
	---help---
		Enables a simple test of the UserFS

if EXAMPLES_USERFS

config EXAMPLES_USERFS_PROGNAME
	string "Program name"
	default "userfs"
	---help---
		This is the name of the program that will be used when the NSH ELF
		program is installed.

config EXAMPLES_USERFS_PRIORITY
	int "UserFS task priority"
	default 100

config EXAMPLES_USERFS_STACKSIZE
	int "UserFS stack size"
	default DEFAULT_TASK_STACKSIZE

endif
```

## examples/usrsocktest/Kconfig
```kconfig
#
# For a description of the syntax of this configuration file,
# see misc/tools/kconfig-language.txt.
#

config EXAMPLES_USRSOCKTEST
	tristate "USRSOCK test example"
	default n
	depends on NET && NET_USRSOCK
	select NET_USRSOCK_TCP
	select NET_USRSOCK_UDP
	select NET_SOCKOPTS
	select PIPES
	---help---
		Enable the User Socket test example. This example application runs
		unit-tests for /dev/usrsock.

if EXAMPLES_USRSOCKTEST

config EXAMPLES_USRSOCKTEST_PROGNAME
	string "Program name"
	default "usrsocktest"
	---help---
		This is the name of the program that will be used when the NSH ELF
		program is installed.

config EXAMPLES_USRSOCKTEST_PRIORITY
	int "usrsocktest task priority"
	default 100

config EXAMPLES_USRSOCKTEST_STACKSIZE
	int "usrsocktest stack size"
	default 4096

endif
```

## examples/ustream/Kconfig
```kconfig
#
# For a description of the syntax of this configuration file,
# see the file kconfig-language.txt in the NuttX tools repository.
#

config EXAMPLES_USTREAM
	tristate "Unix domain stream example"
	default n
	depends on NET_LOCAL
	---help---
		Enable the Unix domain SOCK_STREAM test example

if EXAMPLES_USTREAM

config EXAMPLES_USTREAM_ADDR
	string "Unix domain address"
	default "/dev/fifo"

config EXAMPLES_USTREAM_USE_POLL
	bool "Use poll for checking socket readiness"
	default n

endif # EXAMPLES_USTREAM
```

## examples/uvc_cam/Kconfig
```kconfig
#
# For a description of the syntax of this configuration file,
# see the file kconfig-language.txt in the NuttX tools repository.
#

config EXAMPLES_UVC_CAM
	tristate "UVC Camera streaming example"
	default n
	depends on USBUVC && VIDEO
	---help---
		Captures frames from V4L2 camera and streams to USB host
		via UVC gadget driver (/dev/uvc0).

if EXAMPLES_UVC_CAM

config EXAMPLES_UVC_CAM_PROGNAME
	string "Program name"
	default "uvc_cam"

config EXAMPLES_UVC_CAM_PRIORITY
	int "Task priority"
	default 100

config EXAMPLES_UVC_CAM_STACKSIZE
	int "Stack size"
	default 4096

config EXAMPLES_UVC_CAM_NFRAMES
	int "Number of frames (0=infinite)"
	default 0

endif
```
