## examples/veml6070/Kconfig
```kconfig
#
# For a description of the syntax of this configuration file,
# see the file kconfig-language.txt in the NuttX tools repository.
#

config EXAMPLES_VEML6070
	tristate "VEML6070 UltraViolet sensor example"
	default n
	depends on SENSORS_VEML6070
	---help---
		Enable the VEML6070 example

if EXAMPLES_VEML6070

config EXAMPLES_VEML6070_PROGNAME
	string "Program name"
	default "veml6070"
	depends on BUILD_LOADABLE
	---help---
		This is the name of the program that will be use when the NSH ELF
		program is installed.

config EXAMPLES_VEML6070_PRIORITY
	int "VEML6070 task priority"
	default 100

config EXAMPLES_VEML6070_STACKSIZE
	int "VEML6070 stack size"
	default 2048

endif
```

## examples/vl53l1x/Kconfig
```kconfig
#
# For a description of the syntax of this configuration file,
# see the file kconfig-language.txt in the NuttX tools repository.
#

config EXAMPLES_VL53L1X
	tristate "\"VL53L1X\" example"
	default n
	---help---
		Enable the \"VL53L1X\" example

if EXAMPLES_VL53L1X

config EXAMPLES_VL53L1X_PROGNAME
	string "Program name"
	default "vl53l1x"
	depends on BUILD_LOADABLE
	---help---
		This is the name of the program that will be use when the NSH ELF
		program is installed.

config EXAMPLES_VL53L1X_PRIORITY
	int "VL53L1X priority"
	default 100

config EXAMPLES_VL53L1X_STACKSIZE
	int "VL53L1X stack size"
	default 2048

endif
```

## examples/vsock/Kconfig
```kconfig
#
# For a description of the syntax of this configuration file,
# see the file kconfig-language.txt in the NuttX tools repository.
#

config EXAMPLES_VSOCK
	tristate "\"Vsocket\" example"
	default n

if EXAMPLES_VSOCK

config EXAMPLES_VSOCK_PROGNAME
	string "Program name"
	default "vsock"

config EXAMPLES_VSOCK_PRIORITY
	int "Vsock task priority"
	default 100

config EXAMPLES_VSOCK_STACKSIZE
	int "Vsock stack size"
	default DEFAULT_TASK_STACKSIZE

endif
```

## examples/wamr_module/Kconfig
```kconfig
#
# For a description of the syntax of this configuration file,
# see the file kconfig-language.txt in the NuttX tools repository.
#

config EXAMPLES_WAMR_MODULE
	tristate "WAMR module example"
	default n
	---help---
		This example demonstrates how to register a external module
		into WAMR runtime.
```

## examples/watchdog/Kconfig
```kconfig
#
# For a description of the syntax of this configuration file,
# see the file kconfig-language.txt in the NuttX tools repository.
#

config EXAMPLES_WATCHDOG
	tristate "Watchdog Timer example"
	default n
	---help---
		Enable the watchdog timer example

		In order to use this example, board specific logic must register the
		watchdog timer driver.  That would be in the board bring-up logic
		in the boards/<arch/<chip>/<board>/src directory for the board.

		The way that this is done depends on the underlying MCU architecture.
		For STM32, this would be done like:

			#include "stm32_wdg.h"

			#if defined(CONFIG_STM32_WWDG)
			  stm32_wwdginitialize(CONFIG_STM32_WDG_DEVPATH);
			#elif defined(CONFIG_STM32_IWDG)
			  stm32_iwdginitialize(CONFIG_STM32_WDG_DEVPATH, CONFIG_STM32_LSIFREQ);
			#endif

		For some Atmel SAM configurations, the board-specific initialization
		sequence would be like:

			#include "sam_wdt.h"

			sam_wdt_initialize();

if EXAMPLES_WATCHDOG

config EXAMPLES_WATCHDOG_DEVPATH
	string "Watchdog device path"
	default "/dev/watchdog0"
	---help---
		The path to the watchdog device. Default: /dev/watchdog0

config EXAMPLES_WATCHDOG_PINGTIME
	int "Watchdog ping time"
	default 5000
	---help---
		Time in milliseconds that the example will ping the watchdog before letting the
		watchdog expire. Default: 5000 milliseconds.

config EXAMPLES_WATCHDOG_PINGDELAY
	int "Watchdog ping delay"
	default 500
	---help---
		Time delay between pings in milliseconds. Default: 500 milliseconds.

config EXAMPLES_WATCHDOG_TIMEOUT
	int "Watchdog timeout"
	default 2000
	---help---
		The watchdog timeout value in milliseconds before the watchdog timer
		expires.  Default:  2000 milliseconds.

endif
```

## examples/watched/Kconfig
```kconfig
#
# For a description of the syntax of this configuration file,
# see the file kconfig-language.txt in the NuttX tools repository.
#

config EXAMPLES_WATCHED
	tristate "Watched example"
	default y
	depends on EXAMPLES_WATCHER
	---help---
		This application works with the watcher example and plays
		the role of the watched task. This process will create 2
		watched tasks. These tasks will subscribe to be watched. 
		One task will feed the dog and the other will starve the dog.
		So, the watchdog timer will expire and the offending task will
		be printed. 

if EXAMPLES_WATCHED

config EXAMPLES_WATCHED_PROGNAME
	string "Program name"
	default "watched"
	---help---
		This is the name of the program that will be used when the NSH ELF
		program is installed.

config EXAMPLES_WATCHED_PRIORITY
	int "Watched task priority"
	default 100

config EXAMPLES_WATCHED_STACKSIZE
	int "Watched stack size"
	default DEFAULT_TASK_STACKSIZE

endif
```

## examples/watcher/Kconfig
```kconfig
#
# For a description of the syntax of this configuration file,
# see the file kconfig-language.txt in the NuttX tools repository.
#

config EXAMPLES_WATCHER
	tristate "Watcher example"
	default n
	depends on DRIVER_NOTERAM
	depends on FSUTILS_MKFATFS
	---help---
		Enable the watcher example. The watcher is a task that will monitor
		other tasks that have previously subscribed to be watched. If the 
		watched tasks don't signal the watcher during the watchdog time period,
		the watchdog timer will expire and the watcher will print the tasks that
		did not signal and the ones that signaled. This example will only be supported
		by the chips that supports interrupt on timeout, i.e., which have the \"capture\"
		command implemented.

if EXAMPLES_WATCHER

config EXAMPLES_WATCHER_PROGNAME
	string "Program name"
	default "watcher"
	---help---
		This is the name of the program that will be used when the NSH ELF
		program is installed.

config EXAMPLES_WATCHER_PRIORITY
	int "Watcher task priority"
	default 100

config EXAMPLES_WATCHER_STACKSIZE
	int "Watcher stack size"
	default DEFAULT_TASK_STACKSIZE

config EXAMPLES_WATCHER_DEVPATH
	string "Watchdog device path"
	default "/dev/watchdog0"

config EXAMPLES_WATCHER_TIMEOUT
	int "Watchdog timeout in ms"
	default 5000

config EXAMPLES_WATCHER_SIGNAL
	int "Signal Number for communication"
	default 17
	---help---
		This is the Signal Number used for communication between the watcher task and the watched tasks.

endif
```

## examples/webpanel/Kconfig
```kconfig
#
# For a description of the syntax of this configuration file,
# see the file kconfig-language.txt in the NuttX tools repository.
#

config EXAMPLES_WEBPANEL
	tristate "Web Panel for device management"
	default n
	depends on NET_TCP
	depends on NETUTILS_THTTPD
	depends on NETUTILS_LIBWEBSOCKETS
	depends on NETUTILS_LIBWEBSOCKETS_SERVER
	depends on FS_BINFS
	depends on FS_UNIONFS
	depends on PSEUDOTERM
	depends on PSEUDOTERM_SUSV1
	---help---
		Enable the Web Panel application, a Tasmota-inspired web
		interface for NuttX devices. Provides a landing page served
		via THTTPD from ROMFS, CGI handlers for system info, file
		management, and a WebSocket-based NSH terminal (powered
		by libwebsockets).

if EXAMPLES_WEBPANEL

config EXAMPLES_WEBPANEL_PROGNAME
	string "Program name"
	default "webpanel"

config EXAMPLES_WEBPANEL_PRIORITY
	int "Web Panel task priority"
	default 100

config EXAMPLES_WEBPANEL_STACKSIZE
	int "Web Panel stack size"
	default 4096

config EXAMPLES_WEBPANEL_NETIF
	string "Network interface name"
	default "eth0"
	---help---
		Name of the network interface used by the web panel for
		system info queries and DHCP renew (e.g. eth0, wlan0).

config EXAMPLES_WEBPANEL_CGI_SYSINFO_PROGNAME
	string "CGI sysinfo program name"
	default "sysinfo"

config EXAMPLES_WEBPANEL_CGI_SYSINFO_PRIORITY
	int "CGI sysinfo task priority"
	default 100

config EXAMPLES_WEBPANEL_CGI_SYSINFO_STACKSIZE
	int "CGI sysinfo stack size"
	default 4096

config EXAMPLES_WEBPANEL_CGI_FILES_PROGNAME
	string "CGI files program name"
	default "files"

config EXAMPLES_WEBPANEL_CGI_FILES_PRIORITY
	int "CGI files task priority"
	default 100

config EXAMPLES_WEBPANEL_CGI_FILES_STACKSIZE
	int "CGI files stack size"
	default 4096

config EXAMPLES_WEBPANEL_CGI_UPLOAD_PROGNAME
	string "CGI upload program name"
	default "upload"

config EXAMPLES_WEBPANEL_CGI_UPLOAD_PRIORITY
	int "CGI upload task priority"
	default 100

config EXAMPLES_WEBPANEL_CGI_UPLOAD_STACKSIZE
	int "CGI upload stack size"
	default 8192

config EXAMPLES_WEBPANEL_CGI_RENEW_PROGNAME
	string "CGI DHCP renew program name"
	default "dhcprenew"

config EXAMPLES_WEBPANEL_CGI_RENEW_PRIORITY
	int "CGI DHCP renew task priority"
	default 100

config EXAMPLES_WEBPANEL_CGI_RENEW_STACKSIZE
	int "CGI DHCP renew stack size"
	default 4096

config EXAMPLES_WEBPANEL_WS_PORT
	int "WebSocket terminal TCP port"
	default 8080

config EXAMPLES_WEBPANEL_WS_PRIORITY
	int "WebSocket server task priority"
	default 100

config EXAMPLES_WEBPANEL_WS_STACKSIZE
	int "WebSocket daemon stack size"
	default 8192

config EXAMPLES_WEBPANEL_WS_NSH_STACKSIZE
	int "WebSocket NSH session stack size"
	default 4096

endif
```

## examples/webserver/Kconfig
```kconfig
#
# For a description of the syntax of this configuration file,
# see the file kconfig-language.txt in the NuttX tools repository.
#

config EXAMPLES_WEBSERVER
	tristate "uIP web server example"
	default n
	---help---
		Enable the uIP web server example

if EXAMPLES_WEBSERVER

config EXAMPLES_WEBSERVER_IPADDR
	hex "Device IP"
	default 0x0a000002
	---help---
		This is the IP address of your board.

config EXAMPLES_WEBSERVER_DRIPADDR
	hex "Default Router IP"
	default 0x0a000001
	---help---
		This is the IP address of your router/gateway.

config EXAMPLES_WEBSERVER_NETMASK
	hex "Network Mask"
	default 0xffffff00
	---help---
		This is the network mask to use on this device.

config EXAMPLES_WEBSERVER_DHCPC
	bool "Enable DHCPC"
	default n
	---help---
		Enable DHCP client.

config EXAMPLES_WEBSERVER_NOMAC
	bool "No hardware MAC"
	default y
	---help---
		Some devices don't have hardware MAC then we need to define a
		software MAC.

endif
```

## examples/wget/Kconfig
```kconfig
#
# For a description of the syntax of this configuration file,
# see the file kconfig-language.txt in the NuttX tools repository.
#

config EXAMPLES_WGET
	tristate "wget example"
	default n
	depends on NET_TCP
	---help---
		Enable the wget example

if EXAMPLES_WGET

config EXAMPLES_WGET_STACKSIZE
	int "wget stack size"
	default DEFAULT_TASK_STACKSIZE
	---help---
		Stack size of "wget" command. If you use SSL connection,
		you should increase this value around 8096.

config EXAMPLES_WGET_URL
	string "File URL"
	default ""
	---help---
		The URL of the file to get

config EXAMPLES_WGET_NOMAC
	bool "Use Canned MAC Address"
	depends on !NSH_NETINIT
	default n

config EXAMPLES_WGET_IPADDR
	hex "Target IP address"
	default 0x0a000002

config EXAMPLES_WGET_DRIPADDR
	hex "Default Router IP address (Gateway)"
	default 0x0a000001

config EXAMPLES_WGET_NETMASK
	hex "Network Mask"
	default 0xffffff00

endif
```

## examples/wgetjson/Kconfig
```kconfig
#
# For a description of the syntax of this configuration file,
# see the file kconfig-language.txt in the NuttX tools repository.
#

config EXAMPLES_WGETJSON
	tristate "wget JSON Example"
	default n
	depends on NETUTILS_CJSON
	---help---
		Enable the wget JSON example

if EXAMPLES_WGETJSON

config EXAMPLES_WGETJSON_MAXSIZE
	int "Max. JSON Buffer Size"
	default 1024

config EXAMPLES_WGETJSON_URL
	string "wget URL"
	default "http://10.0.0.1/wgetjson/json_cmd.php"

config EXAMPLES_WGETPOST_URL
	string "wget_post URL"
	default "http://10.0.0.1/wgetjson/post_cmd.php"

endif
```

## examples/wiegand/Kconfig
```kconfig
#
# For a description of the syntax of this configuration file,
# see the file kconfig-language.txt in the NuttX tools repository.
#

config EXAMPLES_WIEGAND
	tristate "Wiegand example"
	default n
	---help---
		Enable the wiegand example

if EXAMPLES_WIEGAND

config EXAMPLES_WIEGAND_PROGNAME
	string "Program name"
	default "wiegand"
	---help---
		This is the name of the program that will be used when the NSH ELF
		program is installed.

config EXAMPLES_WIEGAND_PRIORITY
	int "wiegand task priority"
	default 100

config EXAMPLES_WIEGAND_STACKSIZE
	int "wiegand stack size"
	default DEFAULT_TASK_STACKSIZE

endif
```

## examples/ws2812/Kconfig
```kconfig
#
# For a description of the syntax of this configuration file,
# see the file kconfig-language.txt in the NuttX tools repository.
#

config EXAMPLES_WS2812
	tristate "ws2812 Demo Program"
	default n
	---help---
		Enable the ws2812 demo

if EXAMPLES_WS2812

config EXAMPLES_WS2812_PROGNAME
	string "Program Name"
	default "ws2812"
	---help---
		This is the name of the program that will be used when the NSH ELF
		program is installed.

config EXAMPLES_WS2812_PRIORITY
	int "Task Priority"
	default 100

config EXAMPLES_WS2812_STACKSIZE
	int "Stack Size"
	default DEFAULT_TASK_STACKSIZE

config EXAMPLES_WS2812_DEFAULT_DEV
	string "Default Device"
	default "/dev/leds0"

endif
```

## examples/ws2812esp32rmt/Kconfig
```kconfig
#
# For a description of the syntax of this configuration file,
# see the file kconfig-language.txt in the NuttX tools repository.
#

config EXAMPLES_WS2812_ESP32_RMT
	tristate "ws2812 Demo Program using ESP32_RMT"
	depends on ESP32_RMT
	default n
	---help---
		Enable the ws2812 demo, using ESP32 RMT peripheral to generate the pulses

if EXAMPLES_WS2812_ESP32_RMT

config EXAMPLES_WS2812_ESP32_RMT_PROGNAME
	string "Program Name"
	default "ws2812esp32"
	---help---
		This is the name of the program that will be used when the NSH ELF
		program is installed.

config EXAMPLES_WS2812_ESP32_RMT_PRIORITY
	int "Task Priority"
	default 100

config EXAMPLES_WS2812_ESP32_RMT_STACKSIZE
	int "Stack Size"
	default DEFAULT_TASK_STACKSIZE

endif
```

## examples/xbc_test/Kconfig
```kconfig
#
# For a description of the syntax of this configuration file,
# see the file kconfig-language.txt in the NuttX tools repository.
#

config EXAMPLES_XBC_TEST
	tristate "XBox Controller Test example"
	default n
	---help---
		Enable the XBox Controller Test example

if EXAMPLES_XBC_TEST

config EXAMPLES_XBC_TEST_PROGNAME
	string "Program name"
	default "xbc_test"
	---help---
		This is the name of the program that will be used when the NSH ELF
		program is installed.

config EXAMPLES_XBC_DEVNAME
	string "XBox Controller Device Name"
	default "/dev/xboxa"
	---help---
		Name of XBox controller device to be used. Default: "/dev/xboxa"

config EXAMPLES_XBC_TEST_PRIORITY
	int "Xbc_test task priority"
	default 100

config EXAMPLES_XBC_TEST_STACKSIZE
	int "XBox Controller Test stack size"
	default DEFAULT_TASK_STACKSIZE

endif
```
