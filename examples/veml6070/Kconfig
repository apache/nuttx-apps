## examples/xedge/Kconfig
```kconfig
#
# Xedge IoT Toolkit - NuttX Kconfig integration
#
# Xedge is an embedded software toolkit designed to enable high-level developers
# (e.g., web and Lua programmers) to create sophisticated, secure IoT and industrial
# device applications. It abstracts low-level embedded development through a lightweight
# runtime built on top of the Barracuda App Server and Lua, giving developers direct access
# to HTTP(S), WebSockets, MQTT, file system, and device I/O - all from high-level Lua scripts.
#
# This NuttX integration allows developers to compile and run Xedge as a user application,
# bringing powerful device control capabilities and an embedded web server to NuttX-based
# systems.
#
# Use this if you want to build smart, networked embedded devices with minimal C code,
# and maximum productivity.
#

config EXAMPLES_XEDGE
	tristate "Xedge IoT Toolkit"
	depends on ALLOW_GPL_COMPONENTS
	default n
	---help---
		Enable Xedge support in NuttX. Xedge is a high-level
		toolkit that lets you develop complete IoT device
		applications using Lua, backed by the Barracuda App
		Server.	This application demonstrates a complete
		Xedge runtime integrated into NuttX.

if EXAMPLES_XEDGE

config EXAMPLES_XEDGE_PROGNAME
	string "Program name"
	default "xedge"
	---help---
		This is the name of the ELF executable for the Xedge application in NSH.

config EXAMPLES_XEDGE_PRIORITY
	int "Xedge task priority"
	default 100
	---help---
		Set the task priority for the Xedge runtime.

config EXAMPLES_XEDGE_STACKSIZE
	int "Xedge stack size"
	default 20000
	---help---
		Set the stack size allocated to the Xedge Lua interpreter and application runtime.

endif
```

## examples/xedge_demo/Kconfig
```kconfig
#
# For a description of the syntax of this configuration file,
# see the file kconfig-language.txt in the NuttX tools repository.
#

config EXAMPLES_XEDGE_DEMO
	tristate "Xedge IoT Toolkit Demo"
	depends on NETUTILS_XEDGE && ALLOW_GPL_COMPONENTS
	default n
	---help---
		Simple demonstration of the Xedge IoT Toolkit library.
		
		This example shows how to integrate and use the Xedge library
		in your NuttX application. Xedge provides a high-level development
		environment for creating IoT and industrial device applications
		using Lua scripting with access to HTTP(S), WebSockets, MQTT,
		file system, and device I/O.

		Note: This example requires the NETUTILS_XEDGE library to be enabled.

if EXAMPLES_XEDGE_DEMO

config EXAMPLES_XEDGE_DEMO_PROGNAME
	string "Program name"
	default "xedge_demo"
	---help---
		This is the name of the ELF executable for the Xedge demo application in NSH.

config EXAMPLES_XEDGE_DEMO_PRIORITY
	int "Xedge demo task priority"
	default 100
	---help---
		Set the task priority for the Xedge demo application.

config EXAMPLES_XEDGE_DEMO_STACKSIZE
	int "Xedge demo stack size"
	default 20000
	---help---
		Set the stack size for the Xedge demo application.

endif
```

## examples/zerocross/Kconfig
```kconfig
#
# For a description of the syntax of this configuration file,
# see the file kconfig-language.txt in the NuttX tools repository.
#

config EXAMPLES_ZEROCROSS
	tristate "Zero Cross Detection example"
	default n
	depends on SENSORS_ZEROCROSS && !DISABLE_SIGNALS
	---help---
		Enable the zero cross detection example

if EXAMPLES_ZEROCROSS

config EXAMPLES_ZEROCROSS_DEVNAME
	string "Zero Cross device name"
	default "/dev/zc0"

config EXAMPLES_ZEROCROSS_SIGNO
	int "Zero Cross signal"
	default 13

endif
```

## fsutils/Kconfig
```kconfig
#
# For a description of the syntax of this configuration file,
# see the file kconfig-language.txt in the NuttX tools repository.
#

menu "File System Utilities"

source "$APPSDIR/fsutils/inifile/Kconfig"
source "$APPSDIR/fsutils/mksmartfs/Kconfig"
source "$APPSDIR/fsutils/passwd/Kconfig"

endmenu # FS Utilities
```

## fsutils/flash_eraseall/Kconfig
```kconfig
#
# For a description of the syntax of this configuration file,
# see the file kconfig-language.txt in the NuttX tools repository.
#

config FSUTILS_FLASH_ERASEALL
	bool "flash_eraseall() function"
	default n
	depends on MTD
	---help---
		Enables support for the callable flash_eraseall() function that can
		be used to erase all FLASH backing up a block device driver.

if FSUTILS_FLASH_ERASEALL

endif # FSUTILS_FLASH_ERASEALL
```

## fsutils/flashtool/Kconfig
```kconfig
#
# For a description of the syntax of this configuration file,
# see the file kconfig-language.txt in the NuttX tools repository.
#

config FSUTILS_FLASHTOOL
	tristate "FLASH Tool Command"
	default n
	depends on MTD
	depends on BCH
	---help---
		Enable support for the FLASH tool.

if FSUTILS_FLASHTOOL

config FSUTILS_FLASHTOOL_STACKSIZE
	int "flashtool stack size"
	default DEFAULT_TASK_STACKSIZE
	---help---
		This is the stack size that will be used when starting the flashtool.

config FSUTILS_FLASHTOOL_PRIORITY
	int "flashtool priority"
	default 100
	---help---
		This is the task priority that will be used when starting the flashtool.

endif
```

## fsutils/inifile/Kconfig
```kconfig
#
# For a description of the syntax of this configuration file,
# see the file kconfig-language.txt in the NuttX tools repository.
#

menuconfig FSUTILS_INIFILE
	bool "INI File Parser"
	default n
	---help---
		Enable support for a simple INI file parser.

if FSUTILS_INIFILE

config FSUTILS_INIFILE_MAXLINE
	int "Max line length"
	default 256
	---help---
		The largest line that the parser can expect to see in an INI file.

config FSUTILS_INIFILE_DEBUGLEVEL
	int "Debug level"
	default 0
	range 0 2
	---help---
		0=Debug off; 1=Print errors on console; 2=Print debug information
		on the console.

endif # FSUTILS_INIFILE
```

## fsutils/inih/Kconfig
```kconfig
#
# For a description of the syntax of this configuration file,
# see the file kconfig-language.txt in the NuttX tools repository.
#

menuconfig FSUTILS_INIH
	bool "inih ini file parser"
	default n
	---help---
		inih (INI Not Invented Here) is a simple .INI file parser written in C.
		https://github.com/benhoyt/inih

		Library is licensed under the New BSD license. See LICENSE.txt file in
		the downloaded code for license details

if FSUTILS_INIH

config INIH_MULTI_LINE_ENTRIES
	bool "Enable multiline entries"
	default n
	---help---
		This makes inih to support multi-line entries in the style of Python's
		ConfigParser.

config INIH_USE_MALLOC
	bool "Enable use of malloc()"
	default n
	---help---
		If you enable this, inih will be using malloc() and realloc() to
		allocate needed memory for line-by-line file parsing.

		If you disable this, inih will be using only stack allocated memory
		for parsing file.

if INIH_USE_MALLOC

config INIH_INITIAL_ALLOC
	int "Initial allocation size"
	default 128
	---help---
		inih will allocate this amount of memory and will double it when
		line is bigger than currently allocated memory.

endif # INIH_USE_MALLOC

config INIH_MAX_LINE
	int "Maximum line size"
	default 80
	range 4 4096
	---help---
		Maximum size of a single line. It doesn't matter if you have malloc()
		enabled or not, you can't exceed this value.

endif # FSUTILS_INIH
```

## fsutils/ipcfg/Kconfig
```kconfig
#
# For a description of the syntax of this configuration file,
# see the file kconfig-language.txt in the NuttX tools repository.
#

config FSUTILS_IPCFG
	bool "IP Configuration File Support"
	default n
	depends on NET_IPv4 || NET_IPv6
	---help---
		Enables support for an IP configuration file that holds IP
		address and/or DHCP configuration information for a
		specific network device

if FSUTILS_IPCFG

config IPCFG_WRITABLE
	bool "Writable IP Configuration"
	default y
	---help---
		Can be used to disable writing to the IP Configuration file.  This
		would be necessary if, for example, the IP Configuration file were
		provided on a read-only file system.

config IPCFG_BINARY
	bool "Binary IP Configuration File"
	default n
	---help---
		By default, the IP configuration file is an ASCII human readable
		file with <varialble>=<value> pairs.  A Binary interface may be used
		for more constrained media such as EEPROM.

config IPCFG_PATH
	string "IP Configuration File Directory"
	default "/etc/sysconfig/network-scripts"
	---help---
		Specifies the full path to the directory or mountpoint that holds
		the IP Configuration files.  Each individual configuration file
		within this directory will have names like ipcfg-eth0.

		If CONFIG_IPCFG_CHARDEV is select, this setting is interpreted
		differently.  In this case, CONFIG_IPCFG_PATH is the full path
		to the character driver.

config IPCFG_CHARDEV
	bool "Character Driver"
	default n
	depends on IPCFG_BINARY
	---help---
		In some use cases, where there is only a single network device and
		only a single network device, a character driver on, perhaps, EEPROM
		may be used.  In this case there is not file system and the
		CONFIG_IPCFG_PATH will refer to that character driver.

		NOTE that this configuration is only support with CONFIG_IPCFG_BINARY.

config IPCFG_OFFSET
	int "Data offset"
	default 0
	depends on IPCFG_CHARDEV
	---help---
		Seek to this offset before reading or writing the IP Configuration.
		This is only support for the character driver device.  This permits
		some formatting of, say, EEPROM, so that multiple, different
		configurations can be maintained at different offsets into the IP
		Configuration File.

endif # FSUTILS_IPCFG
```

## fsutils/libtinycbor/Kconfig
```kconfig
#
# For a description of the syntax of this configuration file,
# see the file kconfig-language.txt in the NuttX tools repository.
#

config FSUTILS_TINYCBOR_LIB
	bool "TinyCBOR Library (RFC 8949)"
	default n
	depends on ALLOW_MIT_COMPONENTS
	---help---
		Enable support for the TinyCBOR library. This is an
		implementation of RFC-8949 (Concise Binary Object
		Representation).
		More info: https://lupyuen.github.io/articles/cbor2

if FSUTILS_TINYCBOR_LIB
endif
```
