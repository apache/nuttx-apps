## graphics/Kconfig
```kconfig
#
# For a description of the syntax of this configuration file,
# see the file kconfig-language.txt in the NuttX tools repository.
#

menu "Graphics Support"

config TIFF
	bool "TIFF file generation library"
	default n
	---help---
		Enable support for the TIFF file generation program.

if TIFF

menu "TIFF Screenshot Utility"
source "$APPSDIR/graphics/screenshot/Kconfig"
endmenu

endif # TIFF

config GRAPHICS_TRAVELER
	bool "Traveler game"
	default n
	select FSUTILS_INIFILE
	---help---
		Enable or disable the graphic Traveler game

if GRAPHICS_TRAVELER

menu "Traveler game"
source "$APPSDIR/graphics/traveler/Kconfig"
endmenu

endif # GRAPHICS_TRAVELER
endmenu # Graphics Support
```

## graphics/ft80x/Kconfig
```kconfig
#
# For a description of the syntax of this configuration file,
# see the file kconfig-language.txt in the NuttX tools repository.
#

config GRAPHICS_FT80X
	bool "FTDI/BridgeTek FT80x library"
	default n
	---help---
		Enable support for the FTDI/BridgeTek FT80x library.

if GRAPHICS_FT80X

config GRAPHICS_FT80X_BUFSIZE
	int "I/O buffer size"
	default 512
	range 32 8192
	---help---
		The size of the local display list I/O buffer.  Bigger is better!
		This size should be an even multiple of 4 bytes (otherwise, the size
		will be truncated to the next lower, aligned size).

config GRAPHICS_FT80X_CMDEMPTY_SIGNAL
	int "CMDEMPTY event signal"
	default 18
	range 1 31
	---help---
		This is the signal that will be received when the co-processor CMD
		FIFO becomes empty.

config GRAPHICS_FT80X_TAG_SIGNAL
	int "TAG event signal"
	default 19
	range 1 31
	---help---
		This is the signal that will be received when the co-processor the
		detected touch tag changes.

config GRAPHICS_FT80X_AUDIO_BUFOFFSET
	hex "RAM G audio buffer start offset"
	default 0x00000
	range 0x00000 0x3f800
	---help---
		When playing an audio file, chunks of the audio file will be stored
		in a circular buffer in graphics RAM (RAMG G, 256Kb).

		CONFIG_GRAPHICS_FT80X_AUDIO_BUFOFFSET is the starting offset in RAM G
		for that buffer and CONFIG_FT80x_AUDIO_BUFSIZE is the size of the
		buffer.

		The buffer may, of course, be used for other purposes when not
		playing an audio file.

config GRAPHICS_FT80X_AUDIO_BUFSIZE
	hex "RAM G audio buffer size"
	default 0x10000
	range 0x00800 0x38000
	---help---
		When playing an audio file, chunks of the audio file will be stored
		in a circular buffer in graphics RAM (RAMG G, 256Kb).

		CONFIG_GRAPHICS_FT80X_AUDIO_BUFOFFSET is the starting offset in RAM G
		for that buffer and CONFIG_FT80x_AUDIO_BUFSIZE is the size of the
		buffer.

		The buffer may, of course, be used for other purposes when not
		playing an audio file.

config GRAPHICS_FT80X_DEBUG_ERROR
	bool "Enable error output"
	default y

config GRAPHICS_FT80X_DEBUG_WARN
	bool "Enable warning output"
	default n
	depends on GRAPHICS_FT80X_DEBUG_ERROR

config GRAPHICS_FT80X_DEBUG_INFO
	bool "Enable informational output"
	default n
	depends on GRAPHICS_FT80X_DEBUG_WARN

endif # GRAPHICS_FT80X
```

## graphics/input/Kconfig
```kconfig
#
# For a description of the syntax of this configuration file,
# see the file kconfig-language.txt in the NuttX tools repository.
#

config GRAPHICS_INPUT_GENERATOR
	bool
	default n
	---help---
		This is a simple input generator library that can be used to
		generate input events for testing graphics applications.

menuconfig GRAPHICS_INPUT_MONKEY
	tristate "Monkey test"
	select UINPUT_TOUCH
	select UINPUT_BUTTONS
	select GRAPHICS_INPUT_GENERATOR
	select LIBC_PRINT_EXTENSION
	default n

if GRAPHICS_INPUT_MONKEY

config GRAPHICS_INPUT_MONKEY_PRIORITY
	int "Task priority"
	default 110

config GRAPHICS_INPUT_MONKEY_STACKSIZE
	int "Stack size"
	default 4096

config GRAPHICS_INPUT_MONKEY_REC_DIR_PATH
	string "Recorder directory path"
	default "/data/monkey"

endif

menuconfig GRAPHICS_INPUT_TOOL
	tristate "Enable input tool"
	default n
	select UINPUT_TOUCH
	select UINPUT_BUTTONS
	select UINPUT_MOUSE
	select GRAPHICS_INPUT_GENERATOR
	---help---
		Enable support for a command line input tool.

if GRAPHICS_INPUT_TOOL

config GRAPHICS_INPUT_TOOL_STACKSIZE
	int "input stack size"
	default DEFAULT_TASK_STACKSIZE
	---help---
		The size of stack allocated for the input task.

config GRAPHICS_INPUT_TOOL_PRIORITY
	int "input priority"
	default 110
	---help---
		The priority of the input task.

endif # GRAPHICS_INPUT_TOOL

menuconfig GRAPHICS_INPUT_GETEVENT
	tristate "Enable getevent tool"
	default n
	---help---
		The getevent is a command-line input event monitor. It
		captures and displays real-time events from mouse,
		touchscreen, and keyboard devices via the input subsystem.

		Use getevent to debug and verify input drivers, inspect
		raw event data during device bring-up, or diagnose
		input issues on a running system. It supports automatic
		device detection in /dev as well as manual device path
		specification.

if GRAPHICS_INPUT_GETEVENT

config GRAPHICS_INPUT_GETEVENT_STACKSIZE
	int "getevent stack size"
	default DEFAULT_TASK_STACKSIZE
	---help---
		The size of stack allocated for the getevent task.

config GRAPHICS_INPUT_GETEVENT_PRIORITY
	int "getevent priority"
	default 100
	---help---
		The priority of the getevent task.

config GRAPHICS_INPUT_GETEVENT_DETAIL_INFO
	bool "getevent detail info"
	default n
	---help---
		Enable detailed information in getevent output.

endif # GRAPHICS_INPUT_GETEVENT
```

## graphics/jpgresizetool/Kconfig
```kconfig
#
# For a description of the syntax of this configuration file,
# see the file kconfig-language.txt in the NuttX tools repository.
#

config GRAPHICS_JPGRESIZETOOL
	bool "JPGResizeTool"
	default n
	depends on libjpeg
	---help---
  	Libjpeg JPEG resizer
```

## graphics/libjpeg/Kconfig
```kconfig
#
# For a description of the syntax of this configuration file,
# see the file kconfig-language.txt in the NuttX tools repository.
#

config LIBJPEG
	bool "libjpeg"
	default n
	---help---
		Enable libjpeg.
		This package contains C software to implement JPEG image encoding, decoding,
		and transcoding.  JPEG is a standardized compression method for full-color
		and grayscale images.
		The distributed programs provide conversion between JPEG JFIF format and
		image files in PBMPLUS PPM/PGM, GIF, BMP, and Targa file formats.  The
		core compression and decompression library can easily be reused in other
		programs, such as image viewers.  The package is highly portable C code;
		we have tested it on many machines ranging from PCs to Crays.
		libjpeg is provided from http://www.ijg.org/

if LIBJPEG

config LIBJPEG_VER
	string "libjpeg version"
	default "9c"

config LIBJPEG_TEMP_DIR
	string "Temporary directory"
	default "/mnt/spif/"
	---help---
		This is the directory path including the trailing slash '/'
		to store the temporary files created by libjpeg.

endif # LIBJPEG
```

## graphics/libyuv/Kconfig
```kconfig
#
# For a description of the syntax of this configuration file,
# see the file kconfig-language.txt in the NuttX tools repository.
#

config LIBYUV
	bool "libyuv"
	default n
	---help---
		Enable libyuv.

if LIBYUV

config LIBYUV_BRANCH
	string "libyuv branch (main/stable)"
	default "stable"

endif # LIBYUV
```
