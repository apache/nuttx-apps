## fsutils/mkfatfs/Kconfig
```kconfig
#
# For a description of the syntax of this configuration file,
# see the file kconfig-language.txt in the NuttX tools repository.
#

config FSUTILS_MKFATFS
	bool "mkfatfs utility"
	default y
	depends on FS_FAT && !DISABLE_PSEUDOFS_OPERATIONS
	select BCH
	---help---
		Enables support for the mkfatfs utility

config MKFATFS_BUFFER_ALIGNMENT
	int "Buffer alignment"
	default 0
	depends on FSUTILS_MKFATFS
	---help---
		Enables alignment of the buffers used by the mkfatfs application
		to N bytes. This may be needed for systems with cache or buffer
		alignment constraints.
```

## fsutils/mkgpt/Kconfig
```kconfig
#
# For a description of the syntax of this configuration file,
# see the file kconfig-language.txt in the NuttX tools repository.
#

config FSUTILS_MKGPT
	bool "mkgpt utility"
	default n
	select BCH
	select DEV_URANDOM
	---help---
		Enables support for the mkgpt utility
```

## fsutils/mkmbr/Kconfig
```kconfig
#
# For a description of the syntax of this configuration file,
# see the file kconfig-language.txt in the NuttX tools repository.
#

config FSUTILS_MKMBR
	bool "mkmbr utility"
	default n
	select BCH
	---help---
		Enables support for the mkmbr utility
```

## fsutils/mksmartfs/Kconfig
```kconfig
#
# For a description of the syntax of this configuration file,
# see the file kconfig-language.txt in the NuttX tools repository.
#

config FSUTILS_MKSMARTFS
	bool "mksmartfs utility"
	default y
	depends on FS_SMARTFS && !DISABLE_PSEUDOFS_OPERATIONS
	---help---
		Enables support for the mksmartfs utility
```

## fsutils/passwd/Kconfig
```kconfig
#
# For a description of the syntax of this configuration file,
# see the file kconfig-language.txt in the NuttX tools repository.
#

config FSUTILS_PASSWD
	bool "Password file support"
	default n
	depends on CRYPTO_CRYPTODEV
	depends on NETUTILS_CODECS
	depends on CODECS_BASE64
	---help---
		Enables support for /etc/passwd file access routines.

		Requires CONFIG_CRYPTO=y, CRYPTO_CRYPTODEV (and
		ALLOW_BSD_COMPONENTS), plus NETUTILS_CODECS/CODECS_BASE64 for
		base64url hash encoding.

		NOTE: Password hashes use PBKDF2-HMAC-SHA256 (modular crypt format).
		Existing TEA-encrypted /etc/passwd entries are NOT compatible and
		must be regenerated.

if FSUTILS_PASSWD

config FSUTILS_PASSWD_PATH
	string "Path to the passwd file"
	default "/etc/passwd"

config FSUTILS_PASSWD_READONLY
	bool "Read-only /etc/passwd file?"
	default n

config FSUTILS_PASSWD_IOBUFFER_SIZE
	int "Allocated I/O buffer size"
	default 512

config FSUTILS_PASSWD_PBKDF2_ITERATIONS
	int "Default PBKDF2 iteration count for new passwords"
	default 10000
	range 1000 200000
	---help---
		Number of PBKDF2-HMAC-SHA256 iterations applied when setting a new
		password.  Higher values slow brute-force attacks but also increase
		login latency on low-MHz MCUs.  The iteration count is stored in each
		hash string, so changing this option only affects newly-set passwords.

endif # FSUTILS_PASSWD
```

## fsutils/romloader/Kconfig
```kconfig
#
# For a description of the syntax of this configuration file,
# see the file kconfig-language.txt in the NuttX tools repository.
#

config FSUTILS_ROMLOADER
	bool "Enable ROM image creator and loader (ROMLoader)"
	default n
	depends on (FS_ROMFS && BOARDCTL_ROMDISK) || FS_CROMFS
	depends on !DISABLE_MOUNTPOINT
	---help---
		Mount a ROM file system containing the files inside the loader
		directory (apps/fsutils/romloader/rom). This is a convenience
		feature that allows the user and/or application files to be built into
		a ROM file system without code duplication.

if FSUTILS_ROMLOADER

choice
	prompt "ROM file system type"
	default FSUTILS_ROMLOADER_ROMFS  if   FS_ROMFS && BOARDCTL_ROMDISK
	default FSUTILS_ROMLOADER_CROMFS if  !FS_ROMFS && FS_CROMFS

config FSUTILS_ROMLOADER_ROMFS
	bool "ROMFS"
	depends on FS_ROMFS && BOARDCTL_ROMDISK
	---help---
		Automatically generates and mounts an internal ROMFS file
		system

config FSUTILS_ROMLOADER_CROMFS
	bool "CROMFS"
	depends on FS_CROMFS
	---help---
		Automatically generates and mounts an internal CROMFS file
		system

endchoice # ROM file system type

config FSUTILS_ROMLOADER_MOUNTPOINT
	string "ROMFS mount point"
	default "/mnt/romloader"
	---help---
		The path where the ROM file system will be mounted.

if FSUTILS_ROMLOADER_ROMFS

config FSUTILS_ROMLOADER_SECTORSIZE
	int "ROMFS sector size"
	default 512
	---help---
		The sector size of the ROMFS file system.

config FSUTILS_ROMLOADER_DEVMINOR
	int "ROMFS minor device number"
	default 0
	---help---
		The minor device number of the ROMFS block. For example, the N in
		/dev/ramN. Used for registering the RAM block driver that will hold
		the ROMFS file system containing the storage files.

config FSUTILS_ROMLOADER_DEVPATH
	string "ROMFS device path"
	default "/dev/ram0"
	---help---
		The path to the ROMFS block driver device. This must match
		FSUTILS_ROMLOADER_DEVMINOR. Used for registering the RAM block driver
		that will hold the ROMFS file system containing the storage files.

endif # FSUTILS_ROMLOADER_ROMFS
endif # FSUTILS_ROMLOADER
```

## games/brickmatch/Kconfig
```kconfig
#
# For a description of the syntax of this configuration file,
# see the file kconfig-language.txt in the NuttX tools repository.
#

config GAMES_BRICKMATCH
	bool "Brickmatch Game"
	default n
	---help---
		Enable Brickmatch games. Brickmatch is like a mix
		between Tetris and Crush Candy. The inspiration came
		from a Shift game that was available for Android in the
		F-Droid store. The original game source code still here:
		https://github.com/boombuler/Shift/ but the game only works
		for old Android versions (4.x).
		NOTE: The source code here is not based on that code from
		above github.

if GAMES_BRICKMATCH

config GAMES_BRICKMATCH_PROGNAME
	string "Program name"
	default "brick"
	---help---
		This is the name of the program that will be used when the NSH ELF
		program is installed.

config GAMES_BRICKMATCH_PRIORITY
	int "Brickmatch Game task priority"
	default 100

config GAMES_BRICKMATCH_STACKSIZE
	int "Brickmatch Game stack size"
	default DEFAULT_TASK_STACKSIZE

#
# Output Device Selection
#

choice
	prompt "Output Device (LED Matrix, LCD Screen, etc)"
	default GAMES_BRICKMATCH_USE_LCD_SCREEN

config GAMES_BRICKMATCH_USE_LCD_SCREEN
	bool "LCD Screen as Output (Also APA102 Matrix as LCD Interface)"

config GAMES_BRICKMATCH_USE_LED_MATRIX
	bool "LED Matrix as Output"
endchoice

if GAMES_BRICKMATCH_USE_LED_MATRIX

config GAMES_BRICKMATCH_LED_MATRIX_PATH
	string "LED matrix path"
	default "/dev/leds0"
	---help---
		Path of the led matrix

config GAMES_BRICKMATCH_LED_MATRIX_ROWS
	int "LED Matrix row count"
	default 8

config GAMES_BRICKMATCH_LED_MATRIX_COLS
	int "LED Matrix column count"
	default 8

endif #GAMES_BRICKMATCH_LED_MATRIX_PATH

#
# Input Device Selection
#

choice
	prompt "Input Device (Joystick, Gesture Sensor, etc)"
	default GAMES_BRICKMATCH_USE_CONSOLEKEY

config GAMES_BRICKMATCH_USE_CONSOLEKEY
	bool "Serial Console as Input"
	depends on !INPUT_DJOYSTICK && !SENSORS_APDS9960

config GAMES_BRICKMATCH_USE_DJOYSTICK
	bool "Discrete Joystick as Input"
	depends on INPUT_DJOYSTICK

config GAMES_BRICKMATCH_USE_GESTURE
	bool "Gesture Sensor APDS-9960 as Input"
	depends on SENSORS_APDS9960

config GAMES_BRICKMATCH_USE_GPIO
	bool "GPIO pins as Input"
endchoice

if GAMES_BRICKMATCH_USE_GPIO

config GAMES_BRICKMATCH_UP_KEY_PATH
	string "Up key path"
	default "/dev/gpio0"
	---help---
		Path of the up key to read

config GAMES_BRICKMATCH_DOWN_KEY_PATH
	string "Down key path"
	default "/dev/gpio1"
	---help---
		Path of the down key to read

config GAMES_BRICKMATCH_LEFT_KEY_PATH
	string "Left key path"
	default "/dev/gpio2"
	---help---
		Path of the left key to read

config GAMES_BRICKMATCH_RIGHT_KEY_PATH
	string "Right key path"
	default "/dev/gpio3"
	---help---
		Path of the right key to read

endif #GAMES_BRICKMATCH_USE_GPIO

endif
```

## games/cgol/Kconfig
```kconfig
#
# For a description of the syntax of this configuration file,
# see the file kconfig-language.txt in the NuttX tools repository.
#

config GAMES_CGOL
	bool "Conway's Game of Life"
	depends on VIDEO_FB
	default n
	---help---
		Enable Conway's Game of Life.

if GAMES_CGOL

config GAMES_CGOL_PROGNAME
	string "Program name"
	default "cgol"
	---help---
		This is the name of the program that will be used when the NSH ELF
		program is installed.

config GAMES_CGOL_PRIORITY
	int "CGOL task priority"
	default 100

config GAMES_CGOL_STACKSIZE
	int "CGOL stack size"
	default DEFAULT_TASK_STACKSIZE

config GAMES_CGOL_FBDEV
	string "CGOL frame buffer device path"
	default "/dev/fb0"
	---help---
		The frame buffer device path that will be used by default for rendering.
		Device path can still be selected from first command line argument.

config GAMES_CGOL_DBLBUF
	bool "CGOL double buffered"
	default n
	---help---
		If enabled, CGOL will allocate enough RAM for a 'second frame buffer'.
		Rendering will be done to this buffer and copied to the real frame
		buffer once complete. This is necessary for some devices, but requires
		a lot more memory.

config GAMES_CGOL_MAPWIDTH
	int "Map width"
	range 1 500000
	default 256
	---help---
		This is the width of the game map. It must be greater than or equal to
		the width of the frame buffer. It must also be a multiple of the target
		device's `sizeof(unsigned int) * 8`.

config GAMES_CGOL_MAPHEIGHT
	int "Map height"
	range 1 500000
	default 256
	---help---
		This is the height of the game map. It must be greater than or equal to
		the height of the frame buffer.

config GAMES_CGOL_FRAMEDELAY
	int "Microseconds between frames"
	range 0 10000000
	default 0
	---help---
		This adds a delay between frames in microseconds. If the render is too
		fast for you to "enjoy", then you can slow it down with this.

config GAMES_CGOL_DENSITY
	int "Cell density"
	range 1 10000
	default 6
	---help---
		The initial cell density to populate the map with. The map will be
		randomly initialized with `TOTAL_CELLS * (1 / density)` cells, not
		accounting for overlap.

endif
```

## games/match4/Kconfig
```kconfig
#
# For a description of the syntax of this configuration file,
# see the file kconfig-language.txt in the NuttX tools repository.
#

config GAMES_MATCH4
	bool "Match 4 Game"
	default n
	---help---
		Enable Match 4 game.

if GAMES_MATCH4

config GAMES_MATCH4_PROGNAME
	string "Program name"
	default "match"
	---help---
		This is the name of the program that will be used when the NSH ELF
		program is installed.

config GAMES_MATCH4_PRIORITY
	int "Match 4 Game task priority"
	default 100

config GAMES_MATCH4_STACKSIZE
	int "Match 4 Game stack size"
	default DEFAULT_TASK_STACKSIZE

config MATCH4_GAME_DEBUG
	bool "Print board status to the serial console for debugging"
	default n

config GAMES_MATCH4_LED_MATRIX_PATH
	string "LED matrix path"
	default "/dev/leds0"
	---help---
		Path of the led matrix

config GAMES_MATCH4_LED_MATRIX_ROWS
	int "LED Matrix row count"
	default 8

config GAMES_MATCH4_LED_MATRIX_COLS
	int "LED Matrix column count"
	default 8

#
# Input Device Selection
#

choice
	prompt "Input Device (Serial Console, GPIO, etc)"
	default GAMES_MATCH4_USE_CONSOLEKEY

config GAMES_MATCH4_USE_CONSOLEKEY
	bool "Serial Console as Input"

config GAMES_MATCH4_USE_GPIO
	bool "GPIO pins as Input"
endchoice

if GAMES_MATCH4_USE_GPIO

config GAMES_MATCH4_DOWN_KEY_PATH
	string "Down key path"
	default "/dev/gpio1"
	---help---
		Path of the down key to read

config GAMES_MATCH4_LEFT_KEY_PATH
	string "Left key path"
	default "/dev/gpio2"
	---help---
		Path of the left key to read

config GAMES_MATCH4_RIGHT_KEY_PATH
	string "Right key path"
	default "/dev/gpio3"
	---help---
		Path of the right key to read

endif #GAMES_MATCH4_USE_GPIO

endif
```

## games/shift/Kconfig
```kconfig
#
# For a description of the syntax of this configuration file,
# see the file kconfig-language.txt in the NuttX tools repository.
#

config GAMES_SHIFT
	bool "Shift Game"
	default n
	---help---
		Enable Shift games. Shift is a brick game, like a mix
		between Tetris and Crush Candy. The inspiration came
		from a Shift game that was available for Android in the
		F-Droid store. The original game source code still here:
		https://github.com/boombuler/Shift/ but the game only works
		for old Android versions (4.x).
		NOTE: The source code here is not based on that code from
		above github.

if GAMES_SHIFT

config GAMES_SHIFT_PROGNAME
	string "Program name"
	default "shift"
	---help---
		This is the name of the program that will be used when the NSH ELF
		program is installed.

config GAMES_SHIFT_PRIORITY
	int "Shift Game task priority"
	default 100

config GAMES_SHIFT_STACKSIZE
	int "Shift Game stack size"
	default DEFAULT_TASK_STACKSIZE

#
# Input Device Selection
#

choice
        prompt "Input Device (Joystick, Gesture Sensor, etc)"
	default GAMES_SHIFT_USE_CONSOLEKEY

config GAMES_SHIFT_USE_CONSOLEKEY
	bool "Serial Console as Input"
	depends on !INPUT_DJOYSTICK && !SENSORS_APDS9960

config GAMES_SHIFT_USE_DJOYSTICK
	bool "Discrete Joystick as Input"
	depends on INPUT_DJOYSTICK

config GAMES_SHIFT_USE_GESTURE
	bool "Gesture Sensor APDS-9960 as Input"
	depends on SENSORS_APDS9960

endchoice

endif
```

## games/snake/Kconfig
```kconfig
#
# For a description of the syntax of this configuration file,
# see the file kconfig-language.txt in the NuttX tools repository.
#

config GAMES_SNAKE
	bool "Snake Game"
	default n
	---help---
		Enable Snake game.

if GAMES_SNAKE

config GAMES_SNAKE_PROGNAME
	string "Program name"
	default "snake"
	---help---
		This is the name of the program that will be used when the NSH ELF
		program is installed.

config GAMES_SNAKE_PRIORITY
	int "Snake Game task priority"
	default 100

config GAMES_SNAKE_STACKSIZE
	int "Snake Game stack size"
	default DEFAULT_TASK_STACKSIZE

config DEBUG_SNAKE_GAME
	bool "Print board status to the serial console for debugging"
	default n

config GAMES_SNAKE_LED_MATRIX_PATH
	string "LED matrix path"
	default "/dev/leds0"
	---help---
		Path of the led matrix

config GAMES_SNAKE_LED_MATRIX_ROWS
	int "LED Matrix row count"
	default 8

config GAMES_SNAKE_LED_MATRIX_COLS
	int "LED Matrix column count"
	default 8

#
# Input Device Selection
#

choice INPUT_METHOD
	prompt "Input Device (Serial Console, GPIO, etc)"
	default GAMES_SNAKE_USE_CONSOLEKEY

config GAMES_SNAKE_USE_CONSOLEKEY
	bool "Serial Console as Input"

config GAMES_SNAKE_USE_GPIO
	bool "GPIO pins as Input"
endchoice

if GAMES_SNAKE_USE_GPIO

config GAMES_SNAKE_UP_KEY_PATH
	string "Up key path"
	default "/dev/gpio0"
	---help---
		Path of the up key to read

config GAMES_SNAKE_DOWN_KEY_PATH
	string "Down key path"
	default "/dev/gpio1"
	---help---
		Path of the down key to read

config GAMES_SNAKE_LEFT_KEY_PATH
	string "Left key path"
	default "/dev/gpio2"
	---help---
		Path of the left key to read

config GAMES_SNAKE_RIGHT_KEY_PATH
	string "Right key path"
	default "/dev/gpio3"
	---help---
		Path of the right key to read

endif #GAMES_SNAKE_USE_GPIO

endif
```

## gpsutils/Kconfig
```kconfig
#
# For a description of the syntax of this configuration file,
# see the file kconfig-language.txt in the NuttX tools repository.
#

menu "GPS Utilities"

source "$APPSDIR/gpsutils/minmea/Kconfig"

endmenu # GPS Utilities
```
