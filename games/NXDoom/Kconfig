## system/fbvnc/Kconfig
```kconfig
#
# For a description of the syntax of this configuration file,
# see the file kconfig-language.txt in the NuttX tools repository.
#

config SYSTEM_FBVNC
	tristate "VNC framebuffer mirror daemon"
	default n
	depends on NETUTILS_FBVNC && VIDEO_FB
	select FB_UPDATE
	---help---
		Serves any framebuffer device over VNC with no application
		cooperation:  what changed comes from the kernel's dirty-area
		reporting, and remote input enters through the uinput devices.

		Selects FB_UPDATE, which is what carries an application's
		report of what it changed into the kernel.  Without it the
		daemon still works, sending a whole frame per request.

if SYSTEM_FBVNC

config SYSTEM_FBVNC_PROGNAME
	string "Program name"
	default "fbvnc"

config SYSTEM_FBVNC_PRIORITY
	int "Task priority"
	default 100

config SYSTEM_FBVNC_STACKSIZE
	int "Stack size"
	default 8192
	---help---
		The daemon task is the VNC server:  it runs the protocol loop
		itself rather than waiting for a thread to do it.  Its stack
		therefore has to be the server's, not a supervisor's.

endif
```
