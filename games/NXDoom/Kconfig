## netutils/ptpd/Kconfig
```kconfig
#
# For a description of the syntax of this configuration file,
# see the file kconfig-language.txt in the NuttX tools repository.
#

config NETUTILS_PTPD
	bool "PTPD client/server"
	default n
	depends on NET_IPv4
	depends on NET_IGMP
	depends on NET_UDP || NET_PKT
	---help---
		Build a minimal implementation of IEEE-1588 precision time protocol.
		Uses system gettimeofday() and adjtime() calls to synchronize clock
		with a master clock through network, or to provide a master clock to
		other systems.

if NETUTILS_PTPD

config NETUTILS_PTPD_STACKSIZE
	int "PTP daemon stack stack size"
	default DEFAULT_TASK_STACKSIZE

config NETUTILS_PTPD_SERVERPRIO
	int "PTP daemon priority"
	default 100

config NETUTILS_PTPD_DOMAIN
	int	"PTP domain selection"
	default 0
	range 0 127
	---help---
		Set PTP domain to participate in. Default domain is 0, other domains
		can be used to isolate reference clocks from each other.

config NETUTILS_PTPD_PRIORITY1
	int "PTP server priority1"
	default 128
	range 0 255
	---help---
		Set clock priority to announce when acting as a PTP server.
		Lower value is higher priority.

		A higher priority1 clock will be selected without regard to announced
		clock quality fields.
		Refer to Best Master Clock algorithm in IEEE-1588 for details.

config NETUTILS_PTPD_PRIORITY2
	int "PTP server priority2"
	default 128
	range 0 255
	---help---
		Set clock subpriority to announce when acting as a PTP server.
		This will distinguish between two clocks that are equivalent in
		priority1, class and accuracy values.
		Lower value is higher priority.

config NETUTILS_PTPD_CLASS
	int "PTP server class"
	default 248
	range 0 255
	---help---
		Set master clock class to announce when acting as a PTP server.
		Lower value means higher quality clock source.
		248 is the default for unknown class.

config NETUTILS_PTPD_ACCURACY
	int "PTP server accuracy"
	default 254
	range 0 255
	---help---
		Set master clock accuracy to announce when acting as a PTP server.
		Logarithmic scale is defined in IEEE-1588:
		32: +-  25 ns
		33: +- 100 ns
		34: +- 250 ns
		35: +-   1 us
		36: +-   2.5 us
		37: +-  10 us
		38: +-  25 us
		39: +- 100 us
		40: +- 250 us
		41: +-   1 ms
		42: +-   2.5 ms
		43: +-  10 ms
		44: +-  25 ms
		45: +- 100 ms
		46: +- 250 ms
		47: +-   1 s
		48: +-  10 s
		49: +-  more than 10 s
		254: Unknown

config NETUTILS_PTPD_CLOCKSOURCE
	int "PTP server clock source type"
	default 160
	range 0 255
	---help---
		Set clock source type to announce when acting as a PTP server.
		Common values:
		 32: GPS
		 64: PTP
		 80: NTP
		144: Other
		160: Internal oscillator

config NETUTILS_PTPD_SYNC_INTERVAL_MSEC
	int "PTP server sync transmit interval (ms)"
	default 1000
	---help---
		How often to transmit sync packets in server mode.

config NETUTILS_PTPD_ANNOUNCE_INTERVAL_MSEC
	int "PTP server announce transmit interval (ms)"
	default 10000
	---help---
		How often to transmit announce packets in server mode.

config NETUTILS_PTPD_TWOSTEP_SYNC
	bool "PTP server sends two-step synchronization packets"
	default y
	---help---
		If enabled, sends a follow-up packet after every sync packet.
		This helps compensate for the time taken to initiate the transmission.

config NETUTILS_PTPD_DELAYRESP_INTERVAL
	int "PTP server suggested interval of delay requests"
	range 0 255
	default 4
	---help---
		When responding to a delay request, the server can inform the client
		how often it should test path delay. This is done using header field
		logMessageInterval. The delay will be 2^N seconds.

		Default value 4 results in 16 second interval.

config NETUTILS_PTPD_TIMEOUT_MS
	int "PTP client timeout for changing clock source (ms)"
	default 60000
	---help---
		If no packets are being received from currently chosen clock source,
		fall back to next best clock source after this many seconds.

config NETUTILS_PTPD_SETTIME_THRESHOLD_MS
	int "PTP client threshold for changing system time (ms)"
	default 1000
	---help---
		If difference between local and remote clock exceeds this threshold,
		time is reset with settimeofday() instead of changing the rate with
		adjtime().

config NETUTILS_PTPD_ADJTIME_THRESHOLD_NS
	int "PTP client threshold for using accumulated ppb to adjust system time (ns)"
	default 500
	---help---
		If difference between local and remote clock exceeds this threshold,
		the PTP client can utilize current ppb instead of accumulated ppb to
		accelerate system time adjustment.

config NETUTILS_PTPD_MULTICAST_TIMEOUT_MS
	int "PTP client timeout to rejoin multicast group (ms)"
	default 30000
	---help---
		If no PTP multicast packets are being received, attempt to rejoin the
		multicast group. This can be necessary if network topology changes, or
		depending on hardware, after some error recovery events.
		Set to 0 to disable.

config NETUTILS_PTPD_DRIFT_AVERAGE_S
	int "PTP client clock drift rate averaging time (s)"
	default 600
	range 10 86400
	---help---
		Clock drift rate is averaged over this time pediod. Larger value
		gives more stable estimate but reacts slower to crystal oscillator speed
		changes (such as caused by temperature changes).

config NETUTILS_PTPD_MAX_DRIFT_PPB
	int "PTP client maximum plausible clock drift rate (ppb)"
	default 500000
	range 1000 20000000
	---help---
		A single drift-rate sample computed between two consecutive sync
		updates is discarded (the previous averaged drift_ppb is kept
		unchanged) if its magnitude exceeds this bound. Real crystal
		oscillators drift by at most a few hundred ppm (hundreds of
		thousands of ppb), so this catches bogus samples caused by an
		abnormally short or long measurement interval - e.g. right after
		a clock source outage/reconnect, or a burst of closely spaced
		sync packets following packet loss - before they corrupt the
		long-term drift_ppb average and get applied to the hardware.

		This is intentionally much tighter than
		CLOCK_ADJTIME_SLEWLIMIT_PPM, which bounds how fast a correction
		may be applied rather than how large a real drift measurement
		can plausibly be.

config NETUTILS_PTPD_MAX_PATH_DELAY_NS
	int "PTP client maximum path delay (ns)"
	default 100000
	range 1 1000000000
	---help---
		Measured path delay longer than this is ignored. Delay requests are
		also not transmitted until clock synchronization is better than this.

config NETUTILS_PTPD_DELAYREQ_AVGCOUNT
	int "PTP client path delay averaging count"
	default 100
	---help---
		Measured path delay is averaged over this many samples.

config NETUTILS_PTPD_OUTLIER_THRESHOLD_NS
	int "PTP outlier rejection threshold (ns)"
	default 0
	range 0 1000000000
	---help---
		A phase error measurement that differs from the median of the
		latest accepted ones by more than this many nanoseconds is
		discarded instead of being used to correct the clock. It protects
		the frequency estimate and the phase correction from a single
		disturbed sample, for example a receive timestamp taken late by
		the scheduler with software timestamping.

		A change that lasts is accepted after several discarded samples in
		a row, so the daemon still follows a real step of the master, and
		a short burst of disturbed samples is still ridden out.

		Choose a value well above the normal spread of the measurement:
		a few microseconds are typical with hardware timestamping and
		hundreds with software timestamping. 0 disables the rejection.

config NETUTILS_PTPD_STATUSFILE
	string "PTP daemon status file path"
	default "/tmp/ptpd.status"
	---help---
		Path where the PTP daemon writes its binary status file
		when signaled with SIGUSR1. The ptpd_status() API reads
		this file to retrieve daemon state without requiring shared
		memory, making it work across all build modes (Flat,
		Protected, Kernel). Written atomically via temp + rename.

config NETUTILS_PTPD_INGRESS_LATENCY_NS
	int "PTP hardware receive timestamp latency (ns)"
	default 0
	range -1000000 1000000
	---help---
		Fixed delay, in nanoseconds, between a frame reaching the wire
		reference plane and the moment the MAC latches its hardware
		receive timestamp. This is the ingressLatency port parameter of
		IEEE 1588: the PHY and the MAC clock-domain crossing make the
		timestamp point lag the true arrival of the frame.

		The latency is subtracted from every hardware receive timestamp,
		so a positive value moves the timestamps earlier. It has no
		effect with software timestamping. It can be overridden at
		run time with the -I option.

		The value depends on the PHY and board and has to be measured,
		for example by comparing a physical PPS output against a
		reference. The default of 0 applies no compensation.

config NETUTILS_PTPD_EGRESS_LATENCY_NS
	int "PTP hardware transmit timestamp latency (ns)"
	default 0
	range -1000000 1000000
	depends on NET_TIMESTAMP
	---help---
		Fixed delay, in nanoseconds, between the MAC latching a hardware
		transmit timestamp and the frame reaching the wire reference
		plane. This is the egressLatency port parameter of IEEE 1588: the
		clock domain crossing and the PHY make the frame leave later than
		the timestamp point.

		The latency is added to every hardware transmit timestamp, so a
		positive value moves the timestamps later. It has no effect with
		software timestamping or when the driver does not provide
		hardware transmit timestamps. It can be overridden at run time
		with the -O option.

		The value depends on the PHY and board and has to be measured.
		The default of 0 applies no compensation.

endif # NETUTILS_PTPD
```

## netutils/wifibridge/Kconfig
```kconfig
#
# For a description of the syntax of this configuration file,
# see the file kconfig-language.txt in the NuttX tools repository.
#

config NETUTILS_WIFIBRIDGE
	bool "Wi-Fi SoftAP to Ethernet bridge"
	default n
	depends on NET_IPv4 && NET_BRIDGE && WIRELESS_WAPI
	select NETUTILS_NETLIB
	---help---
		Library that turns a Wi-Fi interface into a SoftAP and bridges it
		to an Ethernet interface at layer 2, so that Ethernet devices
		reach the wireless network without any routing.  The bridge
		interface carries the IP address and, optionally, a DHCP server.

		The wireless driver must support the master (SoftAP) mode and the
		Ethernet driver must accept frames for any destination address
		(NET_PROMISCUOUS).

if NETUTILS_WIFIBRIDGE

config NETUTILS_WIFIBRIDGE_DHCPD
	bool "Run the DHCP server on the bridge"
	default n
	depends on NETUTILS_DHCPD
	---help---
		Allow the library to start the DHCP server on the bridge
		interface.  Leave it unused when another DHCP server is
		reachable through the Ethernet port.

config NETUTILS_WIFIBRIDGE_PERSIST
	bool "Keep the configuration in non-volatile memory"
	default n
	---help---
		Allow the library to save the SoftAP configuration (SSID,
		passphrase, channel, security, address and DHCP server option) in
		a file or in a block device, and to load it again.  The record has
		a CRC and is the only thing in the first bytes of the storage.
		The passphrase is stored as is.

if NETUTILS_WIFIBRIDGE_PERSIST

config NETUTILS_WIFIBRIDGE_STORAGE
	string "File or device that keeps the configuration"
	default "/data/wifibridge.conf"
	---help---
		A file of a file system that is mounted at boot, or a block device
		such as the MTD of a part of the flash (it needs BCH to be opened
		by name).  Writing it also erases the flash that holds it, so it
		should be a device used for this alone.

endif # NETUTILS_WIFIBRIDGE_PERSIST

endif # NETUTILS_WIFIBRIDGE
```

## system/expat/Kconfig
```kconfig
#
# For a description of the syntax of this configuration file,
# see the file kconfig-language.txt in the NuttX tools repository.
#

config LIB_EXPAT
	tristate "Expat XML parser"
	default n
	depends on ALLOW_MIT_COMPONENTS
	---help---
		Enable the Expat stream-oriented XML parser.  The selected version is
		downloaded when the applications tree is configured.

if LIB_EXPAT

config LIB_EXPAT_VERSION
	string "Expat version"
	default "2.8.2"

config LIB_EXPAT_CONTEXT_BYTES
	int "Input context bytes"
	default 1024
	range 0 65536
	---help---
		Number of input bytes retained around the current parse point.  Set
		this to zero to disable XML_GetInputContext().

config LIB_EXPAT_GENERAL_ENTITIES
	bool "General entity support"
	default n
	---help---
		Enable expansion of general entities.  Keep this disabled when XML
		inputs are not fully trusted.

config LIB_EXPAT_DTD
	bool "DTD support"
	default n
	select LIB_EXPAT_GENERAL_ENTITIES
	---help---
		Enable DTD and parameter entity parsing support.  This also enables
		general entities.

endif # LIB_EXPAT
```

## system/fastboot/Kconfig
```kconfig
#
# For a description of the syntax of this configuration file,
# see the file kconfig-language.txt in the NuttX tools repository.
#

menuconfig SYSTEM_FASTBOOTD
	bool "fastbootd"
	default n
	depends on USBFASTBOOT || (NET_TCP && NET_TCPBACKLOG) || SERIAL
	---help---
		Fastboot daemon supporting multiple transports concurrently.
		Enable at least one transport (USB, TCP, Serial).
		The USB transport depends on USBFASTBOOT.
		The TCP network transport depends on NET_TCP and NET_TCPBACKLOG.
		The Serial transport depends on SERIAL.
		Each transport can be individually disabled via
		SYSTEM_FASTBOOTD_USB / SYSTEM_FASTBOOTD_TCP below.

if SYSTEM_FASTBOOTD

config SYSTEM_FASTBOOTD_PRIORITY
	int "fastboot task priority"
	default 100

config SYSTEM_FASTBOOTD_STACKSIZE
	int "fastboot stack size"
	default DEFAULT_TASK_STACKSIZE

config SYSTEM_FASTBOOTD_DOWNLOAD_MAX
	int "fastboot download buffer size"
	default 40960

config SYSTEM_FASTBOOTD_USB
	bool "Fastboot USB transport"
	default y
	depends on USBFASTBOOT
	---help---
		Enable USB transport for fastboot daemon.

config SYSTEM_FASTBOOTD_USB_BOARDCTL
	bool "USB Board Control"
	default n
	depends on BOARDCTL
	depends on BOARDCTL_USBDEVCTRL
	depends on SYSTEM_FASTBOOTD_USB
	---help---
		Connect usbdev before running fastboot daemon.

config SYSTEM_FASTBOOTD_TCP
	bool "Fastboot TCP transport"
	default y
	depends on NET_TCP
	depends on NET_TCPBACKLOG
	---help---
		Enable TCP network transport for fastboot daemon.

config SYSTEM_FASTBOOTD_SHELL
	bool "Execute custom commands"
	default n
	depends on SCHED_CHILD_STATUS
	depends on SYSTEM_POPEN
	---help---
		Enable to support executing custom commands.
		e.g. fastboot oem shell ps
		e.g. fastboot oem shell "mkrd -m 10 -s 512 640"

config SYSTEM_FASTBOOTD_NET_INIT
	bool "Network initialization"
	default n
	depends on SYSTEM_FASTBOOTD_TCP
	select NETUTILS_NETINIT
	---help---
		This option enables/disables all network initialization in fastboot server.

config SYSTEM_FASTBOOTD_SERIAL
	bool "Fastboot serial transport"
	default n
	depends on SERIAL
	---help---
		Enable serial (UART) transport for fastboot daemon.
		Reuses TCP v1 wire framing (FB01 handshake + 8-byte length prefix).
		The host side can use socat to bridge the UART to a TCP socket.

config SYSTEM_FASTBOOTD_SERIAL_PORT
	string "Serial device path"
	default "/dev/ttyS1"
	depends on SYSTEM_FASTBOOTD_SERIAL

endif # SYSTEM_FASTBOOTD
```
