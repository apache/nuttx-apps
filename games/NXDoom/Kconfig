## graphics/tinygl/Kconfig
```kconfig
#
# For a description of the syntax of this configuration file,
# see the file kconfig-language.txt in the NuttX tools repository.
#

menuconfig GRAPHICS_TINYGL
	bool "TinyGL software OpenGL 1.1 subset"
	default n
	---help---
		Enable TinyGL, a small software-only implementation of a subset of
		OpenGL 1.1 originally written by Fabrice Bellard and maintained by
		C-Chads (https://github.com/C-Chads/tinygl).

		TinyGL renders into a memory buffer (struct ZBuffer).  The result
		can be copied to a NuttX framebuffer device (/dev/fbN) with
		ZB_copyFrameBuffer(), or TinyGL can render directly into the
		mmap()ed framebuffer memory.

		The sources are downloaded from GitHub at build time and patched
		for NuttX (see the patches in apps/graphics/tinygl).

if GRAPHICS_TINYGL

config TINYGL_URL
	string "TinyGL download URL"
	default "https://github.com/C-Chads/tinygl/archive"
	---help---
		Base URL of the TinyGL source archives.  The file
		<TINYGL_VERSION>.tar.gz is downloaded from here.

config TINYGL_VERSION
	string "TinyGL git revision"
	default "36a7987e7bebfda19615ea33341b1cc0ff9c3b13"
	---help---
		Git commit of C-Chads/tinygl to download.  The NuttX patches are
		made against this revision.

choice
	prompt "TinyGL pixel format"
	default TINYGL_RENDER_BITS_32

config TINYGL_RENDER_BITS_32
	bool "32 bits per pixel (XRGB8888)"

config TINYGL_RENDER_BITS_16
	bool "16 bits per pixel (RGB565)"

endchoice # TinyGL pixel format

config TINYGL_TEXTURE_POW2
	int "Texture size (log2)"
	default 8
	range 4 10
	---help---
		TinyGL uses a single, fixed texture size set at compile time.  All
		textures are resized to (1 << TINYGL_TEXTURE_POW2) pixels square.
		The default of 8 means 256x256 textures, which use 256KiB each in
		32-bit mode.

config TINYGL_SELECT
	bool "Support GL_SELECT and GL_FEEDBACK render modes"
	default n
	---help---
		Enable glRenderMode(GL_SELECT) (object picking with
		glSelectBuffer()/glLoadName()) and GL_FEEDBACK.  Enabling this makes
		all rendering slightly slower.

config TINYGL_GL_POLYGON
	bool "Support GL_POLYGON and GL_LINE_LOOP"
	default y
	---help---
		Enable rendering of general polygons (up to
		TINYGL_POLYGON_MAX_VERTEX vertices) and line loops.

config TINYGL_POLYGON_MAX_VERTEX
	int "Maximum number of vertices in a GL_POLYGON"
	default 16
	depends on TINYGL_GL_POLYGON

config TINYGL_BLEND
	bool "Support blending (glBlendFunc)"
	default y

config TINYGL_BLEND_DRAW_PIXELS
	bool "Apply blending to glDrawPixels()"
	default n
	depends on TINYGL_BLEND

config TINYGL_POLYGON_STIPPLE
	bool "Support polygon stipple (glPolygonStipple)"
	default y

config TINYGL_NO_DRAW_COLOR
	bool "Skip texels with the no-draw color (0xff00ff)"
	default y
	---help---
		When enabled, texture mapped pixels whose color is exactly
		magenta (0xff00ff) are not drawn, which gives cheap cut-out
		textures.

config TINYGL_ERROR_CHECK
	bool "Enable glGetError() error checking"
	default n
	---help---
		Set GL error flags on invalid calls so that they can be read with
		glGetError().  Useful for debugging, slightly slower.

endif # GRAPHICS_TINYGL
```

## industry/cnc/nvmpg-dro/Kconfig
```kconfig
#
# For a description of the syntax of this configuration file,
# see the file kconfig-language.txt in the NuttX tools repository.
#

config INDUSTRY_CNC_NVMPG_DRO
	tristate "Digital Dream NVMPG pendant DRO"
	default n
	depends on LCD_DEV && DEV_GPIO && !DISABLE_PTHREAD
	---help---
		Digital readout firmware for the Digital Dream NVMPG pendant used
		with the NVUM/NVEM/EC300/EC500 CNC motion controllers.  It shows
		the axis positions, overrides and MPG step that the controller
		sends over the serial link, and reports the pendant keys back to
		it using the same protocol as the original firmware.

if INDUSTRY_CNC_NVMPG_DRO

config INDUSTRY_CNC_NVMPG_DRO_PROGNAME
	string "Program name"
	default "nvmpg_dro"

config INDUSTRY_CNC_NVMPG_DRO_PRIORITY
	int "DRO task priority"
	default 100

config INDUSTRY_CNC_NVMPG_DRO_STACKSIZE
	int "DRO stack size"
	default 2048

config INDUSTRY_CNC_NVMPG_DRO_TTY
	string "Serial port connected to the controller"
	default "/dev/ttyS0"

config INDUSTRY_CNC_NVMPG_DRO_LCD
	string "LCD character device"
	default "/dev/lcd0"

config INDUSTRY_CNC_NVMPG_DRO_NKEYS
	int "Number of keys (/dev/gpio0 .. /dev/gpioN-1)"
	default 10

config INDUSTRY_CNC_NVMPG_DRO_SPLASH
	bool "Show the NuttX logo at startup"
	default y

config INDUSTRY_CNC_NVMPG_DRO_SPLASH_MS
	int "Splash duration (ms)"
	default 1000
	depends on INDUSTRY_CNC_NVMPG_DRO_SPLASH

config INDUSTRY_CNC_NVMPG_DRO_LINK_TIMEOUT
	int "Link timeout (ms)"
	default 1000
	---help---
		Positions are drawn greyed out when no frame was received from
		the controller for this long.

endif
```

## mlearning/tflite-micro/Kconfig
```kconfig
#
# For a description of the syntax of this configuration file,
# see the file kconfig-language.txt in the NuttX tools repository.
#

config TFLITEMICRO
	bool "TFLiteMicro"
	default n
	depends on SYSTEM_FLATBUFFERS && MATH_GEMMLOWP && MATH_KISSFFT && MATH_RUY

if TFLITEMICRO
config TFLITEMICRO_DEBUG
	bool "Print tflite-micro's debug message"
	default n

config TFLITEMICRO_TOOL
	bool "tflite-micro cmdline tool"
	default n

config TFLITEMICRO_SYSLOG
	bool "tflite-micro syslog backend"
	default n

if TFLITEMICRO_SYSLOG

config TFLITEMICRO_SYSLOG_LEVEL
	int "tflite-micro syslog level"
	default 6
	---help---
		Syslog level mapping of tflm, This log level mapping is consistent
		with the nuttx syslog level, please refer to syslog.h:

		define LOG_EMERG     0  /* System is unusable */
		define LOG_ALERT     1  /* Action must be taken immediately */
		define LOG_CRIT      2  /* Critical conditions */
		define LOG_ERR       3  /* Error conditions */
		define LOG_WARNING   4  /* Warning conditions */
		define LOG_NOTICE    5  /* Normal, but significant, condition */
		define LOG_INFO      6  /* Informational message */
		define LOG_DEBUG     7  /* Debug-level message */

endif # TFLITEMICRO_SYSLOG

if TFLITEMICRO_TOOL
config TFLITEMICRO_TOOL_PRIORITY
	int "tflite-micro tool priority"
	default 100

config TFLITEMICRO_TOOL_STACKSIZE
	int "tflite-micro tool stacksize"
	default 4096

endif # TFLITEMICRO_TOOL

config TFLITEMICRO_HELLOWORLD
	bool "Enable Tflite-micro hello world example"
	default n

if TFLITEMICRO_HELLOWORLD
config TFLITEMICRO_HELLOWORLD_PRIORITY
	int "Tflite-micro hello world priority"
	default 100

config TFLITEMICRO_HELLOWORLD_STACKSIZE
	int "Tflite-micro hello world stacksize"
	default 4096

endif # TFLITEMICRO_HELLOWORLD
endif # TFLITEMICRO
```

## netutils/fbvnc/Kconfig
```kconfig
#
# For a description of the syntax of this configuration file,
# see the file kconfig-language.txt in the NuttX tools repository.
#

menuconfig NETUTILS_FBVNC
	bool "VNC server (RFB 3.7) streaming a caller-owned framebuffer"
	default n
	depends on NET_TCP
	---help---
		A VNC Remote Frame Buffer server that streams a framebuffer the
		application owns, supplied through a snapshot callback.

		This is deliberately not the same thing as the VNC server in
		drivers/video/vnc:  that one allocates a framebuffer of its own
		and registers it as another /dev/fbN, so it is a second, virtual
		display.  This one has no framebuffer at all and streams whatever
		the caller points it at, which is what lets it mirror the display
		the LCD is already showing without a duplicate copy.

if NETUTILS_FBVNC

config NETUTILS_FBVNC_PORT
	int "TCP port"
	default 5900
	---help---
		The port clients connect to.  Display N in a VNC client's
		address is port 5900 + N.

config NETUTILS_FBVNC_STACKSIZE
	int "Sender thread stack size"
	default 8192
	---help---
		Sizes the thread that writes frames out.  The protocol loop
		runs in the caller's thread, so its stack is the caller's.

config NETUTILS_FBVNC_PRIORITY
	int "Server thread priority"
	default 100
	---help---
		Keep this below the priority of the thread that renders the UI.
		The remote display is worth less than the local one:  if the two
		compete, the local display should win.

		Note the inverted convention if you are porting a configuration
		from Zephyr, where a smaller number means a higher priority.

config NETUTILS_FBVNC_NAME
	string "Desktop name advertised to clients"
	default "NuttX"

config NETUTILS_FBVNC_FB_WIDTH
	int "Framebuffer width (pixels)"
	default 1024

config NETUTILS_FBVNC_FB_HEIGHT
	int "Framebuffer height (rows)"
	default 600

config NETUTILS_FBVNC_FB_BYTESPP
	int "Framebuffer bytes per pixel"
	default 2
	range 2 2
	---help---
		Only 2 (RGB565) is implemented so far.

		The wire format deliberately matches the framebuffer rather than
		being promoted to 32bpp RGBA.  Promoting doubles the bytes per
		frame, and at this resolution that is the difference between
		1.2 MiB and 2.4 MiB per full redraw -- enough to exhaust the
		Ethernet driver's buffer pool during sustained navigation.

config NETUTILS_FBVNC_MAX_DIRTY
	int "Maximum dirty rectangles per update"
	default 32
	---help---
		How many rectangles the snapshot callback may report.  When the
		application has more changed regions than this it should collapse
		them into one full-screen rectangle rather than dropping any.

config NETUTILS_FBVNC_SEND_CHUNK
	int "Maximum bytes per send() call"
	default 8192

config NETUTILS_FBVNC_ENCODING_HEXTILE
	bool "Hextile encoding (RFB 7.7.4)"
	default y
	---help---
		Tile-based encoding, 16x16 tiles, each described as a fill, as
		runs of a foreground colour over a background, or as raw pixels.

		On a user interface most tiles are a single colour, and a solid
		tile costs three bytes against 512 raw.  That is the difference
		between a first frame that arrives and one that does not: a
		1024x600 screen is 1.2 MiB raw, and this link cannot carry that
		while the display is being redrawn.

		All of the codec is here -- no zlib, no jpeg.  ZRLE and Tight
		compress better but need both, and a per-session deflate
		context besides.

		Falls back to Raw when the client does not ask for Hextile, or
		when it has negotiated a pixel format other than the
		framebuffer's own.

config NETUTILS_FBVNC_MIN_UPDATE_MS
	int "Minimum time between framebuffer updates (ms)"
	default 100
	---help---
		A floor on the time between two consecutive answers to a client
		asking for a framebuffer update, no matter how fast it asks.
		100 ms is a ceiling of 10 updates per second.

		Clients ask again the instant they have finished parsing the
		last answer, which while a list is being dragged means a full
		screen is in flight permanently and the display never catches
		up.  Delaying the answer is not a protocol violation; the
		client is already waiting for one.

		Set to 0 to answer as fast as the client asks.

config NETUTILS_FBVNC_SEND_TIMEOUT
	int "Send timeout (seconds)"
	default 30
	---help---
		Disconnect the client if a send blocks for longer than this.  On
		a wedged connection this is what gets the server back to
		accepting new clients.

endif # NETUTILS_FBVNC

config NETUTILS_FBVNC_TRACE
	bool "Log what every update cost"
	default n
	---help---
		Report, for each update sent, how many rectangles it carried,
		how many bytes they cover, and how long the snapshot and the
		sending each took.

		This is how one tells a slow link from a slow application:  a
		large send time is the network, a large snapshot time is
		whatever produced the pixels.  It is a line of output per
		update, which is far too much to leave on, so it is asked for
		rather than assumed.

config NETUTILS_FBVNC_ENCODING_TRLE
	bool "TRLE encoding (RFB 7.7.5)"
	default y
	---help---
		Send a tile of few colours as a palette and an index per pixel
		rather than as a list of sub-rectangles.

		A widget toolkit draws flat panels and text, so most tiles have
		one or two colours;  two colours cost one bit per pixel here,
		against a sub-rectangle each in Hextile.  Offered to clients
		that ask for it, and preferred over Hextile when both are
		offered.

		Only the native pixel format is served this way.  A client that
		negotiates another gets Raw, converted.
```

## netutils/paho_mqtt/Kconfig
```kconfig
#
# For a description of the syntax of this configuration file,
# see the file kconfig-language.txt in the NuttX tools repository.
#

config LIB_MQTT5
	bool "Enable mqtt5"
	default n
	---help---
		A library for accessing mqtt5 client services through C libraries calls in a simple manner.

config LIB_MQTT5_THREAD_STACKSIZE
	int "MQTT library thread stack size"
	default 16384
	depends on LIB_MQTT5
	---help---
		Stack size used by threads created by the Paho MQTT library.

config LIB_MQTT5_HIGH_PERFORMANCE
	bool "Enable Paho high-performance mode"
	default y
	depends on LIB_MQTT5
	---help---
		Disable Paho heap-allocation tracking and function call-stack
		tracing to reduce runtime and memory overhead. Disable this option
		when debugging the Paho MQTT library.

config UTILS_MQTT5
	tristate "Enable mqtt5 tool"
	depends on LIB_MQTT5
	---help---
		Enable mqtt utility

if UTILS_MQTT5
config UTILS_MQTT5_PRIORITY
	int "mqtt utility priority"
	default 100

config UTILS_MQTT5_STACKSIZE
	int "mqtt utility statcksize"
	default 16384

endif # UTILS_MQTT5
```
