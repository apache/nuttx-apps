## games/NXDoom/Kconfig
```kconfig
#
# For a description of the syntax of this configuration file,
# see the file kconfig-language.txt in the NuttX tools repository.
#

config GAMES_NXDOOM
	tristate "NXDoom"
	default n
	depends on ALLOW_GPL_COMPONENTS
	depends on VIDEO_FB
	depends on CRYPTO
	depends on LIBC_LOCALE
	---help---
		Play DOOM on NuttX!

if GAMES_NXDOOM

comment "Program options"

config GAMES_NXDOOM_PRIORITY
	int "Priority"
	default 100
	---help---
		The task priority for the NXDoom application.

config GAMES_NXDOOM_STACKSIZE
	int "Stack size"
	default 4096
	---help---
		The stack size for the NXDoom application.

comment "General game options"

choice # Language
	prompt "Game language"
	default GAMES_NXDOOM_LANG_EN

	config GAMES_NXDOOM_LANG_EN
		bool "English"
		---help---
			English language support (original).

	config GAMES_NXDOOM_LANG_FR
		bool "French"
		---help---
			French language support.
endchoice # Language

config GAMES_NXDOOM_PREFDIR
	string "DOOM data directory"
	default "/data"
	---help---
		Directory where DOOM WAD files are stored.

config GAMES_NXDOOM_ENDOOM
	bool "Show ENDOOM"
	default n
	---help---
		Show the ENDOOM screen (https://www.doomwiki.org/wiki/ENDOOM).

source "$APPSDIR/games/NXDoom/Kconfig.network"

source "$APPSDIR/games/NXDoom/Kconfig.sound"

source "$APPSDIR/games/NXDoom/Kconfig.graphics"

source "$APPSDIR/games/NXDoom/Kconfig.input"

source "$APPSDIR/games/NXDoom/Kconfig.optimizations"

source "$APPSDIR/games/NXDoom/Kconfig.debug"

endif # GAMES_NXDOOM
```

## games/NXDoom/Kconfig.debug
```kconfig
menuconfig GAMES_NXDOOM_DEBUG
	bool "Debug options"
	default n
	---help---
		Enables debugging options for the NXDoom port.
	
if GAMES_NXDOOM_DEBUG

config GAMES_NXDOOM_RANGECHECK
	bool "Perform range checks"
	default y
	---help---
		The ChocolateDOOM source includes the ability to optionally exclude
		range checking on some array operations.

config GAMES_NXDOOM_ALLOCPROF
	bool "Profile allocator"
	default n
	---help---
		Print the running tally of allocated memory for NXDoom to the console as
		allocations are made.

endif # GAMES_NXDOOM_DEBUG
```

## games/NXDoom/Kconfig.graphics
```kconfig
menu "Graphics options"

config GAMES_NXDOOM_FBPATH
	string "Framebuffer path"
	default "/dev/fb0"
	---help---
		Path to the framebuffer character driver to use for rendering.

endmenu # Graphics options
```

## games/NXDoom/Kconfig.input
```kconfig
choice # Input method
	prompt "NXDoom input method"
	default GAMES_NXDOOM_KEYBOARD

	config GAMES_NXDOOM_KEYBOARD
		bool "Keyboard"
		---help---
			Use a NuttX keyboard character driver.

endchoice # Input method

if GAMES_NXDOOM_KEYBOARD

config GAMES_NXDOOM_UARTKBD
	bool "Keys from a serial terminal"
	default n
	---help---
		Read the keys from a serial terminal instead of a keyboard driver.
		KBDPATH then names a tty, such as /dev/console.  A terminal reports
		a key press only, so each press is released again once the terminal
		stops repeating it.  WASD or the arrow keys move, J fires, K runs,
		L strafes, E or space uses, Q or Esc opens the menu.

config GAMES_NXDOOM_KBDPATH
	string "Keyboard device path"
	default "/dev/kbd0"
	---help---
		Path to the keyboard device to use as input.

endif # GAMES_NXDOOM_KEYBOARD
```

## games/NXDoom/Kconfig.network
```kconfig
menuconfig GAMES_NXDOOM_NET
	bool "Networking features"
	default n
	---help---
		Not ported! Will not work.

if GAMES_NXDOOM_NET

config GAMES_NXDOOM_NET_LOGS
	bool "Enable network logging"
	default n
	---help---
		Enables log information from the network features.

config GAMES_NXDOOM_NET_MAXPLAYERS
	int "Maximum number of players"
	default 6
	---help---
		The maximum number of players, multiplayer/networking.
		This is the maximum supported by the networking code; individual games
		have their own values for MAXPLAYERS that can be smaller.
		ChocolateDOOM default was 8.

config GAMES_NXDOOM_NET_BACKUPTICS
	int "Maximum number of backup tics"
	default 32
	---help---
		The maximum number of backup tics to store locally during a net game.
		ChocalateDOOM default was 128.

config GAMES_NXDOOM_NET_MAXPLAYERNAME
	int "Maximum player name length"
	default 16
	---help---
		The maximum number of characters in a player name for netgames.
		ChocalateDOOM default was 30.

endif # GAMES_NXDOOM_NET
```

## games/NXDoom/Kconfig.optimizations
```kconfig
menu "Optimizations"

config GAMES_NXDOOM_MAXVISPLANES
	int "Maximum number of visplanes"
	default 96
	---help---
		DOOM allocates a static number of 'visplanes' to use for gameplay. The
		original ChocolateDOOM source uses 128 of these. They take a significant
		amount of memory, so you may reduce the number. However, too few planes
		may cause 'visplane overflow' errors, which is more common in complex
		levels.

config GAMES_NXDOOM_MAXOPENINGS
	int "Maximum number of openings"
	default 32
	---help---
		DOOM allocates a static number of 'openings' to use for gameplay. These
		are defined as multiples of the SCREENWIDTH (320). The original
		ChocolateDOOM source uses 64 as the multiplier. They take a significant
		amount of memory, so you may reduce the number. However, too few
		openings will cause 'opening overflow' errors.

config GAMES_NXDOOM_MAXVISSPRITES
	int "Maximum number of visible sprites"
	default 96
	---help---
		DOOM allocates a static number of 'vissprites' to use for gameplay. The
		original ChocolateDOOM source uses 128. They take a significant amount
		of memory, so you may reduce the number. However, too few will cause
		overflow errors.

config GAMES_NXDOOM_MAXDRAWSEGS
	int "Maximum number of drawsegs"
	default 192
	---help---
		DOOM allocates a static number of 'drawsegs' to use for gameplay. The
		original ChocolateDOOM source uses 256. They take a significant amount of
		memory, so you may reduce the number. However, too few will cause
		rendering issues (overflow is checked to avoid crashes).

config GAMES_NXDOOM_STATDUMP_MAX_CAPTURES
	int "Maximum statdump capture buffer entries"
	default 32
	range 1 1024
	---help---
		Number of diagnostic playtime-statistics capture slots.

config GAMES_NXDOOM_FB_CMAP
	bool "Draw through the frame buffer colour map"
	default n
	---help---
		DOOM draws into an 8-bit palettised buffer and normally converts
		every pixel to the pixel format of the frame buffer as it blits.
		A frame buffer that has a colour map of its own can do that
		conversion in hardware while it scans the display out, so enable
		this to load the DOOM palette into the colour map and blit the
		palette indices unconverted.

		This needs a frame buffer that is 8 bits per pixel and supports
		FBIOPUT_CMAP, such as an STM32 LTDC layer configured for L8.  It
		both removes the conversion and halves the amount of data written
		per frame, which matters most when the frame buffer is external
		memory.

config GAMES_NXDOOM_FILLSCREEN
	bool "Stretch the image to the whole display"
	default n
	---help---
		By default the 320x200 image is scaled by the largest whole number
		that fits, which leaves a border on a display whose size is not an
		exact multiple of it.  Enable this to stretch the image over the
		entire frame buffer instead, which fills the display at the cost of
		a scale factor that is not uniform across the image.

config GAMES_NXDOOM_ROWSTAGE
	bool "Build each output row in a staging buffer"
	default n
	---help---
		Expand each row into a staging buffer and copy it to the frame
		buffer, rather than writing the frame buffer a pixel at a time.
		Every frame buffer access then becomes a burst-friendly copy, which
		is worth a lot when the frame buffer is external memory and the
		data cache is in write-through mode, and little otherwise.

		Costs a few kilobytes of .bss for the buffer.  A row that does not
		fit is written directly, as if this were disabled.

config GAMES_NXDOOM_STATIC_SCRNBUF
	bool "Statically allocate render targets"
	default n
	---help---
		For devices with more space available for .bss and less for the heap,
		this option enables static memory as the backing memory for rendering
		targets (i.e. screen, status bar, etc.).

choice # Memory allocation implementation
	prompt "Memory allocation implementation"
	default GAMES_NXDOOM_ALLOC_ZNATIVE

	config GAMES_NXDOOM_ALLOC_ZNATIVE
		bool "z_native"
		---help---
			Use the `z_native` allocator, which relies on NuttX's implementation
			of `malloc()` and `free()` to handle memory allocation.

	config GAMES_NXDOOM_ALLOC_ZZONE
		bool "z_zone"
		---help---
			Use the `z_zone` allocator, which is DOOM's implementation that acts
			on an up-front allocated chunk of memory given by `i_zone_base()`.
	
endchoice # Memory allocation implementation

if GAMES_NXDOOM_ALLOC_ZZONE

config GAMES_NXDOOM_ALLOC_ZZONESTATIC
	bool "Use static z_zone"
	default n
	---help---
		When using the `z_zone` allocator, use static memory to back the
		allocations instead of getting the initial memory from the heap
		using `malloc()`.

endif # GAMES_NXDOOM_ALLOC_ZZONE

config GAMES_NXDOOM_NOWIPE
	bool "Disable wipe animation"
	default n
	---help---
		DOOM has a wipe animation between screens which requires costly
		`z_malloc` allocations. Enabling this option disables that animation.

config GAMES_NXDOOM_SHOWDISKICON
	bool "Show disk icon"
	default n
	---help---
		DOOM can show a disk activity indicator when reading data. Disabling
		this option removes the animation, which saves memory allocations.

endmenu # Optimizations
```

## games/NXDoom/Kconfig.sound
```kconfig
menuconfig GAMES_NXDOOM_SOUND
	bool "Sound features"
	default n
	---help---
		Not ported! Will not work.

if GAMES_NXDOOM_SOUND

config GAMES_NXDOOM_RTTTL_MUSIC
	bool "RTTTL music"
	default n
	depends on AUDIOUTILS_RTTTL_C
	depends on !DISABLE_PTHREAD
	---help---
		Play music using RTTTL.

config GAMES_NXDOOM_RTTTL_DEVICE
	string "RTTTL device"
	default "/dev/pwm0"
	depends on GAMES_NXDOOM_RTTTL_MUSIC
	---help---
		Device for RTTTL output (only PWM currently supported).

endif # GAMES_NXDOOM_SOUND
```

## graphics/microwindows/Kconfig
```kconfig
#
# For a description of the syntax of this configuration file,
# see the file kconfig-language.txt in the NuttX tools repository.
#

menuconfig GRAPHICS_MICROWINDOWS
	bool "Microwindows or the Nano-X Window System"
	default n
	depends on VIDEO_FB
	---help---
		Enable Microwindows or the Nano-X Window System

if GRAPHICS_MICROWINDOWS

config MICROWINDOWS_FB_PATH
	string "Framebuffer device path"
	default "/dev/fb0"
	---help---
		Path to the NuttX framebuffer device.

choice
	prompt "Keyboard driver"
	default MICROWINDOWS_KBD_EVENT
	---help---
		Select the keyboard input driver for Microwindows.

config MICROWINDOWS_KBD_EVENT
	bool "Event-mode keyboard driver"
	---help---
		Reads keyboard_event_s events from a NuttX keyboard device
		(e.g., /dev/kbd).  Supports key press/release tracking and
		modifier keys (Shift, Ctrl, Alt).

config MICROWINDOWS_KBD_RAW
	bool "Raw-mode keyboard driver"
	depends on INPUT_KEYBOARD_BYTESTREAM
	---help---
		Reads raw byte stream from a character device (e.g., /dev/kbda)
		and decodes escape sequences via the kbd_codec library.  Suitable
		for USB HID keyboards on QEMU.

config MICROWINDOWS_KBD_NONE
	bool "No keyboard driver"
	---help---
		No keyboard driver is compiled.  Microwindows will use a null
		keyboard driver that never produces input.  Suitable for
		display-only applications.

config MICROWINDOWS_KBD_CUSTOM
	bool "Custom keyboard driver"
	---help---
		No built-in keyboard driver is compiled.  The application or BSP
		must provide its own kbddev symbol and KBDDEVICE implementation,
		and add the source file to the build (e.g., via CSRCS in its
		Makefile).  See the Microwindows documentation for details.

endchoice

config MICROWINDOWS_KBD_EVENT_PATH
	string "Event keyboard device path"
	default "/dev/kbd"
	depends on MICROWINDOWS_KBD_EVENT
	---help---
		Device path for the event-mode keyboard driver.

config MICROWINDOWS_KBD_RAW_PATH
	string "Raw keyboard device path"
	default "/dev/kbda"
	depends on MICROWINDOWS_KBD_RAW
	---help---
		Device path for the raw-mode keyboard driver.

choice
	prompt "Mouse/touchscreen driver"
	default MICROWINDOWS_MOUSE_RELATIVE
	---help---
		Select the pointing device driver for Microwindows.

config MICROWINDOWS_MOUSE_RELATIVE
	bool "Relative mouse driver"
	---help---
		Reads mouse_report_s events from a NuttX mouse device
		(e.g., /dev/mouse0).  Supports three buttons and scroll wheel.

config MICROWINDOWS_MOUSE_TS
	bool "Touchscreen driver"
	---help---
		Reads touch_sample_s events from a NuttX touchscreen device
		(e.g., /dev/input0).  Supports absolute positioning.

config MICROWINDOWS_MOUSE_NONE
	bool "No mouse/touchscreen driver"
	---help---
		No pointing device driver is compiled.  Microwindows will use a
		null mouse driver that never produces input and hides the cursor.
		Suitable for display-only applications.

config MICROWINDOWS_MOUSE_CUSTOM
	bool "Custom mouse/touchscreen driver"
	---help---
		No built-in pointing device driver is compiled.  The application
		or BSP must provide its own mousedev symbol and MOUSEDEVICE
		implementation, and add the source file to the build (e.g., via
		CSRCS in its Makefile).  See the Microwindows documentation for
		details.

endchoice

config MICROWINDOWS_MOUSE_PATH
	string "Mouse device path"
	default "/dev/mouse0"
	depends on MICROWINDOWS_MOUSE_RELATIVE
	---help---
		Device path for the relative mouse driver.

config MICROWINDOWS_TS_PATH
	string "Touchscreen device path"
	default "/dev/input0"
	depends on MICROWINDOWS_MOUSE_TS
	---help---
		Device path for the touchscreen driver.

config MICROWINDOWS_MWIN
	bool "Win32 API (mwin) support"
	default n
	---help---
		Build the Microwindows Win32 (mwin) API library.  This provides
		a high-level windowing API similar to the Microsoft Windows API
		with window management, controls, and standard dialogs.

endif # GRAPHICS_MICROWINDOWS
```
