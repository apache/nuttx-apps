## industry/nxmodbus/Kconfig
```kconfig
#
# For a description of the syntax of this configuration file,
# see the file kconfig-language.txt in the NuttX tools repository.
#

menuconfig INDUSTRY_NXMODBUS
	bool "NxModbus - New Modbus Stack"
	default n
	---help---
		NxModbus is a modern Modbus stack for NuttX with multi-instance
		support, per-instance register callbacks, and pluggable transport
		backends (RTU, ASCII, TCP, Raw ADU).

		This implementation follows NuttX coding standards and is
		designed for upstream contribution to nuttx-apps.

if INDUSTRY_NXMODBUS

config NXMODBUS_SERVER
	bool "Server (slave) support"
	default y
	---help---
		Enable Modbus server (slave) support. The server processes
		incoming Modbus requests and calls registered register
		callbacks.

config NXMODBUS_CLIENT
	bool "Client (master) support"
	default n
	---help---
		Enable Modbus client (master) support. The client sends
		Modbus requests to a server and receives responses.

config NXMODBUS_RTU
	bool "Modbus RTU mode"
	default y
	---help---
		Enable Modbus RTU (Remote Terminal Unit) serial transmission
		mode. Uses binary encoding with CRC16 error checking.

config NXMODBUS_ASCII
	bool "Modbus ASCII mode"
	default n
	---help---
		Enable Modbus ASCII serial transmission mode. Uses
		hex-encoded text with LRC error checking. Slower but
		more human-readable than RTU.

config NXMODBUS_TCP
	bool "Modbus TCP mode"
	default n
	depends on NET_TCP
	---help---
		Enable Modbus TCP support. Modbus frames are encapsulated
		in TCP/IP using the MBAP header format. Requires network
		stack with TCP support.

config NXMODBUS_RAW_ADU
	bool "Raw ADU transport support"
	default n
	---help---
		Enable raw ADU (Application Data Unit) transport mode.
		The application provides callbacks for transmitting and
		receiving raw Modbus frames. This enables custom transports
		such as TLS, CAN, BLE, or MQTT.

config NXMODBUS_MAX_INSTANCES
	int "Maximum number of NxModbus instances"
	default 1
	range 1 16
	---help---
		Maximum number of simultaneous NxModbus instances. Each
		instance can use a different transport (RTU, TCP, etc.)
		and configuration. Instances are allocated from a static
		pool at compile time.

config NXMODBUS_ADU_DATA_MAX
	int "ADU data buffer size in bytes"
	default 252
	range 4 252
	---help---
		Size of the data[] payload in struct nxmb_adu_s, in bytes.
		This is the PDU body after the function code. The Modbus
		specification allows up to 252 data bytes (1 fc + 252 data =
		253-byte PDU max). Reduce this value to save RAM on
		resource-constrained systems.

config NXMODBUS_REP_SERVER_ID_BUF
	int "Report Server ID buffer size"
	default 32
	range 4 253
	---help---
		Size of the buffer used by FC17 (Report Server ID).
		This buffer holds the server ID byte, run indicator, and
		optional additional data configured via nxmb_set_server_id().

config NXMODBUS_ASCII_TIMEOUT_SEC
	int "ASCII character timeout (seconds)"
	default 1
	range 1 60
	depends on NXMODBUS_ASCII
	---help---
		Character timeout for Modbus ASCII mode in seconds. If no
		character is received within this period, the current frame
		is discarded. Default is 1 second per the Modbus specification.

config NXMODBUS_CLIENT_TIMEOUT_MS
	int "Client default response timeout (ms)"
	default 1000
	range 100 60000
	depends on NXMODBUS_CLIENT
	---help---
		Default response timeout for client (master) mode in
		milliseconds. If no response is received from the server
		within this period, the request fails with ETIMEDOUT.
		Can be overridden at runtime via nxmb_set_timeout().

config NXMODBUS_TCP_MAX_CLIENTS
	int "Maximum simultaneous TCP client connections"
	default 1
	range 1 8
	depends on NXMODBUS_TCP
	---help---
		Maximum number of simultaneous TCP client connections
		accepted by a Modbus TCP server instance. Each connection
		uses one file descriptor. Set to 1 for minimal resource
		usage.

config NXMODBUS_TCP_TIMEOUT_SEC
	int "TCP idle connection timeout (seconds)"
	default 60
	range 1 3600
	depends on NXMODBUS_TCP
	---help---
		Idle timeout for TCP connections in seconds. If no data is
		received on a client connection within this period, the
		connection is closed. Set to a higher value for slow networks.

config NXMODBUS_RTU_IDLE_TIMEOUT_MS
	int "RTU inter-frame idle timeout (ms)"
	default 50
	range 1 1000
	depends on NXMODBUS_RTU
	---help---
		Fallback idle timeout in milliseconds used by the RTU
		transport when waiting for a new frame via select(). This
		is the maximum time to block waiting for data when no
		frame is in progress. The T3.5 character timing is still
		used for frame delimiting within an active reception.

menu "Function Code Selection"

config NXMODBUS_FUNC_READ_COILS
	bool "FC01 Read Coils"
	default y
	depends on NXMODBUS_SERVER
	---help---
		Enable FC01 Read Coils function code handler.

config NXMODBUS_FUNC_READ_DISCRETE
	bool "FC02 Read Discrete Inputs"
	default y
	depends on NXMODBUS_SERVER
	---help---
		Enable FC02 Read Discrete Inputs function code handler.

config NXMODBUS_FUNC_READ_HOLDING
	bool "FC03 Read Holding Registers"
	default y
	depends on NXMODBUS_SERVER
	---help---
		Enable FC03 Read Holding Registers function code handler.

config NXMODBUS_FUNC_READ_INPUT
	bool "FC04 Read Input Registers"
	default y
	depends on NXMODBUS_SERVER
	---help---
		Enable FC04 Read Input Registers function code handler.

config NXMODBUS_FUNC_WRITE_COIL
	bool "FC05 Write Single Coil"
	default y
	depends on NXMODBUS_SERVER
	---help---
		Enable FC05 Write Single Coil function code handler.

config NXMODBUS_FUNC_WRITE_HOLDING
	bool "FC06 Write Single Holding Register"
	default y
	depends on NXMODBUS_SERVER
	---help---
		Enable FC06 Write Single Holding Register function
		code handler.

config NXMODBUS_FUNC_DIAGNOSTICS
	bool "FC08 Diagnostics"
	default y
	depends on NXMODBUS_SERVER
	---help---
		Enable FC08 Diagnostics function code handler.
		Only sub-function 0x0000 (Return Query Data) is supported.

config NXMODBUS_FUNC_WRITE_COILS
	bool "FC15 Write Multiple Coils"
	default y
	depends on NXMODBUS_SERVER
	---help---
		Enable FC15 Write Multiple Coils function code handler.

config NXMODBUS_FUNC_WRITE_HOLDINGS
	bool "FC16 Write Multiple Holding Registers"
	default y
	depends on NXMODBUS_SERVER
	---help---
		Enable FC16 Write Multiple Holding Registers function
		code handler.

config NXMODBUS_FUNC_REPORT_SERVER_ID
	bool "FC17 Report Server ID"
	default y
	depends on NXMODBUS_SERVER
	---help---
		Enable FC17 Report Server ID function code handler.

config NXMODBUS_FUNC_READWRITE_HOLDINGS
	bool "FC23 Read/Write Multiple Holding Registers"
	default y
	depends on NXMODBUS_SERVER
	---help---
		Enable FC23 Read/Write Multiple Holding Registers
		function code handler.

endmenu # Function Code Selection

config NXMODBUS_CUSTOM_FC
	bool "Custom function code extension support"
	default y
	depends on NXMODBUS
	---help---
		Enable support for registering custom Modbus function
		code handlers. Applications can extend the Modbus
		function code set via nxmb_register_custom_fc().

endif # INDUSTRY_NXMODBUS
```

## industry/scpi/Kconfig
```kconfig
#
# For a description of the syntax of this configuration file,
# see the file kconfig-language.txt in the NuttX tools repository.
#

config SCPI_PARSER
	tristate "SCPI instrument side parser"
	default n

if SCPI_PARSER

menu "SCPI parser unit support"

config SCPI_PARSER_UNITS_IMPERIAL
	bool "Imperial units"
	default n

config SCPI_PARSER_UNITS_ANGLE
	bool "Angle units"
	default n

config SCPI_PARSER_UNITS_PARTICLES
	bool "Particle units"
	default n

config SCPI_PARSER_UNITS_DISTANCE
	bool "Distance units"
	default n

config SCPI_PARSER_UNITS_MAGNETIC
	bool "Magnetic units"
	default n

config SCPI_PARSER_UNITS_LIGHT
	bool "Light units"
	default n

config SCPI_PARSER_UNITS_ENERGY_FORCE_MASS
	bool "Energy, force, and mass units"
	default n

config SCPI_PARSER_UNITS_TIME
	bool "Time units"
	default n

config SCPI_PARSER_UNITS_TEMPERATURE
	bool "Temperature units"
	default n

config SCPI_PARSER_UNITS_RATIO
	bool "Ratio units"
	default n

config SCPI_PARSER_UNITS_POWER
	bool "Power units"
	default y

config SCPI_PARSER_UNITS_FREQUENCY
	bool "Frequency units"
	default y

config SCPI_PARSER_UNITS_ELECTRIC
	bool "Electric units"
	default y

config SCPI_PARSER_UNITS_ELECTRIC_CHARGE_CONDUCTANCE
	bool "Electric charge and conductance units"
	default n

endmenu

config SCPI_PARSER_DEMO
	bool "Enable the SCPI parser library demo"
	default n

if SCPI_PARSER_DEMO

config SCPI_PARSER_DEMO_PRIORITY
	int "SCPI demo program priority"
	default 100

config SCPI_PARSER_DEMO_STACKSIZE
	int "SCPI demo program stack size"
	default DEFAULT_TASK_STACKSIZE

endif

endif
```

## inertial/madgwick/Kconfig
```kconfig
#
# For a description of the syntax of this configuration file,
# see the file kconfig-language.txt in the NuttX tools repository.
#

config LIB_MADGWICK
	bool "Madgwick Fusion Algorithm"
	default n
	depends on ALLOW_MIT_COMPONENTS
	---help---
		Enable madgwick fusion algorithm.
		Madgwick is a quick fusion algorithm use integrate
		accelerometer, gyroscope and magnotomer (compass).

if LIB_MADGWICK

config LIB_MADGWICK_VER
	string "Lib Madgwick version"
	default "1.2.1"

endif # LIB_MADGWICK
```

## interpreters/Kconfig
```kconfig
#
# For a description of the syntax of this configuration file,
# see the file kconfig-language.txt in the NuttX tools repository.
#

menu "Interpreters"

source "$APPSDIR/interpreters/bas/Kconfig"
source "$APPSDIR/interpreters/ficl/Kconfig"

config INTERPRETERS_PCODE
	bool "Pascal p-code interpreter"
	default n
	---help---
		Enable support for the Pascal p-code interpreter.  See the README.txt
		file at located in the NuttX Pascal repository and also the
		README.txt file in the apps/interpreter directory. Use of this
		configuration implies that you have performed the required
		installation of the Pascal run-time code.

if INTERPRETERS_PCODE
endif

source "$APPSDIR/interpreters/micropython/Kconfig"
endmenu # Interpreters
```

## interpreters/bas/Kconfig
```kconfig
#
# For a description of the syntax of this configuration file,
# see the file kconfig-language.txt in the NuttX tools repository.
#

config INTERPRETERS_BAS
	tristate "Basic Interpreter support"
	default n
	select LIBC_FLOATINGPOINT
	depends on FS_READABLE
	---help---
		This is a Basic interpreter written by Michael Haardt

		NOTE: This interpreter requires a usable math.h header file.  By
		default, the math library (and hence, math.h) are not provided by
		NuttX.  Therefore, when the Basic code includes math.h it will
		either fail to find the math.h header file or, worse, will take an
		incompatible version of math.h from your toolchain.  The toolchain's
		version of math.h will be incompatible because it will have been
		implemented to work with a different version of the C library.

		Normally, developers will use an optimized math library for their
		processor architecture and do the following:

		- Save a customized copy of math.h from your tool chain in
		  nuttx/arch/<arch>/include
		- Set CONFIG_ARCH_MATH_H=y in your .config file to select this
		  architecture-specific math.h header file.

		An option is to use the built-in, generic, unoptimized NuttX math
		library that is selected by simply by:

		- Set CONFIG_LIBM=y in your .config file

if INTERPRETERS_BAS

config INTERPRETER_BAS_VERSION
	string "Version number"
	default "2.4"

config INTERPRETER_BAS_PRIORITY
	int "Basic interpreter priority"
	default 100
	---help---
		Task priority of the Basic interpreter main task

config INTERPRETER_BAS_STACKSIZE
	int "Basic interpreter stack size"
	default 4096
	---help---
		Size of the stack allocated for the Basic interpreter main task

config INTERPRETER_BAS_VT100
	bool "VT100 terminal support"
	default y

config INTERPRETER_BAS_USE_LR0
	bool "LR0 parser"
	default n
	---help---
		Select if you want LR0 parser.

config INTERPRETER_BAS_USE_SELECT
	bool "Use select()"
	default n

config INTERPRETER_BAS_HAVE_FTRUNCATE
	bool
	default n
	---help---
		NuttX does not currently support the ftruncate interface

config EXAMPLES_BAS_SHELL
	bool "Shell support"
	default n
	depends on ARCH_HAVE_VFORK && EXPERIMENTAL
	select LIBC_EXECFUNCS
	select SCHED_WAITPID
	---help---
		Support execution of shell commands from BASIC.

config EXAMPLES_BAS_EDITOR
	bool "Editor support"
	default n
	depends on EXAMPLES_BAS_SHELL
	---help---
		Support execution of an editor from BASIC.

endif
```

## interpreters/berry/Kconfig
```kconfig
#
# For a description of the syntax of this configuration file,
# see the file kconfig-language.txt in the NuttX tools repository.
#

config INTERPRETERS_BERRY
	tristate "Berry scripting language"
	default n
	depends on ARCH_SETJMP_H
	depends on LIBC_FLOATINGPOINT
	depends on SYSTEM_SYSTEM
	---help---
		Enable the Berry embedded scripting language as an NSH built-in
		command.  Berry provides a small ANSI C99 compiler, register-based
		virtual machine, garbage collector, file I/O, bytecode loading and
		saving, and built-in modules.

		The default NuttX configuration keeps Berry shared-library loading
		disabled so boards do not need CONFIG_LIBC_DLFCN.  The math module
		is enabled, so select a NuttX math library or provide one from the
		toolchain.

if INTERPRETERS_BERRY

config INTERPRETERS_BERRY_PROGNAME
	string "Berry program name"
	default "berry"
	---help---
		The command name used to start the Berry interpreter.

config INTERPRETERS_BERRY_PRIORITY
	int "Berry interpreter priority"
	default 100
	---help---
		Task priority of the Berry interpreter main task.

config INTERPRETERS_BERRY_STACKSIZE
	int "Berry interpreter stack size"
	default 12288
	---help---
		Size of the stack allocated for the Berry interpreter main task.

endif # INTERPRETERS_BERRY
```

## interpreters/duktape/Kconfig
```kconfig
#
# For a description of the syntax of this configuration file,
# see the file kconfig-language.txt in the NuttX tools repository.
#

config INTERPRETERS_DUKTAPE
	tristate "Duktape JavaScript interpreter"
	default n

if INTERPRETERS_DUKTAPE

config INTERPRETERS_DUKTAPE_PRIORITY
	int "Duktape interpreter priority"
	default 100

config INTERPRETERS_DUKTAPE_STACKSIZE
	int "Duktape interpreter stack size"
	default 8192

endif
```

## interpreters/ficl/Kconfig
```kconfig
#
# For a description of the syntax of this configuration file,
# see the file kconfig-language.txt in the NuttX tools repository.
#

config INTERPRETERS_FICL
	bool "Ficl Forth interpreter"
	default n
	---help---
		Enable support for the Ficl interpreter interpreter.  See README.txt file in the
		apps/interpreters/ficl directory.  Use of this configuration assumes
		that you have performed the required installation of the Ficl run-time code.

if INTERPRETERS_FICL
endif
```

## interpreters/jimtcl/Kconfig
```kconfig
#
# For a description of the syntax of this configuration file,
# see the file kconfig-language.txt in the NuttX tools repository.
#

config INTERPRETERS_JIMTCL
	bool "The Jim (TCL) Interpreter"
	default n
	---help---
		Enable support for The Jim interpreter.
		Jim is an opensource small-footprint implementation of the
		Tcl programming language.
```
