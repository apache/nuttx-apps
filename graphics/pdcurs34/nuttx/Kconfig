## graphics/pdcurs34/nuttx/Kconfig
```kconfig
#
# For a description of the syntax of this configuration file,
# see the file kconfig-language.txt in the NuttX tools repository.
#

config PDCURSES_FBDEV
	string "Framebuffer device"
	default "/dev/fb0"

choice
	prompt "TUI Font Selection"
	default PDCURSES_FONT_6X13

config PDCURSES_FONT_4X6
	bool "4x6"
	select NXFONT_X11_MISC_FIXED_4X6
	---help---
		Enables font ID FONTID_X11_MISC_FIXED_4X6 == 21.

config PDCURSES_FONT_5X7
	bool "5x7"
	select NXFONT_X11_MISC_FIXED_5X7
	---help---
		Enables font ID FONTID_X11_MISC_FIXED_5X7 == 22.

config PDCURSES_FONT_5X8
	bool "5x8"
	select NXFONT_X11_MISC_FIXED_5X8
	---help---
		Enables font ID FONTID_X11_MISC_FIXED_5X8 == 23.

config PDCURSES_FONT_6X9
	bool "6x9"
	select NXFONT_X11_MISC_FIXED_6X9
	---help---
		Enables font ID FONTID_X11_MISC_FIXED_6X9 == 24.

config PDCURSES_FONT_6X10
	bool "6x10"
	select NXFONT_X11_MISC_FIXED_6X10
	---help---
		Enables font ID FONTID_X11_MISC_FIXED_6X10 == 25.

config PDCURSES_FONT_6X12
	bool "6x12"
	select NXFONT_X11_MISC_FIXED_6X12
	---help---
		Enables font ID FONTID_X11_MISC_FIXED_6X12 == 26.

config PDCURSES_FONT_6X13
	bool "6x13"
	select NXFONT_X11_MISC_FIXED_6X13
	select NXFONT_X11_MISC_FIXED_6X13B
	---help---
		Enables font ID FONTID_X11_MISC_FIXED_6X13 == 27 and
		bold font ID FONTID_X11_MISC_FIXED_6X13B == 28.

config PDCURSES_FONT_7X13
	bool "7x13"
	select NXFONT_X11_MISC_FIXED_7X13
	select NXFONT_X11_MISC_FIXED_7X13B
	---help---
		Enables font ID FONTID_X11_MISC_FIXED_7X13 == 30 and
		bold font ID FONTID_X11_MISC_FIXED_7X13B == 31.

config PDCURSES_FONT_7X14
	bool "7x14"
	select NXFONT_X11_MISC_FIXED_7X14
	select NXFONT_X11_MISC_FIXED_7X14B
	---help---
		Enables font ID FONTID_X11_MISC_FIXED_7X14 == 33 and
		bold font ID FONTID_X11_MISC_FIXED_7X14B == 34.

config PDCURSES_FONT_8X13
	bool "8x13"
	select NXFONT_X11_MISC_FIXED_8X13
	select NXFONT_X11_MISC_FIXED_8X13B
	---help---
		Enables font ID FONTID_X11_MISC_FIXED_8X13 == 35 and
		bold font ID FONTID_X11_MISC_FIXED_8X13B == 36.

config PDCURSES_FONT_9X15
	bool "9x15"
	select NXFONT_X11_MISC_FIXED_9X15
	select NXFONT_X11_MISC_FIXED_9X15B
	---help---
		Enables font ID FONTID_X11_MISC_FIXED_9X15 == 38 and
		bold font ID FONTID_X11_MISC_FIXED_9X15B == 39.

config PDCURSES_FONT_9X18
	bool "9x18"
	select NXFONT_X11_MISC_FIXED_9X18
	select NXFONT_X11_MISC_FIXED_9X18B
	---help---
		Enables font ID FONTID_X11_MISC_FIXED_9X18 == 40 and
		bold font ID FONTID_X11_MISC_FIXED_9X18B == 41.

config PDCURSES_FONT_10X20
	bool "10x20"
	select NXFONT_X11_MISC_FIXED_10X20
	---help---
		Enables font ID FONTID_X11_MISC_FIXED_10X20 == 42.

endchoice # TUI Font Selection

config PDCURSES_MONO
	bool
	default n

choice
	prompt "Color Format Selection"
	default PDCURSES_COLORFMT_RGB565

config PDCURSES_COLORFMT_Y1
	bool "BPP=1 Monochrome"
	select PDCURSES_MONO

config PDCURSES_COLORFMT_Y2
	bool "BPP=2 Greyscale"
	select PDCURSES_MONO

config PDCURSES_COLORFMT_Y4
	bool "BPP=4 Greyscale"
	select PDCURSES_MONO

config PDCURSES_COLORFMT_RGB332
	bool "BPP=8 RGB332"

config PDCURSES_COLORFMT_RGB565
	bool "BPP=16 RGB565"

config PDCURSES_COLORFMT_RGB888
	bool "BPP=32 RGB888"

endchoice # Color Format Selection

menu "Initial Screen Color"

config PDCURSES_BGCOLOR_GREYLEVEL
	int "Grey Level"
	default 0
	depends on PDCURSES_MONO

config PDCURSES_BGCOLOR_RED
	int "Red Component"
	default 0
	depends on !PDCURSES_MONO

config PDCURSES_BGCOLOR_GREEN
	int "Green Component"
	default 0
	depends on !PDCURSES_MONO

config PDCURSES_BGCOLOR_BLUE
	int "Blue Component"
	default 0
	depends on !PDCURSES_MONO

endmenu # Initial Screen Color

config PDCURSES_HAVE_INPUT
	bool
	default n

menu "Input Devices"

config PDCURSES_DJOYSTICK
	bool "Discrete Joystick"
	default n
	select PDCURSES_HAVE_INPUT
	depends on DJOYSTICK && !DISABLE_POLL

config PDCURSES_DJOYDEV
	string "Discrete Joystick Device"
	default "/dev/djoy0"
	depends on PDCURSES_DJOYSTICK

config PDCURSES_KEYBOARD
	bool "Discrete Joystick"
	default n
	select PDCURSES_HAVE_INPUT
	depends on USBHOST_HIDKBD && !DISABLE_POLL && EXPERIMENTAL

config PDCURSES_MOUSE
	bool "Discrete Joystick"
	default n
	select PDCURSES_HAVE_INPUT
	depends on MOUSE && !DISABLE_POLL && EXPERIMENTAL

endmenu # Input Devices
```

## graphics/pdcurs34/pdcurses/Kconfig
```kconfig
#
# For a description of the syntax of this configuration file,
# see the file kconfig-language.txt in the NuttX tools repository.
#

config PDCURSES_WIDE
	bool "Wide character support"
	default n
	depends on EXPERIMENTAL

config PDCURSES_FORCE_UTF8
	bool "Force UTF8 character set"
	default n
	depends on PDCURSES_WIDE

config PDCURSES_CHTYPE_LONG
	bool "32-bit chtype"
	default n

config PDCURSES_DEBUG
	bool "Enable pdcurses debug output"
	default n

config PDCURSES_PANEL_DEBUG
	bool "Enable special debug output for panels"
	default n

config PDCURSES_MULTITHREAD
	bool "Enable code for running pdcurses from multiple threads (removes global variables)."
	default n
	---help---
		The base pdcurses code uses global and function static variables,
		preventing multiple tasks from using pdcurses in a FLAT model.
		This option collects all those variables into a thread specific
		dynamically allocated context, enabling multiple tasks to use
		pdcurses concurrently at the cost of a slight execution speed
		penalty for performing per task context lookup.

config PDCURSES_MULTITHREAD_HASH
	bool "Use PID HASH lookup for thread specific pdcurses context data."
	depends on PDCURSES_MULTITHREAD
	default n
	---help---
		Without this option, the per task pdcurses logic uses a linked list
		of allocated contexts, keeping RAM usage to a minimum at the expense
		of execution time for semaphore locking / unlocking and list traversal.
		This option enables a PID hash lookup option which eliminates the
		need for this extra logic by using a statically allocated array of
		context pointers whose size is dictated by the MAX_TASKS config variable.

		Enabling this option allows simple hash calculation and array lookup at
		the expense of extra RAM usage for the static array of context pointers.

config PDCURSES_SHORT_ALTCHARSET
	bool "Allow alternate character set with short 16-bit chtype"
	depends on !PDCURSES_CHTYPE_LONG && !PDCURSES_FORCE_UTF8
	default y
	---help---
		The alternate character set includes graphic line drawing characters
		used for drawing box borders.  When using 16-bit chtype, the base
		pdcurses does not define a bit for A_ALTCHARSET.  This option uses
		the MSB of the 8-bit character code as A_ALTCHARSET to enable line
		drawing characters.

		Enabling this means limiting the usable normal character set to the
		base 7-bit ASCII characters, however for most VT-100 / ANSI emulators,
		the upper bits are either not defined or not critical.
```

## graphics/screenshot/Kconfig
```kconfig
#
# For a description of the syntax of this configuration file,
# see misc/tools/kconfig-language.txt.
#

config GRAPHICS_SCREENSHOT
	bool "TIFF screenshot utility"
	default n
	depends on TIFF && NX
	---help---
		Generate a NX screenshot utility based on the TIFF library.

if GRAPHICS_SCREENSHOT

config SCREENSHOT_WIDTH
	int "Screenshot width (in pixels)"
	default 320
	---help---
		The width of the screenshot in pixels/columns.

config SCREENSHOT_HEIGHT
	int "Screenshot height (in lines)"
	default 240
	---help---
		The height of the screenshot in pixels/rows.

config SCREENSHOT_FORMAT
	int "Screenshot color format"
	default 9
	---help---
		See inlcude/nuttx/fb.h for a list of color formats.  The default
		value of 9 corresponds to FB_FMT_RGB16_565

endif
```

## graphics/slcd/Kconfig
```kconfig
#
# For a description of the syntax of this configuration file,
# see the file kconfig-language.txt in the NuttX tools repository.
#

menuconfig GRAPHICS_SLCD
	bool "Segment LCD Emulaton"
	default n
	select NXWIDGETS
	depends on NX && HAVE_CXX
	---help---
		Enable the CLcd class which implements an NX LCD simulation.

if GRAPHICS_SLCD
endif # GRAPHICS_SLCD
```

## graphics/tiff/Kconfig
```kconfig
#
# For a description of the syntax of this configuration file,
# see the file kconfig-language.txt in the NuttX tools repository.
#

config TIFF
	bool "TIFF file generation library"
	default n
	---help---
		Enable support for the TIFF file generation program.

if TIFF
endif # TIFF
```

## graphics/traveler/Kconfig
```kconfig
#
# For a description of the syntax of this configuration file,
# see the file kconfig-language.txt in the NuttX tools repository.
#

config GRAPHICS_TRAVELER
	tristate "Traveler game"
	default n
	depends on NX || VIDEO_FB
	select FSUTILS_INIFILE
	---help---
		Enable or disable the graphic Traveler game

if GRAPHICS_TRAVELER

choice
	prompt "Video interface"
	default GRAPHICS_TRAVELER_FB if VIDEO_FB
	default GRAPHICS_TRAVELER_NX if !VIDEO_FB

config GRAPHICS_TRAVELER_FB
	bool "Framebuffer Driver"
	depends on VIDEO_FB

config GRAPHICS_TRAVELER_NX
	bool "NX Graphics"
	depends on NX

endchoice # Video interface

if GRAPHICS_TRAVELER_FB

config GRAPHICS_TRAVELER_FBDEV
	string "Framebuffer Device"
	default "/dev/fb0"

endif # GRAPHICS_TRAVELER_FB

if GRAPHICS_TRAVELER_NX

comment "NX Server Configuration Options"

config GRAPHICS_TRAVELER_STACKSIZE
	int "Listener Stack Size"
	default 2048
	---help---
		The stacksize to use when starting the NX listener.  Default 2048

config GRAPHICS_TRAVELER_LISTENERPRIO
	int "Listener Priority"
	default 80
	---help---
		The priority of the event listener thread. Default 100.

config GRAPHICS_TRAVELER_CLIENTPRIO
	int "Client Priority"
	default 100
	---help---
		The client priority.  Default: 100

endif # GRAPHICS_TRAVELER_NX

comment "Color configuration"

choice
	prompt "Color format"
	default GRAPHICS_TRAVELER_RGB16_565

config GRAPHICS_TRAVELER_RGB16_565
	bool "RGB16 565"

config GRAPHICS_TRAVELER_RGB32_888
	bool "RGB32 888 (no transparency)"

endchoice # Color format

config GRAPHICS_TRAVELER_DEFPATH
	string "Default path to world data"
	default "/mnt/world"
	---help---
		This is the default path to the directory where the world file data
		can be found.  The default world file name is transfrom.wld (not
		configurable).

config GRAPHICS_TRAVELER_LIMITFPS
	bool "Limit frame rate"
	default y if ARCH_SIM
	default n if !ARCH_SIM
	---help---
		In the UNLIKELY event that the frame rate is too high, this option
		may to selected to limit the frame rate to upper limit.  This is
		most likely not something that you either want or need to do.
		However, in the special case of the PC-based simulation environment,
		it turns out to be necessary to limit the frame rate in order to
		allow other processing to occur.  This is a consequence of the low
		fidelity timing in the simulation.

config GRAPHICS_TRAVELER_MAXFPS
	int "Max frame rate"
	default 30
	depends on GRAPHICS_TRAVELER_LIMITFPS
	---help---
		if GRAPHICS_TRAVELER_LIMITFPS is selected, then this is the maximum
		frame rate that will be permitted.


config GRAPHICS_TRAVELER_PALRANGES
	bool "Use ranged palette"
	default y
	---help---
		If this option is false, then the whole palette table is loaded from
		the graphics file.  Otherwise, the palette table will be calculated
		from a range table.  Default y, this is a good thing.

comment "Input device selection"

config GRAPHICS_TRAVELER_JOYSTICK
	bool
	default n

choice
	prompt "Input device"
	default GRAPHICS_TRAVELER_AJOYSTICK if AJOYSTICK
	default GRAPHICS_TRAVELER_DJOYSTICK if DJOYSTICK && !AJOYSTICK
	default GRAPHICS_TRAVELER_NX_XYINPUT if GRAPHICS_TRAVELER_NX && NX_XYINPUT && !AJOYSTICK && !DJOYSTICK

config GRAPHICS_TRAVELER_AJOYSTICK
	bool "Analog joystick"
	depends on AJOYSTICK
	select GRAPHICS_TRAVELER_JOYSTICK

config GRAPHICS_TRAVELER_DJOYSTICK
	bool "Discrete joystick"
	depends on DJOYSTICK
	select GRAPHICS_TRAVELER_JOYSTICK

config GRAPHICS_TRAVELER_NX_XYINPUT
	bool "NX X/Y input"
	depends on GRAPHICS_TRAVELER_NX && NX_XYINPUT

endchoice # Input device

if GRAPHICS_TRAVELER_AJOYSTICK || GRAPHICS_TRAVELER_DJOYSTICK

config GRAPHICS_TRAVELER_JOYSTICK_SIGNO
	int "Joystick signal"
	default 13
	---help---
		Signal number used by joystick driver to signal button events.

endif

config GRAPHICS_TRAVELER_JOYDEV
	string "Joystick device name"
	default "/dev/ajoy0" if GRAPHICS_TRAVELER_AJOYSTICK
	default "/dev/djoy0" if GRAPHICS_TRAVELER_DJOYSTICK
	depends on GRAPHICS_TRAVELER_JOYSTICK

comment "Debug options"

config GRAPHICS_TRAVELER_ROMFSDEMO
	bool "Build ROMFS demo world"
	default y
	depends on FS_ROMFS
	---help---
		The traveller code will do nothing unless you also provide a world
		data set for it to work on.  The world/ sub-directory contains a
		demo world suitable for testing.  If this option is selected, then
		the demo world is build as a mountable ROMFS file system.  This new
		function is then exported that can be used to mount the demo world:

			int trv_mount_world(int minor, FAR const char *mountpoint)

		This function must be called somewhere in your board-specific start-
		up logic in order to mount the world at 'mountpoint'

config GRAPHICS_TRAVELER_PERFMON
	bool "Performance monitor"
	default y
	---help---
		Enable or disable performance monitoring instrumentation and output.

config GRAPHICS_TRAVELER_DEBUG_LEVEL
	int "Debug output level"
	default 0
	range 0 3
	---help---
		DEBUG_LEVEL == 3 turns off sound and video and enables verbose debug
			messages on stdout.
		DEBUG_LEVEL == 2 turns off sound and video and enables normal debug
			output
		DEBUG_LEVEL == 1 turns off sound and enables normal debug output
		OTHERWISE, all debugging features are disabled.

endif # GRAPHICS_TRAVELER
```

## graphics/traveller/Kconfig
```kconfig
#
# For a description of the syntax of this configuration file,
# see misc/tools/kconfig-language.txt.
#

config GRAPHICS_TRAVELER
	bool "Traveller game"
	default n
	select SYSTEM_INIFILE
	---help---
		Enable or disable the graphic Traveller game

if GRAPHICS_TRAVELER

config GRAPHICS_TRAVELER_DEBUG_LEVEL
	int "Debug output level"
	default 0
	range 0 3
	---help---
		DEBUG_LEVEL == 3 turns off sound and video and enables verbose debug
			messages on stdout.
		DEBUG_LEVEL == 2 turns off sound and video and enables normal debug
			output
		DEBUG_LEVEL == 1 turns off sound and enables normal debug output
		OTHERWISE, all debugging features are disabled.

endif # GRAPHICS_TRAVELER
```
