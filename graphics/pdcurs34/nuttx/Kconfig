## graphics/twm4nx/Kconfig
```kconfig
#
# For a description of the syntax of this configuration file,
# see the file kconfig-language.txt in the NuttX tools repository.
#

menuconfig GRAPHICS_TWM4NX
	tristate "Minimal Tom's Window Manager (TWM) for NuttX (Twm4Nx)"
	default n
	select NX_RAMBACKED
	select NXWIDGETS
	depends on NX && HAVE_CXX
	---help---
		Enable Tom's Window Manager (TWM) for NuttX (Twm4Nx).

		Use of this window manager requires keyboard and mouse input.
		Output is through the NX server.

if GRAPHICS_TWM4NX

comment "Twm4Nx Core Configuration"

config TWM4NX_PROGNAME
	string "Twm4Nx program name"
	default "twm4nx"
	---help---
		This is the name of the program that will be used when the NSH ELF
		program is installed.

config TWM4NX_PRIORITY
	int "Twm4Nx task priority"
	default 100

config TWM4NX_STACKSIZE
	int "Twm4Nx stack size"
	default DEFAULT_TASK_STACKSIZE

config TWM4NX_REVMAJOR
	string "Twm4Nx major version number"
	default "0"

config TWM4NX_REVMINOR
	string "Twm4Nx minor version number"
	default "0"

config TWM4NX_ARCHINIT
	bool "Have architecture-specific initialization"
	default n
	select BOARDCTL
	depends on !NSH_ARCHINIT
	---help---
		Set if your board provides architecture specific initialization
		via the board-interface function boardctl().  The boardctl()
		function will be called early in Twm4Nx initialization to allow
		board logic to do such things as configure MMC/SD slots.

config TWM4NX_NETINIT
	bool "Network initialization"
	default y
	depends on NET
	select NETUTILS_NETINIT
	depends on !NSH_NETINIT
	---help---
		This option enables/disables all network initialization in Twm4Nx.

config TWM4NX_VNCSERVER
	bool "Use VNC Server"
	default y
	depends on VNCSERVER
	select TWM4NX_NOKEYBOARD
	select TWM4NX_NOMOUSE
	---help---
		If selected, then keyboard and positional input will come from the
		VNC server.  In this case all other input settings are ignored.

config TWM4NX_NOKEYBOARD
	bool "Disable keyboard"
	default n
	---help---
		Normally you would never disable keyboard input.  That would make
		using many Twm4Nx applications impossible.  However, this setting
		is sometimes useful for debugging Twm4Nx bringup in a simpler
		environment (it is also used if VNC is selected)

config TWM4NX_NOMOUSE
	bool "Disable mouse/touchscreen"
	default n
	---help---
		Normally you would never disable mouse input.  That would make using
		Twm4Nx impossible.  However, this setting is sometimes useful for
		debugging Twm4Nx bring-up in a simpler environment (it is also used
		if VNC is selected)

choice
	prompt "Position device"
	default TWM4NX_MOUSE
	depends on !TWM4NX_NOMOUSE

config TWM4NX_MOUSE
	bool "Mouse"
	select NX_SWCURSOR

config TWM4NX_TOUCHSCREEN
	bool "Touchscreen"

endchoice # Position device

config TWM4NX_MOUSE_DEVPATH
	string "Path to input device"
	default "/dev/mouse0" if TWM4NX_MOUSE
	default "/dev/input0" if TWM4NX_TOUCHSCREEN

config TWM4NX_KEYBOARD_DEVPATH
	string "Patch to keyboard input device"
	default "/dev/kbd0"
	depends on !TWM4NX_NOKEYBOARD

choice
	prompt "Twm4Nx Theme"
	default TWM4NX_CLASSIC

config TWM4NX_CLASSIC
	bool "Classic"
	---help---
		Strong bordered windows with dark primary colors.  Reminiscent of
		Windows 98.

config TWM4NX_CONTEMPORARY
	bool "Contemporary"
	---help---
		Border-less windows in pastel shades for a more contemporary look.

endchoice # Twm4Nx Theme

config TWM4NX_ICONMGR_NCOLUMNS
	int "Icon Manager columns"
	default 4
	---help---
		The number of buttons in one row of the Icon Manager.

config TWM4NX_DEBUG
	bool "Force debug output"
	default n
	depends on DEBUG_FEATURES
	---help---
		This option will force graphics debug output for Twm4Nx even if
		graphics debug output is not enabled.  This is useful for very low
		level debug of the Twm4Nx logic without interfering output from
		other graphics components.

		NOTE: The level of this Twm4Nx debug is still controlled by the
		basic debug output settings CONFIG_DEBUG_INFO, CONFIG_DEBUG_WARN,
		and CONFIG_DEBUG_ERROR (but not the corresponding
		CONFIG_DEBUG_GRAPHICS_* settings)

source "$APPSDIR/graphics/twm4nx/apps/Kconfig"

endif # GRAPHICS_TWM4NX
```

## graphics/twm4nx/apps/Kconfig
```kconfig
#
# For a description of the syntax of this configuration file,
# see the file kconfig-language.txt in the NuttX tools repository.
#

comment "Twm4Nx Applications"

config TWM4NX_CALIBRATION
	bool "Touchscreen"
	default y
	depends on TWM4NX_TOUCHSCREEN
	---help---
		Enable support for the touchscreen calibration display.

if TWM4NX_CALIBRATION

config TW4NX_STARTUP_CALIB
	bool "Calibrate on startup"
	default n
	---help---
		Bring up the calibration display automatically on startup.  This
		option is necessary if no stored calibration data is provided and
		the window manager is not usable without calibration.  Otherwise,
		calibration can be performed later via the Twm4Nx main menu.

endif # TWM4NX_CALIBRATION

config TWM4NX_NXTERM
	bool "NxTerm Window"
	default y
	depends on NXTERM && NSH_LIBRARY
	---help---
		Enable support for the NxTerm window which provides a text window
		in which you can interact with NSH.

if TWM4NX_NXTERM
endif # TWM4NX_NXTERM

config TWM4NX_CLOCK
	bool "Retro segment LCD clock"
	default y
	select GRAPHICS_SLCD
	---help---
		Enable support for the LCD clock window based on the retro segment
		LCD driver of apps/graphics/slcd.

if TWM4NX_CLOCK

config TWM4NX_CLOCK_HEIGHT
	int "LCD clock height"
	default 64
	---help---
		Fixed height of the LCD clock.  The clock window is not re-sizeable.

endif # TWM4NX_CLOCK
```

## ieee802154/Kconfig
```kconfig
#
# For a description of the syntax of this configuration file,
# see misc/tools/kconfig-language.txt.
#

source "$APPSDIR/ieee802154/common/Kconfig"
source "$APPSDIR/ieee802154/coord/Kconfig"
source "$APPSDIR/ieee802154/i8sak/Kconfig"
```

## industry/abnt_codi/Kconfig
```kconfig
#
# For a description of the syntax of this configuration file,
# see the file kconfig-language.txt in the NuttX tools repository.
#

config INDUSTRY_ABNT_CODI_LIB
	bool "ABNT CODI Library"
	default n
	---help---
		Enable or disable the ABNT CODI Library
```

## industry/foc/Kconfig
```kconfig
#
# For a description of the syntax of this configuration file,
# see the file kconfig-language.txt in the NuttX tools repository.
#

config INDUSTRY_FOC
	bool "FOC Library"
	default n
	select LIBDSP
	---help---
		Enable or disable the FOC Library

if INDUSTRY_FOC

config INDUSTRY_FOC_CORDIC
	bool "Enable CORDIC support"
	default n
	---help---
		Enable support for CORDIC hardware acceleration

if INDUSTRY_FOC_CORDIC

config INDUSTRY_FOC_CORDIC_DEVPATH
	string "CORDIC device path"
	default "/dev/cordic0"

config INDUSTRY_FOC_CORDIC_ANGLE
	bool "Enable CORDIC for phase angle"
	default n

config INDUSTRY_FOC_CORDIC_DQSAT
	bool "Enable CORDIC for dq saturation"
	default n

endif # INDUSTRY_FOC_CORDIC

config INDUSTRY_FOC_FIXED16
	bool "Enable support for fixed16"
	default n
	---help---
		Enable support for FOC fixed16 calculations

config INDUSTRY_FOC_FLOAT
	bool "Enable support for float"
	default n
	---help---
		Enable support for FOC float calculations

config INDUSTRY_FOC_HANDLER_PRINT
	bool "FOC handler state printer"
	default n
	---help---
		Enable support for FOC handler state printer

config INDUSTRY_FOC_ANGLE_OPENLOOP
	bool "FOC angle open-loop handler"
	default y
	---help---
		Enable support for open-loop angle handler

config INDUSTRY_FOC_ANGLE_OSMO
	bool "Enable slidmode angle observer"
	default n
	---help---
		Enable support for SMO observer handler

config INDUSTRY_FOC_ANGLE_ONFO
	bool "Enable fluxlink angle observer"
	default n
	---help---
		Enable support for NFO observer handler

config INDUSTRY_FOC_ANGLE_QENCO
	bool "FOC angle quadrature encoder handler"
	default n
	depends on SENSORS_QENCODER
	---help---
		Enable support for quadrature encoder angle handler

config INDUSTRY_FOC_ANGLE_HALL
	bool "FOC angle 3-phase hall handler"
	default n
	depends on SENSORS_HALL3PHASE
	---help---
		Enable support for 3-phase hall sensor angle handler

if INDUSTRY_FOC_ANGLE_HALL

choice
	prompt "FOC Hall sensor type"
	default INDUSTRY_FOC_ANGLE_HALL_120DEG

config INDUSTRY_FOC_ANGLE_HALL_120DEG
	bool "Hall sensor 120 deg"

config INDUSTRY_FOC_ANGLE_HALL_60DEG
	bool "Hall sensor 60 deg (not tested)"

endchoice # FOC Hall sensor type

config INDUSTRY_FOC_ANGLE_HALL_EST
	bool "FOC Hall angle estimation"
	default n

endif # INDUSTRY_FOC_ANGLE_HALL

config INDUSTRY_FOC_CONTROL_PI
	bool "FOC PI controller"
	default y
	---help---
		Enable support for classic FOC PI controller

config INDUSTRY_FOC_MODULATION_SVM3
	bool "FOC SVM3 modulation"
	default y
	---help---
		Enable support for FOC 3-phase space vector modulation

config INDUSTRY_FOC_MODEL_PMSM
	bool "FOC PMSM model support"
	select INDUSTRY_FOC_HAVE_MODEL
	default n
	---help---
		Enable support for PMSM model

config INDUSTRY_FOC_HAVE_MODEL
	bool
	default n

config INDUSTRY_FOC_ALIGN
	bool "FOC sensor alignment routine"
	default n
	---help---
		Enable support for angle sensor alignment routine (zero offset + direction)

if INDUSTRY_FOC_ALIGN

config INDUSTRY_FOC_ALIGN_INDEX
	bool "FOC alignment index search support"
	default n
	---help---
		Enable support for sensor alignment index search

endif # INDUSTRY_FOC_ALIGN

config INDUSTRY_FOC_IDENT
	bool "FOC motor identification routine"
	default n
	---help---
		Enable support for motor identification routine (phase resistance and phase inductance)

if INDUSTRY_FOC_IDENT

config INDUSTRY_FOC_IDENT_FLUX
	bool "FOC flux linkage identification support"
	default n
	---help---
		Enable support for flux linkage identification

endif # INDUSTRY_FOC_IDENT

config INDUSTRY_FOC_VELOCITY_ODIV
	bool "FOC velocity DIV observer"
	default n
	---help---
		Enable support for the velocity DIV observer

config INDUSTRY_FOC_VELOCITY_OPLL
	bool "FOC velocity PLL observer"
	default n
	---help---
		Enable support for the velocity PLL observer

endif
```
