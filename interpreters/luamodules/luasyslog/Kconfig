## interpreters/luamodules/luasyslog/Kconfig
```kconfig
#
# For a description of the syntax of this configuration file,
# see the file kconfig-language.txt in the NuttX tools repository.
#

config LUA_LSYSLOG_MODULE
	bool "Lua syslog module"
	default n
	depends on INTERPRETERS_LUA
	---help---
		LUA syslog module

if LUA_LSYSLOG_MODULE

config LUA_LSYSLOG_VERSION
	string "lsyslog version"
	default "2.0.1"
	---help---
		Lua lsyslog module release version to fetch and build.

endif # LUA_LSYSLOG_MODULE
```

## interpreters/luamodules/luv/Kconfig
```kconfig
#
# For a description of the syntax of this configuration file,
# see the file kconfig-language.txt in the NuttX tools repository.
#

config LUA_LUV_MODULE
	bool "Lua Luv module"
	default n
	depends on INTERPRETERS_LUA && LIBUV
	depends on LIBC_EXECFUNCS
	depends on LIBC_NETDB
	depends on NET
	depends on NETDEV_IFINDEX
	depends on NET_SOCKOPTS
	depends on NET_TCP
	depends on NET_UDP
	depends on PSEUDOFS_SOFTLINKS
	depends on SCHED_HAVE_PARENT
	---help---
		Bare libuv bindings for Lua

if LUA_LUV_MODULE

config LUA_LUV_VERSION
	string "Luv version"
	default "1.44.2-1"
	---help---
		Luv release version to fetch and build.

endif # LUA_LUV_MODULE
```

## interpreters/micropython/Kconfig
```kconfig
#
# For a description of the syntax of this configuration file,
# see the file kconfig-language.txt in the NuttX tools repository.
#

menuconfig INTERPRETERS_MICROPYTHON
	tristate "Micropython Interpreter"
	default n
  select SERIAL_TERMIOS
  select ARCH_SETJMP_H

if INTERPRETERS_MICROPYTHON

config INTERPRETERS_MICROPYTHON_PRIORITY
	int "Micropython interpreter priority"
	default 100

config INTERPRETERS_MICROPYTHON_STACKSIZE
	int "Micropython interpreter stack size"
	default 8192

config INTERPRETERS_MICROPYTHON_HEAPSIZE
	int "Micropython interpreter default heap size"
	default 65536
	---help---
	Default heapsize of Micropython. Heapsize can be overriden on the command line.


config INTERPRETERS_MICROPYTHON_SOCKET
  bool "Enable Micropython sockets"
  default n

config INTERPRETERS_MICROPYTHON_USSL
  bool "Enable Micropython encryption"
  default n

if INTERPRETERS_MICROPYTHON_USSL

config INTERPRETERS_MICROPYTHON_MBEDTLS
  bool "Switch to MBEDTLS library for Micropython encryption"
  default n
  ---help---
    By default Micropython uses the AXTLS library uses less code space but
    does not support all modern algorithms
    The MBEDTLS library supports more algorithms but takes lots of code space

endif # INTERPRETERS_MICROPYTHON_USSL

endif # INTERPRETERS_MICROPYTHON
```

## interpreters/minibasic/Kconfig
```kconfig
#
# For a description of the syntax of this configuration file,
# see the file kconfig-language.txt in the NuttX tools repository.
#

config INTERPRETERS_MINIBASIC
	tristate "Mini Basic Interpreter support"
	default n
	select LIBC_FLOATINGPOINT
	---help---
		This is a Basic interpreter written by Malcolm McLean

		NOTE: This interpreter requires a usable math.h header file.  By
		default, the math library (and hence, math.h) are not provided by
		NuttX.  Therefore, when the Basic code includes math.h it will
		either fail to find the math.h header file or, worse, will take an
		incompatible version of math.h from your toolchain.  The toolchain's
		version of math.h will be incompatible because it will have been
		implemented to work with a different version of the C library.

		Normally, developers will use an optimized math library for their
		processor architecture and do the following:

		- Save a customized copy of math.h from your tool chain in
		  nuttx/arch/<arch>/include
		- Set CONFIG_ARCH_MATH_H=y in your .config file to select this
		  architecture-specific math.h header file.

		An option is to use the built-in, generic, unoptimized NuttX math
		library that is selected by simply by:

		- Set CONFIG_LIBM=y in your .config file

if INTERPRETERS_MINIBASIC

config INTERPRETER_MINIBASIC_PRIORITY
	int "Basic interpreter priority"
	default 100
	---help---
		Task priority of the Basic interpreter main task

config INTERPRETER_MINIBASIC_STACKSIZE
	int "Basic interpreter stack size"
	default 4096
	---help---
		Size of the stack allocated for the Basic interpreter main task

config INTERPRETER_MINIBASIC_IOBUFSIZE
	int "I/O buffer size"
	default 1024
	---help---
		Size of the statically allocated I/O buffer.

config INTERPRETER_MINIBASIC_TESTSCRIPT
	bool "Test script"
	default n
	---help---
		By default, the path to a basic program must provided on the command
		line.  It this option is selected, then a built-in, canned script is
		enabled and will be used if no path is provided on the command line.
		This canned script can be used for testing purposes.

endif
```

## interpreters/mquickjs/Kconfig
```kconfig
#
# For a description of the syntax of this configuration file,
# see the file kconfig-language.txt in the NuttX tools repository.
#

config INTERPRETERS_MQJS
	tristate "MicroQuickJS JavaScript interpreter"
	default n

if INTERPRETERS_MQJS

config INTERPRETERS_MQJS_PRIORITY
	int "MicroQuickJS interpreter priority"
	default 100
	---help---
		Task priority of the MicroQuickJS interpreter.

 config INTERPRETERS_MQJS_STACKSIZE
 	int "MicroQuickJS interpreter stack size"
 	default 8192
 	---help---
 		Size of the stack allocated for MicroQuickJS interpreter.

 endif # INTERPRETERS_MQJS
```

## interpreters/pcode/Kconfig
```kconfig
config INTERPRETERS_PCODE
	bool "Pascal p-code interpreter"
	default n
	---help---
		Enable support for the Pascal p-code interpreter.  See the README.txt
		file at located in the NuttX Pascal repository and also the
		README.txt file in the apps/interpreter directory. Use of this
		configuration implies that you have performed the required
		installation of the Pascal run-time code.

if INTERPRETERS_PCODE
endif
```

## interpreters/prun/Kconfig
```kconfig
#
# For a description of the syntax of this configuration file,
# see misc/tools/kconfig-language.txt.
#

config INTERPRETERS_PRUN
	bool "Pascal P-Code interpreter"
	default n
	depends on INTERPRETERS_PCODE
	---help---
		Build the Pascal P-Code interpreter / Virtual machine

if INTERPRETERS_PRUN
endif
```

## interpreters/python/Kconfig
```kconfig
#
# For a description of the syntax of this configuration file,
# see the file kconfig-language.txt in the NuttX tools repository.
#

config INTERPRETERS_CPYTHON
	tristate "CPython"
	depends on LIB_ZLIB
	depends on !LIBC_DLFCN || LIB_LIBFFI
	depends on EXPERIMENTAL
	default n
	---help---
		Enable the CPython port to NuttX. This is a port of the Python
		interpreter to NuttX. Initially, it is tweaked to work with the
		RISC-V QEMU virtual board (`rv-virt`).

if INTERPRETERS_CPYTHON

config INTERPRETERS_CPYTHON_VERSION
	string "Python Version"
	default "3.13.0"

config INTERPRETERS_CPYTHON_STACKSIZE
	int "CPython stack size"
	default 307200
	---help---
		This is the stack size allocated when the CPython task runs.

config INTERPRETERS_CPYTHON_PRIORITY
	int "CPython task priority"
	default 100
	---help---
		This is the priority of the CPython task.

config INTERPRETERS_CPYTHON_PROGNAME
	string "CPython name"
	default "python"
	---help---
		This is the name of the program that will be used from the nsh.

config INTERPRETERS_CPYTHON_ENABLE_PIP
	bool "Enable bundled pip"
	default n
	---help---
		Enable bundling pip into the CPython module image. When enabled, the
		build downloads the pip wheel and pre-installs it through a
		site-packages .pth entry that points to ensurepip's bundled wheel.
		Disable this to skip pip wheel download/integration entirely.


config INTERPRETERS_CPYTHON_PYTHONPATH
	string "CPython Python path"
	default "/tmp"
	---help---
		This is the Python default search path for modules files. This is
		required to be a writable path.

endif
```

## interpreters/quickjs/Kconfig
```kconfig
#
# For a description of the syntax of this configuration file,
# see the file kconfig-language.txt in the NuttX tools repository.
#

config INTERPRETERS_QUICKJS
	tristate "QuickJS JavaScript interpreter"
	default n

if INTERPRETERS_QUICKJS

choice
	prompt "QuickJS command line interpreter"
	default INTERPRETERS_QUICKJS_NONE

config INTERPRETERS_QUICKJS_NONE
	bool "distable quickjs interpreter"

config INTERPRETERS_QUICKJS_MINI
	bool "Minimal quickjs interpreter"

config INTERPRETERS_QUICKJS_FULL
	bool "normal quickjs interpreter"

endchoice # QuickJS command line interpreter

config INTERPRETERS_QUICKJS_BIGNUM
	bool "Bignum support"
	default n
	---help---
		It's depend on libatomic,
		Not all platform support it.

config INTERPRETERS_QUICKJS_PRIORITY
	int "QuickJS interpreter priority"
	default 100

config INTERPRETERS_QUICKJS_STACKSIZE
	int "QuickJS interpreter stack size"
	default 8192

config INTERPRETERS_QUICKJS_EXT_HOOK
	bool "External init/destory hook"
	default n
	depends on INTERPRETERS_QUICKJS_MINI
	---help---
		Since minimal interpreter only support 'console.log',
		you can export custom module by implement init/destory hook.

endif # INTERPRETERS_QUICKJS
```

## interpreters/toywasm/Kconfig
```kconfig
#
# For a description of the syntax of this configuration file,
# see the file kconfig-language.txt in the NuttX tools repository.
#

config INTERPRETERS_TOYWASM
	tristate "Toywasm Webassembly Runtime"
	default n

	# TOYWASM_ENABLE_WASM_THREADS and TOYWASM_ENABLE_WASI_THREADS
	# depends on pthread
	# REVISIT: make these Kconfig
	depends on !DISABLE_PTHREAD

if INTERPRETERS_TOYWASM

config INTERPRETERS_TOYWASM_PRIORITY
	int "Toywasm cli priority"
	default 100

config INTERPRETERS_TOYWASM_STACKSIZE
	int "Toywasm cil stack size"
	default DEFAULT_TASK_STACKSIZE

endif
```
