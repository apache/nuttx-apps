## interpreters/wamr/Kconfig
```kconfig
#
# For a description of the syntax of this configuration file,
# see the file kconfig-language.txt in the NuttX tools repository.
#

config INTERPRETERS_WAMR
	tristate "Webassembly Micro Runtime"
	default n

if INTERPRETERS_WAMR

config INTERPRETERS_WAMR_VERSION
	string "WAMR Version"
	default "WAMR-2.1.0"
	---help---
		Version WAMR-09-29-2020 and later (include main) supported.

config INTERPRETERS_IWASM_TASK
	bool "Webassembly iwasm task"
	default y

if INTERPRETERS_IWASM_TASK

config INTERPRETERS_WAMR_PRIORITY
	int "Webassembly Micro Runtime priority"
	default 100

config INTERPRETERS_WAMR_STACKSIZE
	int "Webassembly Micro Runtime stack size"
	default 8192

endif # INTERPRETERS_IWASM_TASK

config INTERPRETERS_WAMR_AOT
	bool "Enable AOT"
	select ARCH_USE_TEXT_HEAP if ARCH_HAVE_TEXT_HEAP
	default n

config INTERPRETERS_WAMR_AOT_QUICK_ENTRY
	bool "Enable AOT quick entry"
	default n
	depends on INTERPRETERS_WAMR_AOT
	---help---
		Note: This option only works with WAMR 1.3.1 or later.
		Enable AOT quick entry to improve performance for call
		AOTed function from host side in some cases with simple
		signature.
		Enable this option will increase the size of runtime, ~8KB.

config INTERPRETERS_WAMR_AOT_STACK_FRAME
	bool "Enable AOT stack frame"
	default n
	depends on INTERPRETERS_WAMR_AOT

config INTERPRETERS_WAMR_AOT_WORD_ALIGN_READ
	bool "Make WAMR AOT loader use word-aligned read"
	default y if ARCH_HAVE_TEXT_HEAP_WORD_ALIGNED_READ
	default n

config INTERPRETERS_WAMR_MEM_DUAL_BUS_MIRROR
	bool "Make WAMR AOT loader aware of separate instruction/data memory mapping"
	default y if ARCH_HAVE_TEXT_HEAP_SEPARATE_DATA_ADDRESS
	default n

choice
	prompt "Enable interpreter"
	default INTERPRETERS_NONE

config INTERPRETERS_WAMR_FAST
	bool "Enable fast interpreter"

config INTERPRETERS_WAMR_CLASSIC
	bool "Enable classic interpreter"

config INTERPRETERS_NONE
	bool "Disable interpreter"

endchoice # Enable interpreter

config INTERPRETERS_WAMR_DEBUG_AOT
	bool "Enable debugger support for AOT modules"
	default n
	depends on INTERPRETERS_WAMR_AOT

config INTERPRETERS_WAMR_DEBUG_INTERP
	bool "Enable debugger support in the interpreter"
	default n
	# Note: It only works with the classic interpreter
	depends on INTERPRETERS_WAMR_CLASSIC
	# Note: It uses thread-manager internally
	depends on INTERPRETERS_WAMR_THREAD_MGR
	# Note: It sets up the listening socket with SO_LINGER
	depends on NET_TCP
	depends on NET_SOLINGER

config INTERPRETERS_WAMR_LOG
	bool "Enable log"
	default n

config INTERPRETERS_WAMR_LIBC_BUILTIN
	bool "Enable built-in libc"
	default n

config INTERPRETERS_WAMR_BUILD_MODULES_FOR_NUTTX
	bool "Build WASM modules for NuttX system interface (Experimental)"
	default n
	depends on INTERPRETERS_WAMR_LIBC_BUILTIN

config INTERPRETERS_WAMR_LIBC_WASI
	bool "Enable WASI libc"
	select PSEUDOFS_SOFTLINKS
	default n
	---help---
		Note: As of writing this, this works only with main branch of
		wasm-micro-runtime.
		I.e. INTERPRETERS_WAMR_VERSION="main"

		Note: As of writing this, most of the filesystem operations are
		not implemented. (Mainly because of lack of openat family of
		the API in NuttX.)

config INTERPRETERS_WAMR_MULTI_MODULE
	bool "Enable multi module support"
	default n

config INTERPRETERS_WAMR_MINILOADER
	bool "Enable mini-loader"
	default n
	---help---
		Mini-loader don't check the integrity of wasm module

config INTERPRETERS_WAMR_REF_TYPES
	bool "Enable reference types support"
	default n

config INTERPRETERS_WAMR_GC
	bool "Enable GC support"
	default n

config INTERPRETERS_WAMR_ENABLE_SPEC_TEST
	bool "Enable spectest support"
	default n

config INTERPRETERS_WAMR_TAIL_CALL
	bool "Enable tail call support"
	default n
	---help---
		This only available for WAMR 1.3.0 later (don't include 1.3.0)

config INTERPRETERS_WAMR_STACK_GUARD_SIZE
	int "Custom stack guard size"
	default 1024
	---help---
		Reserve some space in stack as guard to detect stack overflow.

		Please consider this extra stack consumption when deciding the stack
		size of your NuttX task on which you run WAMR.

		The default value here (1024) was chosen to match the default value on
		the majority of other platforms, including Linux. It also matches
		the expections in the WAMR AoT compiler.
		On the other hand, it might be a bit larger than what's strictly
		necessary, especially for typical NuttX targets.

config INTERPRETERS_WAMR_THREAD_MGR
	bool "Enable thread manager"
	default n

config INTERPRETERS_WAMR_LIB_WASI_THREADS
	bool "Enable wasi-threads"
	default n
	---help---
		See https://github.com/bytecodealliance/wasm-micro-runtime/blob/main/doc/pthread_impls.md

config INTERPRETERS_WAMR_LIB_PTHREAD
	bool "Enable lib pthread (legacy)"
	default n
	---help---
		See https://github.com/bytecodealliance/wasm-micro-runtime/blob/main/doc/pthread_impls.md

config INTERPRETERS_WAMR_LIB_PTHREAD_SEMAPHORE
	bool "Enable semaphore"
	depends on INTERPRETERS_WAMR_LIB_PTHREAD
	default n

config INTERPRETERS_WAMR_SHARED_MEMORY
	bool "Enable shared memory"
	default n

config INTERPRETERS_WAMR_BULK_MEMORY
	bool "Enable bluk memory"
	default n

config INTERPRETERS_WAMR_ENABLE_EXCE_HANDLING
	bool "Enable exception-handling"
	default n

config INTERPRETERS_WAMR_PERF_PROFILING
	bool "Enable performance profiling"
	default n

config INTERPRETERS_WAMR_MEMORY_PROFILING
	bool "Enable memory profiling"
	default n

config INTERPRETERS_WAMR_MEMORY_TRACING
	bool "Enable memory tracing"
	default n

config INTERPRETERS_WAMR_DUMP_CALL_STACK
	bool "Enable dump call stack (on exception)"
	default n

config INTERPRETERS_WAMR_DISABLE_HW_BOUND_CHECK
	bool "Disable hardware bound check"
	default y
	---help---
		This option is currently a no-op because
		NuttX doesn't have necessary functionalities.
		That is, regardless of this setting, WAMR's HW bounds
		check is not available for NuttX.

config INTERPRETERS_WAMR_LOAD_CUSTOM_SECTIONS
	bool "Enable load custom section support"
	default n

config INTERPRETERS_WAMR_CUSTOM_NAME_SECTIONS
	bool "Enable custom name section support"
	default n

config INTERPRETERS_WAMR_GLOBAL_HEAP_POOL
	bool "Enable global heap pool"
	default n

if INTERPRETERS_WAMR_GLOBAL_HEAP_POOL

config INTERPRETERS_WAMR_GLOBAL_HEAP_POOL_SIZE
	int "Global heap pool size (in KB)"
	default 128

endif # INTERPRETERS_WAMR_GLOBAL_HEAP_POOL

config INTERPRETERS_WAMR_CONFIGUABLE_BOUNDS_CHECKS
	bool "Configuable bounds checks"
	default n
	---help---
		Bounds checks enabled by default. With this option, you can
		disable bounds checks passing --disable-bounds-checks to
		iwasm.

config INTERPRETERS_WAMR_EXTERNAL_MODULE_REGISTRY
	bool "Enable external module registry"
	default n
	---help---
		This option enables the support for loading WASM modules from
		external libraries, which is useful when you want to extend the
		functionality of WAMR without modifying its source code.

endif
```

## interpreters/wasm3/Kconfig
```kconfig
#
# For a description of the syntax of this configuration file,
# see the file kconfig-language.txt in the NuttX tools repository.
#

config INTERPRETERS_WASM3
	tristate "WASM3 Webassembly Runtime"
	default n

if INTERPRETERS_WASM3

config INTERPRETERS_WASM3_PRIORITY
	int "WASM3 Webassembly priority"
	default 100

config INTERPRETERS_WASM3_STACKSIZE
	int "WASM3 Webassembly stack size"
	default DEFAULT_TASK_STACKSIZE

config INTERPRETERS_WASM3_CODEPAGE
	int "WASM3 code page align size"
	default 512

config INTERPRETERS_WASM3_FIXEDHEAP
	int "WASM3 Fixed heap size"
	default 0
	---help---
	0 : Use malloc/free instead of internal heap

config INTERPRETERS_WASM3_LOG
	bool "WASM3 log"
	default n

if INTERPRETERS_WASM3_LOG

config INTERPRETERS_WASM3_LOG_VERBOSE
	bool "WASM3 log verbose"
	default n

endif

endif
```

## logging/nxscope/Kconfig
```kconfig
#
# For a description of the syntax of this configuration file,
# see the file kconfig-language.txt in the NuttX tools repository.
#

config LOGGING_NXSCOPE
	bool "NxScope interface"
	default n

if LOGGING_NXSCOPE

config LOGGING_NXSCOPE_INTF_SERIAL
	bool "NxScope serial port interface support"
	default n
	---help---
		For details, see logging/nxscope/nxscope_iserial.c

config LOGGING_NXSCOPE_INTF_DUMMY
	bool "NxScope dummy interface support"
	default n
	---help---
		Useful for debug purposes. For details, see logging/nxscope/nxscope_idummy.c

config LOGGING_NXSCOPE_PROTO_SER
	bool "NxScope default serial protocol support"
	default y
	---help---
		For frame details, see logging/nxscope/nxscope_pser.c

config LOGGING_NXSCOPE_DIVIDER
	bool "NxScope support for samples divider"
	default n
	---help---
		This option enables interface that allows you to reduce
		the rate of samples written to the stream buffer.

config LOGGING_NXSCOPE_ACKFRAMES
	bool "NxScope support for ACK frames"
	default n
	---help---
		This option enables ACK frames for set requests

config LOGGING_NXSCOPE_USERTYPES
	bool "NxScope support for user types"
	default n
	---help---
		This option enables user-defined frames (see enum nxscope_hdr_id_e)

config LOGGING_NXSCOPE_CRICHANNELS
	bool "NxScope support for critical channels"
	default n
	---help---
		Enable the support for non-buffered critical channels

config LOGGING_NXSCOPE_DISABLE_PUTLOCK
	bool "NxScope disable lock in channels put interfaces"
	default n
	---help---
		This option disables lock in channels put interfaces.
		In that case, the user is responsible for ensuring
		thread-safe operations with nxscope_lock/nxscope_unlock functions.

endif # LOGGING_NXSCOPE
```

## lte/alt1250/Kconfig
```kconfig
#
# For a description of the syntax of this configuration file,
# see the file kconfig-language.txt in the NuttX tools repository.
#

config LTE_ALT1250
	tristate "ALT1250 usrsock daemon"
	default n
	depends on NET_USRSOCK && MODEM_ALT1250
	select NET_USRSOCK_TCP
	select NET_USRSOCK_ICMP
	select PIPES
	select NET_USRSOCK_OTHER
	---help---
		Enable support for the alt1250 usrsock daemon

if LTE_ALT1250
config LTE_ALT1250_PROGNAME
	string "alt1250 program name"
	default "alt1250"

config LTE_ALT1250_PRIORITY
	int "alt1250 task priority"
	default 100

config LTE_ALT1250_STACKSIZE
	int "alt1250 stack size"
	default 2048

config LTE_ALT1250_ENABLE_HIBERNATION_MODE
	bool "Enable LTE hibernation mode"
	default n
	depends on PM
	---help---
		Enable LTE hibernation mode to reduce current
		consumption during communication standby.

menu "SMS configuration"

config LTE_ALT1250_SMS_TOA
	bool "Configure type of address of destination address"
	default n
	---help---
		Change the type of address of the destination address.

choice
	prompt "Configure Nature of Address Indicator"
	depends on LTE_ALT1250_SMS_TOA

config LTE_ALT1250_SMS_NAI_UNKNOWN
	bool "Unkown"

config LTE_ALT1250_SMS_NAI_INTERNATIONAL
	bool "International number"

config LTE_ALT1250_SMS_NAI_NATIONAL
	bool "National number"

config LTE_ALT1250_SMS_NAI_NETWORK_SPEC
	bool "Network specific number"

config LTE_ALT1250_SMS_NAI_SUBSCRIBER
	bool "Subscriber number"

config LTE_ALT1250_SMS_NAI_ALPANUMERIC
	bool "Alphanumeric"

config LTE_ALT1250_SMS_NAI_ABBREVIATED
	bool "Abbreviated number"

config LTE_ALT1250_SMS_NAI_RESERVED
	bool "Reserved for extension"

endchoice # Configure Nature of Address Indicator

choice
	prompt "Configure Numbering Plan Indicator"
	depends on LTE_ALT1250_SMS_TOA

config LTE_ALT1250_SMS_NPI_UNKNOWN
	bool "Unkown"

config LTE_ALT1250_SMS_NPI_ISDN
	bool "ISDN/telephone numbering plan"

config LTE_ALT1250_SMS_NPI_DATA
	bool "Data numbering plan"

config LTE_ALT1250_SMS_NPI_TELEX
	bool "Telex numbering plan"

config LTE_ALT1250_SMS_NPI_SERVICE_CENTRE_SPEC
	bool "Service Centre Specific plan"

config LTE_ALT1250_SMS_NPI_SERVICE_CENTRE_SPEC2
	bool "Service Centre Specific plan-2"

config LTE_ALT1250_SMS_NPI_NATIONAL
	bool "National numbering plan"

config LTE_ALT1250_SMS_NPI_PRIVATE
	bool "Private numbering plan"

config LTE_ALT1250_SMS_NPI_ERMES
	bool "ERMES numbering plan"

config LTE_ALT1250_SMS_NPI_RESERVED
	bool "Reserved for extension"

endchoice # Configure Numbering Plan Indicator

endmenu # SMS configuration

config LTE_ALT1250_EXTEND_IOCTL
	bool "Enabling extended ioctl handler"
	default n

config LTE_ALT1250_LAUNCH_EVENT_TASK
	bool "Launches an internal task to handle events"
	default y
	---help---
		Launches an internal task to handle the event.
		It is also possible to disable this option and handle events with a user task.
		If disabled, use lapi_evtinit() and lapi_evtyield().

if LTE_ALT1250_LAUNCH_EVENT_TASK

config LTE_ALT1250_EVENT_TASK_PRIORITY
	int "internal task priority"
	default 100

config LTE_ALT1250_EVENT_TASK_STACKSIZE
	int "internal task stack size"
	default 2048

endif

config LTE_ALT1250_CONTAINERS
	int "Number of containers"
	default 10
	range 1 255
	---help---
		Determines the maximum number of containers.
		The container is a buffer used to communicate with the ALT1250
		that contains the relevant information for communication.
		Increasing this value may improve the performance during parallel processing.
		On the other hand, decreasing this value will reduce the memory usage.

config LTE_ALT1250_CONTROL_SOCKETS
	int "Number of sockets for control"
	default 3
	range 1 10
	---help---
		Determines the maximum number of sockets used for LAPI and SMS.

config LTE_ALT1250_DEBUG_MSG
	bool "Enable debug output messages"
	default n

endif
```

## lte/lapi/Kconfig
```kconfig
#
# For a description of the syntax of this configuration file,
# see the file kconfig-language.txt in the NuttX tools repository.
#

menuconfig LTE_LAPI
	bool "LTE Configuration Library"
	default n
	---help---
		Enable the LTE Configuration Library.

if LTE_LAPI

config LTE_LAPI_DEBUG_MSG
	bool "Enable debug output messages"
	default n
	depends on DEBUG_NET_ERROR

config LTE_LAPI_KEEP_COMPATIBILITY
	bool "Keep the LTE library compatible."
	default n
	---help---
		lte_get_operator_sync, lte_get_imsi_sync, lte_get_imei_sync, lte_get_phoneno_sync,
		these functions have changed their specifications to specify the length of the
		argument string. Functions in the old spec will be discarded, but enabling this
		option makes you be able to use them.
		Furthermore, this option will be removed in the near future, and functions in
		the old spec will be completely discarded.

config LTE_LAPI_LOG_ACCESS
	bool "Enable the log access API"
	default n
	---help---
		Enable these log access APIs: lte_log_open, lte_log_close,
		lte_log_read, lte_log_lseek, lte_log_remove.

config LTE_LAPI_ENABLE_DEPRECATED_API
	bool "Enable deprecated API"
	default y
	---help---
		If your application does not use the deprecated APIs,
		this option can help to reduce memory usage.
		Deprecated APIs are asynchronous APIs except lte_activate_pdn.
		See include/lte/lte_api.h for a list of asynchronous APIs.
		Deprecated APIs will be removed in the future,
		please use the synchronous API instead.

endif # LTE_LAPI
```
