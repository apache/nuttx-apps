## math/libtommath/Kconfig
```kconfig
#
# For a description of the syntax of this configuration file,
# see the file kconfig-language.txt in the NuttX tools repository.
#

menuconfig MATH_LIBTOMMATH
	bool "LibTomMath MPI Math Library"
	default n
	---help---
		LibTomMath, a free open source portable number theoretic
		multiple-precision integer (MPI) library written entirely in C

if MATH_LIBTOMMATH

config LIBTOMMATH_VERSION
	string "LibTomMath Version"
	default "1.2.0"

menuconfig LIBTOMMATH_DEMOS
	bool "LibTomMath MPI Math Library Demos"
	default n
	---help---
		LibTomMath demo and test applications.

if LIBTOMMATH_DEMOS

config LIBTOMMATH_TEST
	tristate "LibTomMath Test"
	default n
	---help---
		Demo test application for LibTomMath

if LIBTOMMATH_TEST

config LIBTOMMATH_TEST_PROGNAME
	string "Test program name"
	default "tommath_test"
	---help---
		LibTomMath test application name

config LIBTOMMATH_TEST_PRIORITY
	int "Test application priority"
	default 100

config LIBTOMMATH_TEST_STACKSIZE
	int "Test application stack size"
	default DEFAULT_TASK_STACKSIZE

endif # LIBTOMMATH_TEST

config LIBTOMMATH_MTEST_OPPONENT
	tristate "LibTomMath MTest opponent"
	default n
	---help---
		Demo mtest opponent application for LibTomMath

if LIBTOMMATH_MTEST_OPPONENT

config LIBTOMMATH_MTEST_OPPONENT_PROGNAME
	string "MTest opponent program name"
	default "tommath_mtest_opponent"
	---help---
		LibTomMath mtest opponent application name

config LIBTOMMATH_MTEST_OPPONENT_PRIORITY
	int "MTest opponent application priority"
	default 100

config LIBTOMMATH_MTEST_OPPONENT_STACKSIZE
	int "MTest opponent application stack size"
	default DEFAULT_TASK_STACKSIZE

endif # LIBTOMMATH_MTEST_OPPONENT

config LIBTOMMATH_TIMING
	tristate "LibTomMath Timing"
	default n
	---help---
		Demo timing test application for LibTomMath

if LIBTOMMATH_TIMING

config LIBTOMMATH_TIMING_PROGNAME
	string "Timing program name"
	default "tommath_timing"
	---help---
		LibTomMath test application name

config LIBTOMMATH_TIMING_PRIORITY
	int "Timing application priority"
	default 100

config LIBTOMMATH_TIMING_STACKSIZE
	int "Timing application stack size"
	default DEFAULT_TASK_STACKSIZE

endif # LIBTOMMATH_TIMING

endif # LIBTOMMATH_DEMOS

config LIBTOMMATH_MTEST
	tristate "LibTomMath MPI Math Library Mtest"
	default n
	---help---
		LibTomMath mtest applications for LibTomMath

if LIBTOMMATH_MTEST

config LIBTOMMATH_MTEST_PROGNAME
	string "Mtest program name"
	default "tommath_mtest"
	---help---
		LibTomMath test application name

config LIBTOMMATH_MTEST_PRIORITY
	int "Mtest application priority"
	default 100

config LIBTOMMATH_MTEST_STACKSIZE
	int "Mtest application stack size"
	default DEFAULT_TASK_STACKSIZE

endif # LIBTOMMATH_MTEST

endif # MATH_LIBTOMMATH
```

## middleware/uorb/Kconfig
```kconfig
#
# For a description of the syntax of this configuration file,
# see the file kconfig-language.txt in the NuttX tools repository.
#

config UORB
	tristate "uORB async pub/sub IPC"
	default n
	depends on HAVE_CXX
	---help---
		Enable the uORB 
```

## mlearning/cmsis/Kconfig
```kconfig
#
# For a description of the syntax of this configuration file,
# see the file kconfig-language.txt in the NuttX tools repository.
#

config CMSIS
	bool "CMSIS Libraries"
	default n
	---help---
		Enable CMSIS Libraries.
		The Cortex Microcontroller Software Interface Standard (CMSIS) is provided
		from https://github.com/ARM-software/CMSIS_5 and licensed under Apache-2.0.
		For details, see http://arm-software.github.io/CMSIS_5/General/html/index.html.

if CMSIS

config CMSIS_VER
	string "Default CMSIS version"
	default 5.8.0

config CMSIS_DSP
	bool "CMSIS DSP"
	default y
	---help---
		Enable CMSIS-DSP: Fast implementation of digital signal processing.

if CMSIS_DSP

config CMSIS_DSP_ARM_MATH_MATRIX_CHECK
	bool "CMSIS DSP MATH MATRIX CHECK"
	default n
	---help---
		Enable checking on the input and output sizes of matrices

config CMSIS_DSP_ARM_MATH_ROUNDING
	bool "CMSIS DSP MATH ROUNDING"
	default n
	---help---
		Enable rounding on support functions

endif # CMSIS_DSP

config CMSIS_NN
        bool "CMSIS NN"
        default y
        depends on CMSIS_DSP
        ---help---
                Enable CMSIS-NN: Efficient neural network kernels.


endif # CMSIS
```

## mlearning/darknet/Kconfig
```kconfig
#
# For a description of the syntax of this configuration file,
# see the file kconfig-language.txt in the NuttX tools repository.
#

config DARKNET_YOLO
	bool "YOLO: Real-Time Object Detection"
	default n
	---help---
		You only look once (YOLO) is a state-of-the-art,
                real-time object detection system

if DARKNET_YOLO

config DARKNET_YOLO_VER
	string "DARKNET YOLO version"
	default "master"

endif # DARKNET_YOLO
```

## modbus/Kconfig
```kconfig
#
# For a description of the syntax of this configuration file,
# see the file kconfig-language.txt in the NuttX tools repository.
#

menu "FreeModBus"
config MODBUS
	bool "Modbus support using FreeModbus"
	default n

if MODBUS

config MB_FUNC_HANDLERS_MAX
	int "Maximum number of Modbus functions"
	default 16
	---help---
		Maximum number of Modbus functions codes the protocol stack should support.

		The maximum number of supported Modbus functions must be greater than
		the sum of all enabled functions in this file and custom function
		handlers. If set to small adding more functions will fail.

config MODBUS_SLAVE
	bool "Modbus slave support via FreeModBus"
	default n

if MODBUS_SLAVE
config MB_ASCII_ENABLED
	bool "Modbus ASCII support"
	default y

config MB_RTU_ENABLED
	bool "Modbus RTU support"
	default y

config MB_TCP_ENABLED
	bool "Modbus TCP support"
	default y

config MB_HAVE_CLOSE
	bool "Platform close callbacks"
	default n
	depends on MB_TCP_ENABLED
	---help---
		A port which wants to get an callback must select
		CONFIG_MB_HAVE_CLOSE and provide vMBPortClose() as
		as vMBTCPPortClose() (if CONFIG_MB_TCP_ENABLED)

config MB_ASCII_TIMEOUT_SEC
	int "Character timeout"
	depends on MB_ASCII_ENABLED
	default 1
	---help---
		Character timeout value for Modbus ASCII

		The character timeout value is not fixed for Modbus ASCII and is therefore
		a configuration option. It should be set to the maximum expected delay
		time of the network.


config MB_ASCII_TIMEOUT_WAIT_BEFORE_SEND_MS
	int "Timeout to wait before sending"
	depends on MB_ASCII_ENABLED
	default 0
	---help---
		Timeout to wait in ASCII prior to enabling transmitter

		If defined the function calls vMBPortSerialDelay with the argument
		MB_ASCII_TIMEOUT_WAIT_BEFORE_SEND_MS to allow for a delay before
		the serial transmitter is enabled. This is required because some
		targets are so fast that there is no time between receiving and
		transmitting the frame. If the master is to slow with enabling its
		receiver then he will not receive the response correctly.

config MB_FUNC_OTHER_REP_SLAVEID_BUF
	int "Size of Slave ID report buffer"
	depends on MB_FUNC_OTHER_REP_SLAVEID_ENABLED
	default 32
	---help---
		Number of bytes which should be allocated for the Report Slave ID command.

		This number limits the maximum size of the additional segment in the
		report slave id function. See eMBSetSlaveID() for more information on
		how to set this value. It is only used if MB_FUNC_OTHER_REP_SLAVEID_ENABLED
		is set to 1.

config MB_FUNC_OTHER_REP_SLAVEID_ENABLED
	bool "Report Slave ID function"
	default y
	---help---
		If the Report Slave ID function should be enabled.

config MB_FUNC_READ_INPUT_ENABLED
	bool "Read Input Registers function"
	default y
	---help---
		If the Read Input Registers function should be enabled.

config MB_FUNC_READ_HOLDING_ENABLED
	bool "Read Holding Registers function"
	default y
	---help---
		If the Read Holding Registers function should be enabled.

config MB_FUNC_WRITE_HOLDING_ENABLED
	bool "Write Single Register function"
	default y
	---help---
		If the Write Single Register function should be enabled.

config MB_FUNC_WRITE_MULTIPLE_HOLDING_ENABLED
	bool "Write Multiple registers function"
	default y
	---help---
		If the Write Multiple registers function should be enabled.

config MB_FUNC_READ_COILS_ENABLED
	bool "Read Coils function"
	default y
	---help---
		If the Read Coils function should be enabled.

config MB_FUNC_WRITE_COIL_ENABLED
	bool "Write Coils function"
	default y
	---help---
		If the Write Coils function should be enabled.

config MB_FUNC_WRITE_MULTIPLE_COILS_ENABLED
	bool "Write Multiple Coils function"
	default y
	---help---
		If the Write Multiple Coils function should be enabled.

config MB_FUNC_READ_DISCRETE_INPUTS_ENABLED
	bool "Read Discrete Inputs function"
	default y
	---help---
		If the Read Discrete Inputs function should be enabled.

config MB_FUNC_READWRITE_HOLDING_ENABLED
	bool "Read/Write Multiple Registers function"
	default y
	---help---
		If the Read/Write Multiple Registers function should be enabled.

endif # MODBUS_SLAVE

config MODBUS_MASTER
	bool "Modbus Master support via FreeModBus"
	default n

config MB_ASCII_MASTER
	bool "Modbus ASCII master"
	default n
	depends on MODBUS_MASTER

config MB_RTU_MASTER
	bool "Modbus RTU master"
	default n
	depends on MODBUS_MASTER

config MB_PORT_HAS_CLOSE
	bool "Platform close callbacks"
	default n
	depends on MODBUS_MASTER
	---help---
		A port which wants to get an callback must select
		CONFIG_MB_HAS_CLOSE and provide vMBMasterPortClose() as
		as pvMBMasterFrameCloseCur() (if CONFIG_MB_RTU_MASTER)

if MB_ASCII_MASTER || MB_RTU_MASTER

config MB_MASTER_TOTAL_SLAVE_NUM
	int "Total number slaves"
	default 16
	---help---
		The total slaves in Modbus Master system. Default 16.
		NOTE: The slave ID must be continuous from 1.

config MB_MASTER_DELAY_MS_CONVERT
	int "Convert Delay value"
	default 200
	---help---
		When master sends a broadcast frame, it should allow slaves to process
		current frame before sending new frame. New frame will be send only
		after Convert Delay time duration.

config MB_MASTER_TIMEOUT_MS_RESPOND
	int "Respond timeout value"
	default 1000
	---help---
		When master sends frame, which is not broadcast, it should wait for
		given time duration for slave response. If slave doesn't respond
		during give time period, the master will process timeout
		error and only then it will be able to send new frame.

config MB_MASTER_FUNC_READ_INPUT_ENABLED
	bool "Read Input Registers function"
	default y
	---help---
		If the Read Input Registers function should be enabled.

config MB_MASTER_FUNC_READ_HOLDING_ENABLED
	bool "Read Holding Registers function"
	default y
	---help---
		If the Read Holding Registers function should be enabled.

config MB_MASTER_FUNC_WRITE_HOLDING_ENABLED
	bool "Write Single Register function"
	default y
	---help---
		If the Write Single Register function should be enabled.

config MB_MASTER_FUNC_WRITE_MULTIPLE_HOLDING_ENABLED
	bool "Write Multiple registers function"
	default y
	---help---
		If the Write Multiple registers function should be enabled.

config MB_MASTER_FUNC_READ_COILS_ENABLED
	bool "Read Coils function"
	default y
	---help---
		If the Read Coils function should be enabled.

config MB_MASTER_FUNC_WRITE_COIL_ENABLED
	bool "Write Coils function"
	default y
	---help---
		If the Write Coils function should be enabled.

config MB_MASTER_FUNC_WRITE_MULTIPLE_COILS_ENABLED
	bool "Write Multiple Coils function"
	default y
	---help---
		If the Write Multiple Coils function should be enabled.

config MB_MASTER_FUNC_READ_DISCRETE_INPUTS_ENABLED
	bool "Read Discrete Inputs function"
	default y
	---help---
		If the Read Discrete Inputs function should be enabled.

config MB_MASTER_FUNC_READWRITE_HOLDING_ENABLED
	bool "Read/Write Multiple Registers function"
	default y
	---help---
		If the Read/Write Multiple Registers function should be enabled.

endif # MB_ASCII_MASTER || MB_RTU_MASTER
endif # MODBUS
endmenu # FreeModBus
```

## netutils/Kconfig
```kconfig
#
# For a description of the syntax of this configuration file,
# see the file kconfig-language.txt in the NuttX tools repository.
#

menu "Network Utilities"

source "$APPSDIR/netutils/chat/Kconfig"
source "$APPSDIR/netutils/codecs/Kconfig"
source "$APPSDIR/netutils/dhcpc/Kconfig"
source "$APPSDIR/netutils/dhcpd/Kconfig"
source "$APPSDIR/netutils/esp8266/Kconfig"
source "$APPSDIR/netutils/ftpc/Kconfig"
source "$APPSDIR/netutils/ftpd/Kconfig"
source "$APPSDIR/netutils/json/Kconfig"
source "$APPSDIR/netutils/smtp/Kconfig"
source "$APPSDIR/netutils/telnetd/Kconfig"
source "$APPSDIR/netutils/tftpc/Kconfig"
source "$APPSDIR/netutils/thttpd/Kconfig"
source "$APPSDIR/netutils/netlib/Kconfig"
source "$APPSDIR/netutils/webclient/Kconfig"
source "$APPSDIR/netutils/webserver/Kconfig"
source "$APPSDIR/netutils/ntpclient/Kconfig"
source "$APPSDIR/netutils/discover/Kconfig"
source "$APPSDIR/netutils/xmlrpc/Kconfig"
source "$APPSDIR/netutils/pppd/Kconfig"

endmenu # Network Utilities
```

## netutils/bare/Kconfig
```kconfig
config NETUTILS_BARE
	bool "Binary Application Record Encoding (BARE)"
	default n
	depends on ALLOW_MIT_COMPONENTS
	---help---
		BARE is a simple binary representation for structured
		application data.

		See https://baremessages.org/

		cbare is an MIT-licensed I/O agnostic C implementation of the
		BARE message encoding that is used when this option is enabled.

if NETUTILS_BARE

config NETUTILS_BARE_TEST
	bool "Enable baretest"
	default n
	---help---
		Enable baretest -- BARE test application.

endif
```

## netutils/chat/Kconfig
```kconfig
#
# For a description of the syntax of this configuration file,
# see the file kconfig-language.txt in the NuttX tools repository.
#

config NETUTILS_CHAT
	bool "Chat tool"
	default n
	---help---
		Enable the chat tool.

if NETUTILS_CHAT

endif # NETUTILS_CHAT
```

## netutils/cjson/Kconfig
```kconfig
#
# For a description of the syntax of this configuration file,
# see the file kconfig-language.txt in the NuttX tools repository.
#

config NETUTILS_CJSON
	bool "cJSON library (current version)"
	default n
	select LIBC_FLOATINGPOINT
	---help---
		Enables the cJSON library.

if NETUTILS_CJSON

config NETUTILS_CJSON_URL
	string "URL where cJSON library can be downloaded"
	default "https://github.com/DaveGamble/cJSON/archive"

config NETUTILS_CJSON_VERSION
	string "Version number"
	default "1.7.12"

config NETUTILS_CJSON_TEST
	bool "Enable cJSON test"
	default n

if NETUTILS_CJSON_TEST

config CJSON_UNITY_TEST_DIR
	string "cJSON test directory"
	default "/data"

config CJSON_TEST_PRIORITY
	int "task priority"
	default 100

config CJSON_TEST_STACKSIZE
	int "stack size"
	default 102400

config CJSON_NESTING_LIMIT
	int "NESTING_LIMIT"
	default 100

endif # NETUTILS_CJSON_TEST

endif # NETUTILS_CJSON
```
