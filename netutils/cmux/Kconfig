## netutils/cmux/Kconfig
```kconfig
#
# For a description of the syntax of this configuration file,
# see the file kconfig-language.txt in the NuttX tools repository.
#

config NETUTILS_CMUX
	bool "Cmux tool"
	default n
	---help---
		Enable the CMUX (GSM 07.10) multiplexing protocol utility.
		CMUX allows multiplexing multiple virtual serial connections
		over a single physical serial link, commonly used with GSM/LTE
		modems to simultaneously handle AT commands, data connections,
		and other communication channels.

if NETUTILS_CMUX

endif # NETUTILS_CMUX
```

## netutils/connectedhomeip/Kconfig
```kconfig
#
# For a description of the syntax of this configuration file,
# see the file kconfig-language.txt in the NuttX tools repository.
#

config MATTER
	bool "Connected Home over IP (CHIP)"
	default n
	---help---
		Enable the Connected Home over IP (CHIP)

if MATTER

config MATTER_LOG
	bool "Build matter with logs"
	default n
	---help---
		To reduce flash size, logs are not opened by default

endif
```

## netutils/cwebsocket/Kconfig
```kconfig
#
# For a description of the syntax of this configuration file,
# see the file kconfig-language.txt in the NuttX tools repository.
#

config CWEBSOCKET
	bool "WebSocket Client Library"
	default n
	depends on ALLOW_MIT_COMPONENTS
	select LIBC_SCANSET
	---help---
		Enable WebSocket Client Library.
		WebSocket Client Library is provided from https://github.com/jeremyhahn/cwebsocket
		and licensed under MIT.
```

## netutils/dhcp6c/Kconfig
```kconfig
#
# For a description of the syntax of this configuration file,
# see the file kconfig-language.txt in the NuttX tools repository.
#

config NETUTILS_DHCP6C
    bool "DHCPv6 client"
    default n
    depends on NET_IPv6
    depends on NET_UDP && NET_UDP_CHECKSUMS

if NETUTILS_DHCP6C

config NETUTILS_DHCP6C_REQUEST_TIMEOUT
    int "Default single request timeout in second"
    default 6

endif
```

## netutils/dhcpc/Kconfig
```kconfig
#
# For a description of the syntax of this configuration file,
# see the file kconfig-language.txt in the NuttX tools repository.
#

config NETUTILS_DHCPC
	bool "DHCP client"
	default n
	depends on NET_UDP
	select NET_BINDTODEVICE if !NET_UDP_NO_STACK
	---help---
		Enable support for the DHCP client.

if NETUTILS_DHCPC

config NETUTILS_DHCPC_HOST_NAME
	string "DHCP client host name"
	default "nuttx"

config NETUTILS_DHCPC_RECV_TIMEOUT_MS
	int "Number of receive timeout in millisecond"
	default 3000
	---help---
		This is the timeout value when dhcp client receives response

config NETUTILS_DHCPC_RETRIES
	int "Number of retries for dhcp client request"
	default 3
	---help---
		This setting determines how many times resolver retries request
		until failing.

config NETUTILS_DHCPC_BOOTP_FLAGS
	hex "Flags of Bootstrap"
	default 0x0000 if !NET_IPFORWARD
	default 0x8000 if NET_IPFORWARD
	---help---
		This setting to set the BOOTP broadcast flags.
		Reference RFC1542: Clarifications and Extensions for the
		Bootstrap Protocol.

		Note: We're not always able to receive unicast traffic before
		being fully configured, e.g. with forward enabled. Then we need
		to enable the broadcast flag under these situations.

config NETUTILS_DHCPC_RELEASE_RETRIES
	int "DHCP Release send retries"
	default 3
	---help---
		Number of times to retry sending DHCPRELEASE message if sendto() fails.
		Default is 3 attempts.

config NETUTILS_DHCPC_RELEASE_TRANSMISSION_DELAY_MS
	int "DHCP Release transmission delay (milliseconds)"
	default 10
	---help---
		Delay in milliseconds used for:
		1. Between DHCPRELEASE retry attempts when sendto() fails
		2. To ensure packet transmission before socket closure (if IP clearing enabled)
		Since UDP is connectionless, this delay gives the network stack
		time to actually send the packet. Set to 0 to disable delays
		(not recommended). Default is 10ms.

config NETUTILS_DHCPC_RELEASE_ENSURE_TRANSMISSION
	bool "Ensure DHCP Release message transmission"
	default y
	---help---
		Add a delay after successfully sending DHCPRELEASE message to ensure
		the packet is actually transmitted before the function returns.
		Since DHCP RELEASE has no ACK response from server, this delay helps
		ensure the release message reaches the server before closing the socket.
		Uses the same delay value as CONFIG_NETUTILS_DHCPC_RELEASE_TRANSMISSION_DELAY_MS.

config NETUTILS_DHCPC_RELEASE_CLEAR_IP
	bool "Clear IP address after DHCP release"
	default n
	---help---
		Clear all network configuration from the interface after sending
		DHCPRELEASE message. This includes IP address, subnet mask, default
		gateway. RFC 2131 doesn't mandate immediate clearing, so this is
		disabled by default to maintain connectivity.
		Enable this for scenarios where complete network reset is required.

endif
```

## netutils/discover/Kconfig
```kconfig
#
# For a description of the syntax of this configuration file,
# see the file kconfig-language.txt in the NuttX tools repository.
#

config NETUTILS_DISCOVER
	bool "Network Discovery Utility"
	default n
	depends on NET_UDP
	select NETUTILS_NETLIB
	---help---
		Tool for discovering devices on the local network per UDP broadcast.

if NETUTILS_DISCOVER

config DISCOVER_STACK_SIZE
	int "Discover Daemon Stack Size"
	default 1024

config DISCOVER_PRIORITY
	int "Discover Daemon Priority"
	default 50

config DISCOVER_PORT
	int "Discover Daemon Port Number"
	default 96

config DISCOVER_INTERFACE
	string "Network Interface Name"
	default "eth0"

config DISCOVER_DEVICE_CLASS
	hex "Network Discovery Class"
	default 0xff

config DISCOVER_DESCR
	string "Discoverer Description"
	default "NuttX"

endif
```

## netutils/dnsclient/Kconfig
```kconfig
#
# For a description of the syntax of this configuration file,
# see misc/tools/kconfig-language.txt.
#

config NETUTILS_DNSCLIENT
	bool "DNS Name resolution"
	default n
	depends on NET && NET_UDP
	---help---
		Enable support for the name resolution.

if NETUTILS_DNSCLIENT

choice
	prompt "Internet Protocol"
	default NETUTILS_DNSCLIENT_IPv4 if NET_IPv4
	default NETUTILS_DNSCLIENT_IPv6 if NET_IPv6 && !NET_IPv4

config NETUTILS_DNSCLIENT_IPv4
	bool "IPv4"
	depends on NET_IPv4

config NETUTILS_DNSCLIENT_IPv6
	bool "IPv6"
	depends on NET_IPv6

endchoice # Internet Protocol

config NETUTILS_DNSCLIENT_ENTRIES
	int "Number of DNS resolver entries"
	default 8
	---help---
		Number of DNS resolver entries.  Default: 8

config NETUTILS_DNSCLIENT_MAXRESPONSE
	int "Max response size"
	default 96
	---help---
		This setting determines the maximum size of response message that
		can be received by the DNS resolver.  The default is 96 but may
		need to be larger on enterprise networks (perhaps 176).

endif # NETUTILS_DNSCLIENT
```

## netutils/dropbear/Kconfig
```kconfig
#
# For a description of the syntax of this configuration file,
# see the file kconfig-language.txt in the NuttX tools repository.
#

menuconfig NETUTILS_DROPBEAR
	tristate "Dropbear SSH server"
	default n
	depends on NET && NET_TCP
	depends on !DISABLE_PSEUDOFS_OPERATIONS
	depends on !DISABLE_PTHREAD
	depends on SCHED_WAITPID
	depends on SCHED_HAVE_PARENT
	depends on SCHED_CHILD_STATUS
	depends on NSH_LIBRARY
	depends on FSUTILS_PASSWD
	depends on PSEUDOTERM
	depends on SERIAL
	depends on DEV_URANDOM
	depends on LIBC_NETDB
	depends on LIBC_GAISTRERROR
	depends on CRYPTO
	depends on CRYPTO_RANDOM_POOL
	depends on ALLOW_BSD_COMPONENTS
	depends on CRYPTO_CRYPTODEV
	depends on CRYPTO_CRYPTODEV_SOFTWARE_CRYPTO
	---help---
		Enable a minimal Dropbear SSH server port for NuttX.  This initial
		port is based on the ESP-IDF MCU test port and provides a single
		foreground SSH server process with SSH sessions backed by NSH.

		The port computes the hmac-sha2-256 packet MAC through the NuttX
		crypto device (/dev/crypto, CRYPTO_SHA2_256_HMAC) instead of the
		bundled libtomcrypt implementation, which is dropped from the
		build.  The SHA-256 hash descriptor itself stays in the
		application: Dropbear's key derivation clones partially-updated
		hash states (hashkeys() in common-kex.c), which cannot be
		represented by a kernel crypto session.

if NETUTILS_DROPBEAR

config NETUTILS_DROPBEAR_STACKSIZE
	int "Dropbear main stack size"
	default 65536
	---help---
		Stack size for the Dropbear server built-in.
		This is architecture-specific, so adjust it according to your setup.

config NETUTILS_DROPBEAR_PRIORITY
	int "Dropbear main priority"
	default 100

config NETUTILS_DROPBEAR_SHELL_PRIORITY
	int "Dropbear NSH session priority"
	default 100

config NETUTILS_DROPBEAR_PROGNAME
	string "Dropbear program name"
	default "dropbear"
	---help---
		This is the name of the program that will be used when the NSH ELF
		program is installed.

config NETUTILS_DROPBEAR_LISTEN_RETRIES
	int "Dropbear listen retries"
	default 0
	---help---
		Number of times to retry listen setup when no listen socket could
		be opened.  Zero means to retry forever.

config NETUTILS_DROPBEAR_LISTEN_RETRY_MAX
	int "Dropbear maximum listen retry interval"
	default 120
	range 1 3600
	---help---
		Maximum number of seconds to wait between listen setup retries.
		The retry delay starts at one second and doubles until it reaches
		this value.

config NETUTILS_DROPBEAR_SHELL_STACKSIZE
	int "Dropbear NSH session task stack size"
	default 8192

config NETUTILS_DROPBEAR_SCP
	bool "Enable scp remote copy helper"
	default y
	depends on PIPES
	---help---
		Build Dropbear's scp program and allow SSH exec requests so a host
		scp client can copy files to and from NuttX using the legacy scp
		protocol.  This does not build a full SSH client for initiating scp
		transfers from the target.

config NETUTILS_DROPBEAR_SCP_STACKSIZE
	int "Dropbear scp stack size"
	default 32768
	depends on NETUTILS_DROPBEAR_SCP

config NETUTILS_DROPBEAR_SCP_PRIORITY
	int "Dropbear scp priority"
	default 100
	depends on NETUTILS_DROPBEAR_SCP

config NETUTILS_DROPBEAR_PORT
	int "Dropbear listen port"
	default 2222

config NETUTILS_DROPBEAR_HOSTKEY_PATH
	string "Dropbear ECDSA P-256 host key path"
	default "/etc/dropbear/dropbear_ecdsa_host_key"
	---help---
		Path to the persistent ECDSA P-256 host key used by the Dropbear
		server.  The file is stored in Dropbear's native host key format.

config NETUTILS_DROPBEAR_GENERATE_HOSTKEY
	bool "Generate host key if missing"
	default y
	---help---
		Pass -R so Dropbear generates an ECDSA P-256 host key on demand and
		persists it at NETUTILS_DROPBEAR_HOSTKEY_PATH when it does not exist.
		Product builds can disable this and provision the host key
		externally (loaded with -r).

config NETUTILS_DROPBEAR_COMPRESSION
	bool "Enable SSH compression (zlib)"
	default n
	depends on LIB_ZLIB
	---help---
		Enable zlib compression for SSH sessions.  Requires the zlib
		library (LIB_ZLIB).  When disabled, Dropbear is built with
		DISABLE_ZLIB and negotiates no compression.

		WARNING: each session allocates a zlib deflate state of about
		256 KiB (DROPBEAR_ZLIB_WINDOW_BITS=15, DROPBEAR_ZLIB_MEM_LEVEL=8),
		and the state is allocated even for the delayed zlib@openssh.com
		method, right after key exchange.

config NETUTILS_DROPBEAR_SYSLOG
	bool "Log via syslog"
	default n
	---help---
		Route Dropbear log messages through syslog().  When disabled,
		Dropbear is built with DISABLE_SYSLOG.

config NETUTILS_DROPBEAR_COMMIT
	string "Dropbear upstream commit"
	default "54ef47adf8c99b422be6a8f694f2866e62f88b9e"
	---help---
		Upstream Dropbear (mkj/dropbear) commit to download and build.

endif
```

## netutils/esp8266/Kconfig
```kconfig
#
# For a description of the syntax of this configuration file,
# see the file kconfig-language.txt in the NuttX tools repository.
#

config NETUTILS_ESP8266
	bool "ESP8266"
	select ARCH_HAVE_NET
	default n
	---help---
		Enable support for ESP8266 application interface.

if NETUTILS_ESP8266

config NETUTILS_ESP8266_DEV_PATH
	string "Serial device path"
	default "/dev/ttyS1"

config NETUTILS_ESP8266_BAUDRATE
	int "Serial BAUD rate"
	default 115200

config NETUTILS_ESP8266_MAXTXLEN
	int "Max. TX length"
	default 256

config NETUTILS_ESP8266_MAXRXLEN
	int "Max. RX length"
	default 256

config NETUTILS_ESP8266_WORKER_BUF_LEN
	int "Max. Worker RX length"
	default 256

config NETUTILS_ESP8266_THREADPRIO
	int "Worker thread priority"
	default 100

endif
```

## netutils/ftpc/Kconfig
```kconfig
#
# For a description of the syntax of this configuration file,
# see the file kconfig-language.txt in the NuttX tools repository.
#

config NETUTILS_FTPC
	bool "FTP client"
	default n
	---help---
		Enable support for the FTP client.

if NETUTILS_FTPC

config DEBUG_FTPC
	bool "Debug FTP client"
	default n
	depends on DEBUG_FEATURES
	---help---
		Enable debug support for the FTP client.  This option simple forces
		CONFIG_DEBUG_NET to be on, but only for the files within this directory.

config FTP_TMPDIR
	string "TMP directory path for FTP"
	default "/tmp"
	---help---
		The path to use for storing temporary files used in the transfer process
		by the FTP client.

config FTP_SIZE_CMD_MODE_BINARY
	bool "Use binary mode for size command"
	default n
	---help---
		Use binary transfer mode for FTP size command.

config FTPC_DISABLE_EPRT
	bool "Disable EPRT and use PORT instead"
	default n
	---help---
		FTP uses PORT and EPRT when in active mode. EPRT replaced PORT to allow
		for IPv6 support. EPRT is supported in most FTP implementations now. However,
		if you need to use PORT instead, use this option to disable EPRT and
		fallback to using PORT.

config FTPC_DISABLE_EPSV
	bool "Disable EPSV and use PASV instead"
	default n
	---help---
		FTP uses EPSV or PASV when in passive mode. EPSV replaced PASV to allow
		for IPv6 support. EPSV is supported in most FTP implementations now. However,
		if you need to use PASV instead, use this option to disable EPSV and
		fallback to using PASV.

config FTPC_OVER_SENDFILE
	bool "Use sendfile() in ftpc binary transfer mode of PUT operation"
	default y
	depends on NET_SENDFILE
	---help---
		This option enables using sendfile() in ftpc binary transfer mode of PUT
		operation. If the option is enabled but ASCII transfer mode is activated,
		ftpc falls back to the combination of read() and write().
		Using sendfile() provides a higher performance compared
		to the combination of read() and write().

endif
```

## netutils/ftpd/Kconfig
```kconfig
#
# For a description of the syntax of this configuration file,
# see the file kconfig-language.txt in the NuttX tools repository.
#

config NETUTILS_FTPD
	bool "FTP server"
	default n
	depends on NET_TCP
	---help---
		Enable support for the FTP server.

if NETUTILS_FTPD

config FTPD_WORKERSTACKSIZE
	int "FTPD server thread stack size"
	default DEFAULT_TASK_STACKSIZE

config FTPD_LOGIN_PASSWD
	bool "Verify FTPD server login with encrypted password file"
	default n
	depends on FSUTILS_PASSWD
	---help---
		Use the content of an encrypted password file to verify user
		credentials.  This option requires that you have selected
		CONFIG_FSUTILS_PASSWD to enable the access methods of
		apps/fsutils/passwd.

endif
```

## netutils/iperf/Kconfig
```kconfig
#
# For a description of the syntax of this configuration file,
# see the file kconfig-language.txt in the NuttX tools repository.
#
		
config NETUTILS_IPERF
	bool "iperf example"
	default n
	depends on NET
	select NETUTILS_NETLIB
	select LIBC_FLOATINGPOINT
	select SYSTEM_ARGTABLE3
	---help---
		Enable the \"iperf example\"

if NETUTILS_IPERF
		
config NETUTILS_IPERF_PROGNAME
	string "Program name"
	default "iperf"
	---help---
		This is the name of the program that will be used when the NSH ELF
		program is installed.

config NETUTILS_IPERF_PRIORITY
	int "iperf task priority"
	default 100

config NETUTILS_IPERF_STACKSIZE
	int "iperf stack size"
	default DEFAULT_TASK_STACKSIZE

config NETUTILS_IPERFTEST_DEVNAME
	string "iperf Network device"
	default "wlan0"

endif
```
