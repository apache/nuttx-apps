## netutils/iptables/Kconfig
```kconfig
#
# For a description of the syntax of this configuration file,
# see the file kconfig-language.txt in the NuttX tools repository.
#

config NETUTILS_IPTABLES
	bool "iptables libary"
	default n
	---help---
		iptable libary support.
```

## netutils/iptlite/Kconfig
```kconfig
#############################################################################
#
# netutils/iptlite/Kconfig
# iptlite networking application
#
#############################################################################

# For a description of the syntax of this configuration file,
# see the file kconfig-language.txt in the NuttX tools repository.
#

config NETUTILS_IPTLITE
	bool "iptlite packet filter"
	default n
	depends on NET_TCP
	---help---
		Enable the iptlite packet filter

if NETUTILS_IPTLITE

config NETUTILS_IPTLITE_PROGNAME
	string "Program name"
	default "iptlite"
	---help---
		This is the name of the program that will be used when the NSH ELF
		program is installed.

config NETUTILS_IPTLITE_PRIORITY
	int "iptlite task priority"
	default 100

config NETUTILS_IPTLITE_STACKSIZE
	int "iptlite stack size"
	default DEFAULT_TASK_STACKSIZE

endif
```

## netutils/jsoncpp/Kconfig
```kconfig
#
# For a description of the syntax of this configuration file,
# see the file kconfig-language.txt in the NuttX tools repository.
#

config NETUTILS_JSONCPP
	bool "JSONCPP"
	default n
	---help---
		JsonCpp is a C++ library that allows manipulating JSON values,
		including serialization and deserialization to and from strings.
		It can also preserve existing comment in unserialization/
		serialization steps, making it a convenient format to store user
		input files.

if NETUTILS_JSONCPP

config JSONCPP_VERSION
	string "Jsoncpp Version"
	default "1.9.5"

endif # NETUTILS_JSONCPP
```

## netutils/libcoap/Kconfig
```kconfig
#
# For a description of the syntax of this configuration file,
# see the file kconfig-language.txt in the NuttX tools repository.
#

config NETUTILS_LIBCOAP
	bool "LIBCOAP"
	default n
	---help---
		libcoap is a C implementation of a lightweight application-protocol
		for devices that are constrained their resources such as computing
		power, RF range, memory, bandwidth, or network packet sizes. This
		protocol, CoAP, is standardized by the IETF as RFC 7252.

if NETUTILS_LIBCOAP

config LIBCOAP_VERSION
	string "libcoap version"
	default "4.3.4"

config NETUTILS_LIBCOAP_EXAMPLE
	tristate "Example coap-server and coap-client"
	default n

if NETUTILS_LIBCOAP_EXAMPLE

config NETUTILS_LIBCOAP_EXAMPLE_PRIORITY
	int "libcoap example priority"
	default 100

config NETUTILS_LIBCOAP_EXAMPLE_STACKSIZE
	int "libcoap example stacksize"
	default 2048

endif # NETUTILS_LIBCOAP_EXAMPLE

endif # NETUTILS_LIBCOAP
```

## netutils/libcurl4nx/Kconfig
```kconfig
#
# For a description of the syntax of this configuration file,
# see the file kconfig-language.txt in the NuttX tools repository.
#

config NETUTILS_LIBCURL4NX
	bool "cURL4nx HTTP client library"
	default n
	depends on NET_TCP
	select LIBC_NETDB
	select NETUTILS_NETLIB_GENERICURLPARSER
	---help---
		Enable the NuttX cURL like library.

if NETUTILS_LIBCURL4NX

config LIBCURL4NX_MAXHOST
	int "Maximum URL host length"
	default 128

config LIBCURL4NX_MAXPATH
	int "Maximum URL path length"
	default 128

config LIBCURL4NX_MAXMETHOD
	int "Maximum HTTP method length"
	default 16

config LIBCURL4NX_MAXUSERAGENT
	int "Maximum HTTP user agent length"
	default 64

config LIBCURL4NX_MAXHEADERLINE
	int "Maximum receivable header line"
	default 128

config LIBCURL4NX_RXBUFLEN
	int "Initial RX buffer size"
	default 512

config LIBCURL4NX_MINRXBUFLEN
	int "Minimum RX buffer size for CURL4NXOPT_BUFFERSIZE"
	default 16

config LIBCURL4NX_MAXRXBUFLEN
	int "Maximum RX buffer size for CURL4NXOPT_BUFFERSIZE"
	default 2048

endif
```

## netutils/libshvc/Kconfig
```kconfig
#
# For a description of the syntax of this configuration file,
# see the file kconfig-language.txt in the NuttX tools repository.
#

config NETUTILS_LIBSHVC
	bool "Silicon Heaven Protocol (lightweight C implementation)"
	depends on NETUTILS_LIBULUT
	default n
	---help---
		Enable the SHV API to be used in NuttX applications.
```

## netutils/libulut/Kconfig
```kconfig
#
# For a description of the syntax of this configuration file,
# see the file kconfig-language.txt in the NuttX tools repository.
#

# The ulut library is to be meant primarily used with
# the Silicon Heaven protocol, hence the info comment.

if !NETUTILS_LIBULUT && !NETUTILS_LIBSHVC
comment "uLan Utilities Library required to support the Silicon Heaven protocol"
endif

config NETUTILS_LIBULUT
	bool "uLan Utilities Library (ULUT)"
	default n
	---help---
		Enable the ULUT library to be used in NuttX applications.
```

## netutils/libwebsockets/Kconfig
```kconfig
#
# For a description of the syntax of this configuration file,
# see the file kconfig-language.txt in the NuttX tools repository.
#

config NETUTILS_LIBWEBSOCKETS
	bool "libwebsockets library (current version)"
	default n
	depends on NET
	---help---
		Enables the libwebsockets library.

if NETUTILS_LIBWEBSOCKETS

config NETUTILS_LIBWEBSOCKETS_VERSION
	string "Version number"
	default "4.3.1"

config NETUTILS_LIBWEBSOCKETS_SERVER
	bool "Enable server support"
	default n
	---help---
		Enable WebSocket/HTTP server support in libwebsockets.
		When disabled, only client-side code is built.

config NETUTILS_LIBWEBSOCKETS_TLS
	bool "Enable TLS support"
	default y
	depends on OPENSSL_MBEDTLS_WRAPPER
	---help---
		Enable TLS in libwebsockets via the OpenSSL-mbedTLS
		wrapper. Requires CONFIG_OPENSSL_MBEDTLS_WRAPPER.
		When disabled, only plain ws:// connections are supported.

endif
```

## netutils/mdns/Kconfig
```kconfig
config LIB_MDNS
	bool "MDNS library"
	default n
	---help---
		Enable the mDNS library. This allows calls to the library to be made.
		
		This external library is "unlicensed" using the methodology from
		http://unlicense.org
		
		You should be sure that this license is acceptable for your usage.

		By default, the "built-in" demo is added as an application that can
		be run from nsh <mdns>.

		This is also needed for the optional daemon that allows the demo
		app's mDNS functionality to be started and stopped from user
		applications. There is an associated example app
		(CONFIG_EXAMPLES_MDNSD) to allow the daemon to be tried from nsh.

		Ultimately, this should be used simply as a library, and neither the
		demo app nor the daemon utilised. If just built as a library,the
		relevant header file <mdns.h> is copied to the usual netutils
		include location and can be utilised be including it:

		#include <netutils/mdns.h>

if LIB_MDNS

config NETUTILS_MDNS
	tristate "Enable mdns built-in demo app"
	default n
	---help---
		Enable the author's original built-in MDNS demo app. This allows the
		functionality of the library to be demonstrated. Information on using
		it is available from the original git repo for this external library:

		https://github.com/mjansson/mdns

if NETUTILS_MDNS

config NETUTILS_MDNS_PROGNAME
	string "mDNS program name"
	default "mdns"
	---help---
		This is the name of the program that will be used when the NSH ELF
		program is installed.

config NETUTILS_MDNS_PRIORITY
	int "mDNS task priority"
	default 100

config NETUTILS_MDNS_STACKSIZE
	int "mDNS stack size"
	default DEFAULT_TASK_STACKSIZE
	---help---
		The default (4KiB) is adequate for simple networks but this will
		most likely need to be increased if there are many network devices
		attached that could send queries.

config NETUTILS_MDNS_VERBOSE
	bool "Enable verbose printf output from built-in mdns demo"
	default y
endif

config NETUTILS_MDNS_DAEMON
	tristate "Wrap mdns demo app as a daemon, which can be started/stopped"
	default n
	depends on NETUTILS_MDNS
	---help---
		This option wraps the mdns demo app as a daemon, so requires
		CONFIG_NETUTILS_MDNS to be selected.

		There is also an example app (CONFIG_EXAMPLES_MDNSD) to allow the
		mdns daemon to be started/stopped via the NuttX shell.

config NETUTILS_MDNS_DAEMON_STOP_SIGNAL
	int "Signal used to stop the MDNSD daemon"
	default 22
	depends on NETUTILS_MDNS_DAEMON

endif #NETUTILS_MDNS
```

## netutils/mqttc/Kconfig
```kconfig
#
# For a description of the syntax of this configuration file,
# see the file kconfig-language.txt in the NuttX tools repository.
#

config NETUTILS_MQTTC
	tristate "Enable MQTT-C"
	default n
	---help---
		Enable MQTT-C

if NETUTILS_MQTTC

config NETUTILS_MQTTC_EXAMPLE
	tristate "Enable MQTT-C example"
	default n
	---help---
		Enable MQTT-C example

if NETUTILS_MQTTC_EXAMPLE

config NETUTILS_MQTTC_EXAMPLE_STACKSIZE
	int "Task's stack size"
	default 8192

endif

config NETUTILS_MQTTC_WITH_MBEDTLS
	bool "Enable MQTT-C with mbedtls"
	default n
	depends on CRYPTO_MBEDTLS
	select DEV_URANDOM

config NETUTILS_MQTTC_VERSION
	string "MQTT-C Version"
	default "1.1.5"

endif
```

## netutils/nanopb/Kconfig
```kconfig
#
# For a description of the syntax of this configuration file,
# see the file kconfig-language.txt in the NuttX tools repository.
#

config NETUTILS_NANOPB
	tristate "Nanopb Protocol Buffers"
	default n
	---help---
		Nanopb is a small code-size Protocol Buffers implementation in ansi C.
		It is especially suitable for use in microcontrollers, but fits any
		memory restricted system.

if NETUTILS_NANOPB

config NETUTILS_NANOPB_VERSION
	string "Nanopb Version"
	default "0.4.8"

config NETUTILS_NANOPB_EXAMPLE
	tristate "Enable Nanopb example"
	default n
	---help---
		Enable Nanopb simple example

if NETUTILS_NANOPB_EXAMPLE

config NETUTILS_NANOPB_EXAMPLE_PRIORITY
	int "Task Priority"
	default 100

config NETUTILS_NANOPB_EXAMPLE_STACKSIZE
	int "Task stack size"
	default DEFAULT_TASK_STACKSIZE

endif

endif
```

## netutils/netcat/Kconfig
```kconfig
#
# For a description of the syntax of this configuration file,
# see the file kconfig-language.txt in the NuttX tools repository.
#

config NETUTILS_NETCAT
	tristate "NetCat tool"
	default n
	depends on NET_TCP
	---help---
		Enable the NetCat TCP/IP swiss army tool

if NETUTILS_NETCAT

config NETUTILS_NETCAT_PROGNAME
	string "Program name"
	default "netcat"
	---help---
		This is the name of the program that will be use when the NSH ELF
		program is installed.

config NETUTILS_NETCAT_PRIORITY
	int "netcat task priority"
	default 100

config NETUTILS_NETCAT_STACKSIZE
	int "netcat stack size"
	default DEFAULT_TASK_STACKSIZE

config NETUTILS_NETCAT_SENDFILE
	bool "Use sendfile() in netcat when possible"
	default y
	depends on NET_SENDFILE
	---help---
		This option enables using sendfile() in netcat client mode
		if a normal file (not stdin) is sent. If the option is enabled
		but stdin is sent rather than a normal file, netcat falls back
		to the combination of read() and write().
		Using sendfile() provides a higher performance compared to
		the combination of read() and write().

config NETUTILS_NETCAT_BUFSIZE
	int "netcat I/O buffer size"
	default 256
	---help---
		The I/O buffer is used in the netcat server mode.
		The I/O buffer is also used in the netcat client mode only if
		sendfile() is not applicable.

endif
```
