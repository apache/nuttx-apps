## netutils/netlib/Kconfig
```kconfig
#
# For a description of the syntax of this configuration file,
# see the file kconfig-language.txt in the NuttX tools repository.
#

config NETUTILS_NETLIB
	bool "Network support library"
	default n
	depends on NET
	select IEEE802154_LIBMAC if WIRELESS_IEEE802154
	---help---
		Enable support for the network support library.

if NETUTILS_NETLIB

config NETUTILS_NETLIB_GENERICURLPARSER
	bool "Build the generic URL parser"
	default n
	---help---
		If this option is selected, a generic URL parser
		is included in the build. It is more flexible than
		the basic netlib_parsehttpurl routine.
endif
```

## netutils/nng/Kconfig
```kconfig
#
# For a description of the syntax of this configuration file,
# see the file kconfig-language.txt in the NuttX tools repository.
#

config NETUTILS_NNG
	bool "Enable Nanomsg NG"
	default n
	---help---
		Enable Nanomsg-NG library. NNG is a lightweight, broker-less library,
		offering a simple API to solve common recurring messaging problems,
		such as publish/subscribe, RPC-style request/reply, or service discovery.

if NETUTILS_NNG

config NETUTILS_NNG_VERSION
	string "NNG Version"
	default "1.5.2"

config NETUTILS_NNG_HAVE_EPOLL
	bool "Build with epoll"
	default n
	---help---
		If this option is selected, an epoll based poll gueue
		is included in the build. Otherwise poll based queue
		is included in the build.

choice
	prompt "TLS engine"
	default NETUTILS_NNG_USE_NONE

config NETUTILS_NNG_USE_NONE
	bool "None"

config NETUTILS_NNG_USE_MBEDTLS
	bool "MbedTLS"
	select CRYPTO_MBEDTLS

endchoice # TLS engine

endif
```

## netutils/ntpclient/Kconfig
```kconfig
#
# For a description of the syntax of this configuration file,
# see the file kconfig-language.txt in the NuttX tools repository.
#

config NETUTILS_NTPCLIENT
	bool "NTP client"
	default n
	depends on NET_UDP && NET_SOCKOPTS
	---help---
		Enable support for the minimal NTP client.

if NETUTILS_NTPCLIENT

config NETUTILS_NTPCLIENT_SERVER
	string "NTP server hostnames"
	default "0.pool.ntp.org;1.pool.ntp.org;2.pool.ntp.org"
	depends on LIBC_NETDB
	---help---
		List of NTP server hostnames to use. Server names need to
		be separated by ';'.

config NETUTILS_NTPCLIENT_SERVERIP
	hex "NTP server IP address"
	default 0x0a000001
	depends on !LIBC_NETDB
	---help---
		Warning: this is deprecated option. Suitable only for testing.
		Never use this in real NuttX products!

		Use of hardcoded IP address for NTP server is known bad
		practice:

		  https://en.wikipedia.org/wiki/NTP_server_misuse_and_abuse

config NETUTILS_NTPCLIENT_PORTNO
	int "NTP server port number"
	default 123

config NETUTILS_NTPCLIENT_STACKSIZE
	int "NTP client daemon stack stack size"
	default DEFAULT_TASK_STACKSIZE

config NETUTILS_NTPCLIENT_SERVERPRIO
	int "NTP client daemon priority"
	default 100

config NETUTILS_NTPCLIENT_STAY_ON
	bool "Make NTP client keep polling"
	default y

config NETUTILS_NTPCLIENT_POLLDELAYSEC
	int "NTP client poll interval (seconds)"
	default 60
	depends on NETUTILS_NTPCLIENT_STAY_ON

config NETUTILS_NTPCLIENT_RETRIES
	int "NTP client retry seconds to wait for network up"
	default 60

config NETUTILS_NTPCLIENT_NUM_SAMPLES
	int "NTP client number of samples collected for filter"
	default 5

config NETUTILS_NTPCLIENT_SIGWAKEUP
	int "NTP client wakeup signal number"
	default 18

config NETUTILS_NTPCLIENT_WITH_AUTH
	bool "NTP client with authentication"
	default n

endif # NETUTILS_NTPCLIENT
```

## netutils/ping/Kconfig
```kconfig
#
# For a description of the syntax of this configuration file,
# see the file kconfig-language.txt in the NuttX tools repository.
#

config NETUTILS_PING
	bool "ICMP ping support"
	default n
	depends on NET_ICMP
	---help---
		Build in support for a IPv4 ping command.  This command ping will
		send the ICMP ECHO_REQUEST and wait for the ICMP ECHO_RESPONSE from
		the remote peer.

 config NETUTILS_PING6
	bool "ICMPv6 ping support"
	default n
	depends on NET_ICMPv6
	---help---
		Build in support for a IPv6 ping command.  This command ping will
		send the ICMPv6 ECHO_REQUEST and wait for the ICMPv6 ECHO_RESPONSE
		from the remote peer.
```

## netutils/plcatool/Kconfig
```kconfig
#
# For a description of the syntax of this configuration file,
# see the file kconfig-language.txt in the NuttX tools repository.
#

config NETUTILS_PLCATOOL
	bool "plcatool support"
	default n
	---help---
		Build in support for the plcatool command. This command allows configuring
                the PLCA access method in 10BASE-T1S network adapters supporting PLCA.
                Syntax of the plcatool is inspired by the corresponding syntax used by the ethtool.
```

## netutils/pppd/Kconfig
```kconfig
#
# For a description of the syntax of this configuration file,
# see the file kconfig-language.txt in the NuttX tools repository.
#

config NETUTILS_PPPD
	bool "PPP server"
	default n
	select NETUTILS_CHAT
	select NET_TUN
	depends on NET && NET_UDP
	---help---
		Enable support for the PPP daemon.

if NETUTILS_PPPD

config NETUTILS_PPPD_PAP
	bool "PPP PAP Authentication Support"
	default n
	---help---
		Enable PAP Authentication for ppp connection, this requires
		authentication credentials to be supplied.

endif # NETUTILS_PPPD
```

## netutils/rexec/Kconfig
```kconfig
#
# For a description of the syntax of this configuration file,
# see the file kconfig-language.txt in the NuttX tools repository.
#

config NETUTILS_REXEC
	tristate "Remote execution client"
	default n
	---help---
		Enable support for the remote execution client.

if NETUTILS_REXEC

config NETUTILS_REXEC_PRIORITY
	int "Remote execution client task priority"
	default 100

config NETUTILS_REXEC_STACKSIZE
	int "Remote execution client stack size"
	default DEFAULT_TASK_STACKSIZE

endif
```

## netutils/rexecd/Kconfig
```kconfig
#
# For a description of the syntax of this configuration file,
# see the file kconfig-language.txt in the NuttX tools repository.
#

config NETUTILS_REXECD
	tristate "Remote Execution Server"
	default n
	---help---
		Enable support for the Remote Execution server.

if NETUTILS_REXECD

config NETUTILS_REXECD_PRIORITY
	int "Remote execution server task priority"
	default 100

config NETUTILS_REXECD_STACKSIZE
	int "Remote execution server task stack size"
	default DEFAULT_TASK_STACKSIZE

endif
```

## netutils/rtptools/Kconfig
```kconfig
#
# For a description of the syntax of this configuration file,
# see the file kconfig-language.txt in the NuttX tools repository.
#

config NETUTILS_RTPTOOLS
	bool "Enable RTP Tools"
	default n
	---help---
		RTP Tools is a set of small applications
		that can be used for processing RTP data.

if NETUTILS_RTPTOOLS

config NETUTILS_RTPTOOLS_VERSION
	string "RTP Tools version"
	default "9356740cb0c264577e0f9505e682e53a1e0996d5"

menuconfig RTPTOOLS_APPS
	tristate "RTP Tools Applications"
	default y
	---help---
		Enable RTP Tools Applications

if RTPTOOLS_APPS

config NETUTILS_RTPTOOLS_DEFAULT_TASK_STACKSIZE
	int "RTP Tools apps default stack size"
	default 12288

config NETUTILS_RTPTOOLS_RTPPLAY
	bool "Enable rtpplay"
	default n
	---help---
		Play back RTP sessions recorded by rtpdump.

if NETUTILS_RTPTOOLS_RTPPLAY

config NETUTILS_RTPTOOLS_RTPPLAY_PROGNAME
	string "Program name"
	default "rtpplay"
	---help---
		This is the name of the program that will be used.

config NETUTILS_RTPTOOLS_RTPPLAY_PRIORITY
	int "rtpplay task priority"
	default 100

config NETUTILS_RTPTOOLS_RTPPLAY_STACKSIZE
	int "rtpplay stack size"
	default NETUTILS_RTPTOOLS_DEFAULT_TASK_STACKSIZE

endif # NETUTILS_RTPTOOLS_RTPPLAY

config NETUTILS_RTPTOOLS_RTPSEND
	bool "Enable rtpsend"
	default n
	---help---
		Generate RTP packets from textual description,
		generated by hand or rtpdump.

if NETUTILS_RTPTOOLS_RTPSEND

config NETUTILS_RTPTOOLS_RTPSEND_PROGNAME
	string "Program name"
	default "rtpsend"
	---help---
		This is the name of the program that will be used.

config NETUTILS_RTPTOOLS_RTPSEND_PRIORITY
	int "rtpsend task priority"
	default 100

config NETUTILS_RTPTOOLS_RTPSEND_STACKSIZE
	int "rtpsend stack size"
	default NETUTILS_RTPTOOLS_DEFAULT_TASK_STACKSIZE

endif # NETUTILS_RTPTOOLS_RTPSEND

config NETUTILS_RTPTOOLS_RTPDUMP
	bool "Enable rtpdump"
	default y
	---help---
		Parse and print RTP packets, generating output
		files suitable for rtpplay and rtpsend.

if NETUTILS_RTPTOOLS_RTPDUMP

config NETUTILS_RTPTOOLS_RTPDUMP_PROGNAME
	string "Program name"
	default "rtpdump"
	---help---
		This is the name of the program that will be used.

config NETUTILS_RTPTOOLS_RTPDUMP_PRIORITY
	int "rtpdump task priority"
	default 100

config NETUTILS_RTPTOOLS_RTPDUMP_STACKSIZE
	int "rtpdump stack size"
	default NETUTILS_RTPTOOLS_DEFAULT_TASK_STACKSIZE

endif # NETUTILS_RTPTOOLS_RTPDUMP

config NETUTILS_RTPTOOLS_RTPTRANS
	bool "Enable rtptrans"
	default n
	---help---
		RTP translator between unicast and multicast networks.

if NETUTILS_RTPTOOLS_RTPTRANS

config NETUTILS_RTPTOOLS_RTPTRANS_PROGNAME
	string "Program name"
	default "rtptrans"
	---help---
		This is the name of the program that will be used.

config NETUTILS_RTPTOOLS_RTPTRANS_PRIORITY
	int "rtptrans task priority"
	default 100

config NETUTILS_RTPTOOLS_RTPTRANS_STACKSIZE
	int "rtptrans stack size"
	default NETUTILS_RTPTOOLS_DEFAULT_TASK_STACKSIZE

endif # NETUTILS_RTPTOOLS_RTPTRANS

endif # RTPTOOLS_APPS

endif # NETUTILS_RTPTOOLS
```

## netutils/smtp/Kconfig
```kconfig
#
# For a description of the syntax of this configuration file,
# see the file kconfig-language.txt in the NuttX tools repository.
#

config NETUTILS_SMTP
	bool "SMTP"
	default n
	depends on NET_IPv4
	depends on NET_TCP
	---help---
		Enable support for SMTP.

if NETUTILS_SMTP
endif
```

## netutils/telnetc/Kconfig
```kconfig
#
# For a description of the syntax of this configuration file,
# see the file kconfig-language.txt in the NuttX tools repository.
#

config NETUTILS_TELNETC
	bool "Telnet client library"
	default n
	depends on NET && NET_TCP
	---help---
		Enable support for the libtelnet.  This is a public domain
		Telnet client library available from https://github.com/seanmiddleditch/libtelnet
		modified for use with NuttX.  Original Authors:

			Sean Middleditch <sean@sourcemud.org>
			Jack Kelly <endgame.dos@gmail.com>
			Katherine Flavel <kate@elide.org>

if NETUTILS_TELNETC
endif
```

## netutils/tftpc/Kconfig
```kconfig
#
# For a description of the syntax of this configuration file,
# see the file kconfig-language.txt in the NuttX tools repository.
#

config NETUTILS_TFTPC
	bool "TFTP client"
	default n
	depends on NET_UDP && NET_IPv4
	---help---
		Enable support for the TFTP client.

if NETUTILS_TFTPC
endif
```

## netutils/usrsock_rpmsg/Kconfig
```kconfig
#
# For a description of the syntax of this configuration file,
# see the file kconfig-language.txt in the NuttX tools repository.
#

config NETUTILS_USRSOCK_RPMSG
	tristate "RPMSG usrsock"
	default n
	depends on NET && RPTUN
	select EVENT_FD if !NET_USRSOCK
	---help---
		Enable usrsock through rpmsg channel.

if NETUTILS_USRSOCK_RPMSG

config NETUTILS_USRSOCK_RPMSG_PRIORITY
	int "usrsock task priority"
	default 80
	---help---
		The priority for usrsock task.

config NETUTILS_USRSOCK_RPMSG_STACKSIZE
	int "usrsock task stack size"
	default DEFAULT_TASK_STACKSIZE
	---help---
		The stack size allocated for the usrsock task.

config NETUTILS_USRSOCK_NSOCK_DESCRIPTORS
	int "The maximum number of socket descriptors for usrsock monitoring"
	default 64
	---help---
		The maximum number of socket description for usrsosck monitoring.

config NETUTILS_USRSOCK_NIOVEC
	int "The maximum number of I/O vector for reassemble buffer"
	default 8
	---help---
		The maximum number of I/O vector for reassemble buffer.

endif # NETUTILS_USRSOCK_RPMSG
```

## netutils/wakaama/Kconfig
```kconfig
#
# For a description of the syntax of this configuration file,
# see the file kconfig-language.txt in the NuttX tools repository.
#

config NETUTILS_WAKAAMA
	bool "Eclipse Wakaama"
	default n
	depends on ALLOW_ECLIPSE_COMPONENTS
	---help---
		Enable Eclipse Wakaama (formerly liblwm2m) - an implementation
		of LWM2M protocol.

if NETUTILS_WAKAAMA

config WAKAAMA_VERSION
	string "Wakaama version"
	default "bf81d0827b6e4f369c8022f9d23c1600b8d4c528"

config WAKAAMA_COAP_DEFAULT_BLOCK_SIZE
	int "Wakaama LWM2M COAP default block size"
	default 1024

config WAKAAMA_CLIENT_MODE
	bool "Wakaama client mode"
	default n

config WAKAAMA_SERVER_MODE
	bool "Wakaama server mode"
	default n

config WAKAAMA_BOOTSTRAP
	bool "Wakaama bootstrap"
	default n

config WAKAAMA_OLD_CONTENT_FORMAT_SUPPORT
	bool "Wakaama old content format support"
	default n

config WAKAAMA_TLV
	bool "Wakaama TLV support"
	default n

config WAKAAMA_JSON
	bool "Wakaama JSON support"
	default n

config WAKAAMA_SENML_JSON
	bool "Wakaama SenML JSON support"
	default n

menuconfig WAKAAMA_EXAMPLES
	bool "Wakaama examples"

if WAKAAMA_EXAMPLES

if WAKAAMA_CLIENT_MODE

choice
	prompt "Wakaama clinet example"
	default WAKAAMA_EXAMPLE_CLIENT_LIGHT

config WAKAAMA_EXAMPLE_CLIENT_LIGHT
	bool "Wakaama light client example"

config WAKAAMA_EXAMPLE_CLIENT
	bool "Wakaama client example"

config WAKAAMA_EXAMPLE_CLIENT_DTLS
	bool "Wakaama client DTLS example"
	depends on CRYPTO_TINYDTLS

endchoice # "Wakaama clinet example"

config WAKAAMA_EXAMPLE_CLIENT_STACKSIZE
	int "Wakaama client example stack size"
	default 8192

endif # WAKAAMA_CLIENT_MODE

endif # WAKAAMA_EXAMPLES

endif # NETUTILS_WAKAAMA
```

## netutils/wakeonlan/Kconfig
```kconfig
#
# For a description of the syntax of this configuration file,
# see the file kconfig-language.txt in the NuttX tools repository.
#

config NETUTILS_WAKEONLAN
	bool "WakeOnLAN support"
	default n
	depends on NET_UDP && NET_SOCKOPTS
	---help---
		Enable the wake on LAN command "wol".  This command
		sends a WakeOnLAN magic packet to target MAC address.

if NETUTILS_WAKEONLAN

config NETUTILS_WAKEONLAN_PROGNAME
	string "Program name"
	default "wol"
	---help---
		This is the name of the program that will be used when the NSH ELF
		program is installed.

config NETUTILS_WAKEONLAN_PRIORITY
	int "WakeOnLAN task priority"
	default 100

config NETUTILS_WAKEONLAN_STACKSIZE
	int "WakeOnLAN stack size"
	default DEFAULT_TASK_STACKSIZE

endif
```

## netutils/webclient/Kconfig
```kconfig
#
# For a description of the syntax of this configuration file,
# see the file kconfig-language.txt in the NuttX tools repository.
#

config NETUTILS_WEBCLIENT
	bool "uIP web client"
	default n
	depends on NET_TCP
	select LIBC_NETDB
	select NET_SOCKOPTS
	select NETUTILS_NETLIB_GENERICURLPARSER
	---help---
		Enable support for the uIP web client.

if NETUTILS_WEBCLIENT

config NSH_WGET_USERAGENT
	string "wget User Agent"
	default "NuttX/6.xx.x (; http://www.nuttx.org/)"

config WEBCLIENT_TIMEOUT
	int "Request and receive timeouts"
	default 10

config WEBCLIENT_MAXHTTPLINE
	int "Max http line size"
	default 200

config WEBCLIENT_MAXMIMESIZE
	int "Max mime size"
	default 32

config WEBCLIENT_MAXHOSTNAME
	int "Max host name size"
	default 40

config WEBCLIENT_MAXFILENAME
	int "Max file name size"
	default 100

endif
```
