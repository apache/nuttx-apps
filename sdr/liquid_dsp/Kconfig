## sdr/liquid_dsp/Kconfig
```kconfig
#
# For a description of the syntax of this configuration file,
# see the file kconfig-language.txt in the NuttX tools repository.
#

config SDR_LIQUID_DSP
	bool "Liquid DSP Library"
	default n
	---help---
		Enable the Liquid DSP Library - https://liquidsdr.org
```

## sensors/accel_calib/Kconfig
```kconfig
#
# For a description of the syntax of this configuration file,
# see the file kconfig-language.txt in the NuttX tools repository.
#

config SENSORS_ACCEL_CALIB
	bool "Accelerometer calibration application"
	default n
	---help---
		Enable the accelerometer calibration application

if SENSORS_ACCEL_CALIB

config ACCEL_CALIB_SAMPLING_FREQ
	int "Accelerometer sampling frequency"
    default 50
    range 1 1000
	---help---
		Configure the sampling frequency of the accelerometer used to record
		calibration data points. Value is in Hz.

config ACCEL_CALIB_DELIM
	string "Output delimiter"
    default "	"
	---help---
		Select the delimeter used to separate X, Y, Z measurements. Leave empty for tab
		delimiting.

endif # SENSORS_ACCEL_CALIB
```

## sensors/netsensor/Kconfig
```kconfig
#
# For a description of the syntax of this configuration file,
# see the file kconfig-language.txt in the NuttX tools repository.
#

config SENSORS_NETSENSOR
	tristate "Netsensor"
	default n
	depends on UORB
	depends on USENSOR
	depends on NET_UDP
	---help---
		Program for a networked sensor that publishes data received over UDP as
		uORB topics.

if SENSORS_NETSENSOR

comment "Program options"

config SENSORS_NETSENSOR_PRIORITY
	int "Priority"
	default 100
	---help---
		The task priority for the netsensor process.

config SENSORS_NETSENSOR_STACKSIZE
	int "Stack size"
	default DEFAULT_TASK_STACKSIZE
	---help---
		The stack size for the netsensor process.

endif # SENSORS_NETSENSOR
```

## sensors/netsensor_stream/Kconfig
```kconfig
#
# For a description of the syntax of this configuration file,
# see the file kconfig-language.txt in the NuttX tools repository.
#

config SENSORS_NETSENSOR_STREAM
	tristate "Netsensor stream"
	default n
	depends on UORB
	depends on NET_UDP
	---help---
		Program to stream uORB data over UDP in a format which can be
		interpreted by the netsensor.

if SENSORS_NETSENSOR_STREAM

comment "Program options"

config SENSORS_NETSENSOR_STREAM_PRIORITY
	int "Priority"
	default 100
	---help---
		The task priority for the netsensor_stream process.

config SENSORS_NETSENSOR_STREAM_STACKSIZE
	int "Stack size"
	default DEFAULT_TASK_STACKSIZE
	---help---
		The stack size for the netsensor_stream process.

endif # SENSORS_NETSENSOR_STREAM
```

## system/Kconfig
```kconfig
#
# For a description of the syntax of this configuration file,
# see the file kconfig-language.txt in the NuttX tools repository.
#

menu "System Libraries and NSH Add-Ons"

source "$APPSDIR/system/free/Kconfig"
source "$APPSDIR/system/cle/Kconfig"
source "$APPSDIR/system/cu/Kconfig"
source "$APPSDIR/system/install/Kconfig"
source "$APPSDIR/system/flash_eraseall/Kconfig"
source "$APPSDIR/system/hex2bin/Kconfig"
source "$APPSDIR/system/i2c/Kconfig"
source "$APPSDIR/system/hexed/Kconfig"
source "$APPSDIR/system/netdb/Kconfig"
source "$APPSDIR/system/nxplayer/Kconfig"
source "$APPSDIR/system/ramtest/Kconfig"
source "$APPSDIR/system/readline/Kconfig"
source "$APPSDIR/system/prun/Kconfig"
source "$APPSDIR/system/mdio/Kconfig"
source "$APPSDIR/system/sudoku/Kconfig"
source "$APPSDIR/system/lm75/Kconfig"
source "$APPSDIR/system/vi/Kconfig"
source "$APPSDIR/system/sched_note/Kconfig"
source "$APPSDIR/system/stackmonitor/Kconfig"
source "$APPSDIR/system/symtab/Kconfig"
source "$APPSDIR/system/cdcacm/Kconfig"
source "$APPSDIR/system/composite/Kconfig"
source "$APPSDIR/system/ubloxmodem/Kconfig"
source "$APPSDIR/system/usbmsc/Kconfig"
source "$APPSDIR/system/usbmonitor/Kconfig"
source "$APPSDIR/system/zmodem/Kconfig"
source "$APPSDIR/system/zoneinfo/Kconfig"

endmenu # System Libraries and NSH Add-Ons
```

## system/adb/Kconfig
```kconfig
#
# For a description of the syntax of this configuration file,
# see the file kconfig-language.txt in the NuttX tools repository.
#

menuconfig SYSTEM_ADBD
	tristate "ADB daemon application"
	default n
	depends on LIBUV
	select LIBC_PRINT_EXTENSION
	---help---
		Enable support for adb daemon.

if SYSTEM_ADBD

config ADBD_PROGNAME
	string "Program name"
	default "adbd"
	---help---
		This is the name of the program that will be used.

config ADBD_STACKSIZE
	int "Stack size"
	default DEFAULT_TASK_STACKSIZE
	---help---
		The size of stack allocated for the adb daemon task.

config ADBD_PRIORITY
	int "Task priority"
	default 100
	---help---
		The priority of the adb daemon task.

config ADBD_AUTHENTICATION
	bool "Authentication support"
	default n
	---help---
		Enable authentication for adb daemon.

if ADBD_AUTHENTICATION

config ADBD_AUTH_PUBKEY
	bool "Public key authentication"
	default n
	---help---
		Enable hook to accept new public keys.

config ADBD_TOKEN_SIZE
	int "Authentication token size"
	default 20

endif # ADBD_AUTHENTICATION

config ADBD_DEVICE_ID
	string "Default adb device id"
	depends on !BOARDCTL_UNIQUEID
	default ""

config ADBD_PRODUCT_NAME
	string "Default adb product name"
	default "adb dev"

config ADBD_PRODUCT_MODEL
	string "Default adb product model"
	default "adb board"

config ADBD_PRODUCT_DEVICE
	string "Default adb product device"
	default "NuttX device"

config ADBD_FEATURES
	string "Default adb server features list"
	default "cmd"

config ADBD_PAYLOAD_SIZE
	int "Normal ADB frame size"
	default 1024
	---help---
		Normal frame size in bytes.

config ADBD_CNXN_PAYLOAD_SIZE
	int "Connection frame size"
	default 1024
	---help---
		Connection frame is bigger than others.
		Can be between 128 to 256 bytes in most of the cases.
		If authentication is enabled, frame size must bigger
		to receive public key from host (around 1024 bytes).

config ADBD_FRAME_MAX
	int "Frame pool size"
	default 1
	---help---
		ADB frame pool size.

config ADBD_TCP_SERVER
	bool "Network socket transport support"
	depends on NET_TCP
	default n
	---help---
		Run adb daemon on network socket.

config ADBD_TCP_SERVER_PORT
	int "Network socket transport port"
	depends on ADBD_TCP_SERVER
	default 5555
	---help---
		Port used by adb daemon socket server

config ADBD_USB_SERVER
	bool "USB transport support"
	depends on USBADB
	default n
	---help---
		Run adb daemon on USB bus

choice
	prompt "Check usb hotplug"
	default ADBD_USB_HOTPLUG_BYTIMER

config ADBD_USB_HOTPLUG_BYTIMER
	bool "Using 1s timer to check usb hotplug"
	depends on ADBD_USB_SERVER
	---help---
		Using 1s timer to check usb hotplug

config ADBD_USB_HOTPLUG_BYNOTIFY
	bool "Using fs notify to check usb hotplug"
	depends on ADBD_USB_SERVER
	depends on FS_NOTIFY
	---help---
		Using fs notify to monitor usb hotplug

endchoice # Check usb hotplug

config ADBD_QEMU_SERVER
	bool "QEMU pipe transport support"
	depends on GOLDFISH_PIPE
	default n
	---help---
		Run adb daemon on qemu pipe

config ADBD_QEMU_SERVER_PORT
	int "QEMU pipe transport port"
	depends on ADBD_QEMU_SERVER
	default 5555
	---help---
		Port used by adb daemon qemu pipe server

config ADBD_LOGCAT_SERVICE
	bool "ADB logcat support"
	select LIBC_PRINT_EXTENSION
	depends on RAMLOG_SYSLOG
	default n
	---help---
		Enable "adb logcat" feature.

config ADBD_FILE_SERVICE
	bool "ADB file sync support"
	default n
	---help---
		Enable "adb ls/push/pull" feature.

config ADBD_FILE_SYMLINK
	bool "File service symlink support"
	depends on ADBD_FILE_SERVICE
	depends on PSEUDOFS_SOFTLINKS
	default PSEUDOFS_SOFTLINKS
	---help---
		Enable fs symlink support.

config ADBD_SHELL_SERVICE
	bool "ADB shell support"
	depends on SYSTEM_NSH
	depends on LIBC_EXECFUNCS
	depends on PSEUDOTERM
	default n
	---help---
		Enable "adb shell" feature.

config ADBD_SHELL_SERVICE_CMD
	string "ADB shell command"
	depends on ADBD_SHELL_SERVICE
	default "sh"
	---help---
		The shell command name.

config ADBD_SHELL_SERVICE_PATH
	string "ADB shell path"
	depends on ADBD_SHELL_SERVICE
	default "/bin/sh"
	---help---
		The path to the shell executable.

config ADBD_SOCKET_SERVICE
	bool "ADB socket service"
	depends on NET
	default n
	---help---
		Enable "adb forward|reverse" feature.

config ADBD_BOARD_INIT
	bool "Board initialization"
	depends on BOARDCTL
	default n
	---help---
		Setup board before running adb daemon.

config ADBD_USB_BOARDCTL
	bool "USB Board Control"
	depends on BOARDCTL
	depends on ADBD_USB_SERVER
	select BOARDCTL_USBDEVCTRL
	default ADBD_BOARD_INIT
	---help---
		Connect usbdev before running adb daemon.

config ADBD_NET_INIT
	bool "Network initialization"
	default n
	depends on NET
	select NETUTILS_NETINIT
	---help---
		This option enables/disables all network initialization in ADB server.

endif # SYSTEM_ADBD
```

## system/adcscope/Kconfig
```kconfig
#
# For a description of the syntax of this configuration file,
# see the file kconfig-language.txt in the NuttX tools repository.
#

menuconfig SYSTEM_ADCSCOPE
	bool "NxScope ADC stream app"
	default n
	depends on ADC && LOGGING_NXSCOPE

if SYSTEM_ADCSCOPE

config SYSTEM_ADCSCOPE_PROGNAME
	string "Program name"
	default "adcscope"

config SYSTEM_ADCSCOPE_PRIORITY
	int "adcscope task priority"
	default 100

config SYSTEM_ADCSCOPE_STACKSIZE
	int "adcscope stack size"
	default DEFAULT_TASK_STACKSIZE

config SYSTEM_ADCSCOPE_SERIAL_PATH
	string "adcscope serial device path"
	default "/dev/ttyUSB0"

config SYSTEM_ADCSCOPE_SERIAL_BAUD
	int "adcscope serial baud"
	default 115200
	---help---
		Ignored if set to 0 (for example for RTT interface)

config SYSTEM_ADCSCOPE_CDCACM
	bool "adcscope CDCACM device support"
	depends on CDCACM
	default n

config SYSTEM_ADCSCOPE_FORCE_ENABLE
	bool "adcscope force enable"
	default n

config SYSTEM_ADCSCOPE_STREAMBUF_LEN
	int "adcscope stream buffer length"
	default 512

config SYSTEM_ADCSCOPE_RXBUF_LEN
	int "adcscope RX buffer length"
	default 32

config SYSTEM_ADCSCOPE_RX_PADDING
	int "adcscope RX padding"
	default 0
	---help---
		This value is returned by NxScope protocol to the client and can
		be used to optimize RX transfers when the target supports DMA transfers.
		In this case this value should be equal to the DMA RX buffer length.

config SYSTEM_ADCSCOPE_MAIN_INTERVAL
	int "adcscope main interval (microseconds)"
	default 100000
	---help---
		This value is responsible for the frequency at which stream
		frames will be sent and incoming frames will be received.

config SYSTEM_ADCSCOPE_FETCH_INTERVAL
	int "adcscope fetch interval (microseconds)"
	default 1000
	---help---
		This value is responsible for the frequency at which the ADC
		samples are read. If set to 0, then samples are read at maximum rate.

config SYSTEM_ADCSCOPE_ADC_PATH
	string "adcscope ADC device path"
	default "/dev/adc0"

config SYSTEM_ADCSCOPE_ADCBUF_LEN
	int "adcscope buffer length"
	default ADC_FIFOSIZE
	---help---
		The number of samples in the buffer used to read from the ADC device.
		This is the maximum number of samples that can be read from the ADC
		device during one read() operation.

config SYSTEM_ADCSCOPE_SWTRIG
	bool "adcscope uses software trigger"
	default n
	---help---
		When this option is set, all read() operations on the ADC device will
		be preceded by an ioctl(ANIOC_TRIGGER) call.

choice
	prompt "adcscope data type"
	default SYSTEM_ADCSCOPE_INT16

config SYSTEM_ADCSCOPE_INT16
	bool "pack ADC data as int16_t"
	---help---
		NxScope send ADC samples as int16_t data.

config SYSTEM_ADCSCOPE_INT32
	bool "pack ADC data as int32_t"
	---help---
		NxScope send ADC samples as int32_t data.

endchoice # "adcscope data type"

endif # SYSTEM_ADCSCOPE
```

## system/argtable3/Kconfig
```kconfig
#
# For a description of the syntax of this configuration file,
# see the file kconfig-language.txt in the NuttX tools repository.
#

config SYSTEM_ARGTABLE3
	bool "ARGTABLE3 library"
	default n
	---help---
		Enables the ARGTABLE3 library.

if SYSTEM_ARGTABLE3

config SYSTEM_ARGTABLE3_VERSION
	string "ARGTABLE3 Version"
	default "3.2.0.7402e6e"

config SYSTEM_ARGTABLE3_TEST
	tristate "System Argtable3 Test"
	default n
	---help---
		test application for argtable3

if SYSTEM_ARGTABLE3_TEST

config SYSTEM_ARGTABLE3_TEST_PROGNAME
	string "Test program name"
	default "argtable3_test"
	---help---
		Argtable3 test application name

config SYSTEM_ARGTABLE3_TEST_PRIORITY
	int "Test application priority"
	default 100

config SYSTEM_ARGTABLE3_TEST_STACKSIZE
	int "Test application stack size"
	default DEFAULT_TASK_STACKSIZE

endif

endif
```

## system/batterydump/Kconfig
```kconfig
#
# For a description of the syntax of this configuration file,
# see the file kconfig-language.txt in the NuttX tools repository.
#
#
config SYSTEM_BATTERYDUMP
	tristate "Battery dump system tool"
	default n
	---help---
		Enable the battery dump

if SYSTEM_BATTERYDUMP

config SYSTEM_BATTERYDUMP_PROGNAME
	string "Program name"
	default "batterydump"
	---help---
		This is the name of the program that will be used when the NSH ELF
		program is installed.

config SYSTEM_BATTERYDUMP_PRIORITY
	int "Battery dump task priority"
	default 100

config SYSTEM_BATTERYDUMP_STACKSIZE
	int "Battery dump stack size"
	default DEFAULT_TASK_STACKSIZE

endif
```

## system/cachespeed/Kconfig
```kconfig
#
# For a description of the syntax of this configuration file,
# see the file kconfig-language.txt in the NuttX tools repository.
#

config SYSTEM_CACHESPEED
	tristate "CACHE Speed Test"
	default n
	---help---
		Enable a simple CACHE speed test.

if SYSTEM_CACHESPEED

config SYSTEM_CACHESPEED_PROGNAME
	string "Program name"
	default "cachespeed"
	---help---
		This is the name of the program that will be used when the NSH ELF
		program is installed.

config SYSTEM_CACHESPEED_PRIORITY
	int "CACHE speed test task priority"
	default 100

config SYSTEM_CACHESPEED_STACKSIZE
	int "CACHE speed test stack size"
	default DEFAULT_TASK_STACKSIZE

endif
```
