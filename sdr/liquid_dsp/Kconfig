## system/dd/Kconfig
```kconfig
#
# For a description of the syntax of this configuration file,
# see the file kconfig-language.txt in the NuttX tools repository.
#

config SYSTEM_DD
	tristate "system 'dd' command"
	default !DEFAULT_SMALL
	---help---
		Enable support for the system 'dd' command.

if SYSTEM_DD

config SYSTEM_DD_PROGNAME
	string "dd program name"
	default "dd"
	---help---
		This is the name of the program that will be used when the dd
		program is installed.

config SYSTEM_DD_PRIORITY
	int "dd task priority"
	default 100

config SYSTEM_DD_STACKSIZE
	int "dd stack size"
	default DEFAULT_TASK_STACKSIZE

config SYSTEM_DD_STATS
	bool "dd: Support transfer statistics"
	default y

endif
```

## system/debug/Kconfig
```kconfig
#
# For a description of the syntax of this configuration file,
# see the file kconfig-language.txt in the NuttX tools repository.
#

config SYSTEM_DEBUG
	tristate "Debugpoint utility"
	default n
	depends on ARCH_HAVE_DEBUG
	depends on LIB_GDBSTUB
	---help---
		Enable the DEBUG test program. It is a simple
		utility for testing the debug point support and
		add debug points to the system by command line.

if SYSTEM_DEBUG

config SYSTEM_DEBUG_PROGNAME
	string "Program name"
	default "debug"
	---help---
		This is the name of the program that will be used when the NSH ELF
		program is installed.

config SYSTEM_DEBUG_PRIORITY
	int "Task priority"
	default 100

config SYSTEM_DEBUG_STACKSIZE
	int "Stack size"
	default DEFAULT_TASK_STACKSIZE

endif
```

## system/debugpoint/Kconfig
```kconfig
#
# For a description of the syntax of this configuration file,
# see the file kconfig-language.txt in the NuttX tools repository.
#

config SYSTEM_DEBUGPOINT
	tristate "Debugpoint utility"
	default n
	depends on ARCH_HAVE_DEBUG
	depends on LIB_GDBSTUB
	---help---
		Enable the DEBUGPOINT test program. It is a simple
		utility for testing the debug point support and
		add debug points to the system by command line.

if SYSTEM_DEBUGPOINT

config SYSTEM_DEBUGPOINT_PROGNAME
	string "Program name"
	default "debugpoint"
	---help---
		This is the name of the program that will be used when the NSH ELF
		program is installed.

config SYSTEM_DEBUGPOINT_PRIORITY
	int "Task priority"
	default 100

config SYSTEM_DEBUGPOINT_STACKSIZE
	int "Stack size"
	default DEFAULT_TASK_STACKSIZE

endif
```

## system/dhcp6c/Kconfig
```kconfig
#
# For a description of the syntax of this configuration file,
# see the file kconfig-language.txt in the NuttX tools repository.
#

config SYSTEM_DHCPC_RENEW6
	tristate "DHCP IPv6 Address Renewal"
	default n
	select NETUTILS_DHCP6C
	depends on NET_UDP && NET_IPv6 && NET_ICMPv6_AUTOCONF
	---help---
		Enable the DHCP client 'renew6' command

if SYSTEM_DHCPC_RENEW6

config DHCPC_RENEW6_PROGNAME
	string "Program dhcpv6 name"
	default "renew6"
	---help---
		This is the name of the program that will be used when the NSH ELF
		program is installed.

config DHCPC_RENEW6_PRIORITY
	int "DHCPC6 task priority"
	default 100

config DHCPC_RENEW6_STACKSIZE
	int "DHCPC6 stack size"
	default DEFAULT_TASK_STACKSIZE

endif
```
