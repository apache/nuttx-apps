## system/cdcacm/Kconfig
```kconfig
#
# For a description of the syntax of this configuration file,
# see the file kconfig-language.txt in the NuttX tools repository.
#

menuconfig SYSTEM_CDCACM
	tristate "USB CDC/ACM Device Commands"
	default n
	depends on LIB_BOARDCTL && CDCACM
	select BOARDCTL_USBDEVCTRL
	---help---
		Enable the USB CDC/ACM class controls.  These controls include:

		sercon:  Connect the mass storage device to the host
		serdis:  Disconnect the mass storage device to the host

if SYSTEM_CDCACM

config SYSTEM_CDCACM_DEVMINOR
	int "CDC/ACM Minor Device Number"
	default 0
	---help---
		The minor device number of the serial driver for the CDC/ACM device.
		For example, N in /dev/ttyACMN.  Used for registering the serial
		driver. Default is zero.

config SYSTEM_CDCACM_TRACEINIT
	bool "USB Trace Initialization"
	default n
	depends on USBDEV_TRACE || DEBUG_USB
	---help---
		If USBDEV_TRACE is enabled (or CONFIG_DEBUG_FEATURES and CONFIG_DEBUG_USB),
		then the add-on code will also manage the USB trace output.  The
		amount of trace output can be controlled this configuration value:
		This setting will show USB initialization events

config SYSTEM_CDCACM_TRACECLASS
	bool "USB Trace Class"
	default n
	depends on USBDEV_TRACE || DEBUG_USB
	---help---
		If USBDEV_TRACE is enabled (or CONFIG_DEBUG_FEATURES and CONFIG_DEBUG_USB),
		then the add-on code will also manage the USB trace output.  The
		amount of trace output can be controlled this configuration value:
		This setting will show USB class driver events

config SYSTEM_CDCACM_TRACETRANSFERS
	bool "USB Trace Transfers"
	default n
	depends on USBDEV_TRACE || DEBUG_USB
	---help---
		If USBDEV_TRACE is enabled (or CONFIG_DEBUG_FEATURES and CONFIG_DEBUG_USB),
		then the add-on code will also manage the USB trace output.  The
		amount of trace output can be controlled this configuration value:
		This setting will show USB data transfer events

config SYSTEM_CDCACM_TRACECONTROLLER
	bool "USB Trace Device Controller Events"
	default n
	depends on USBDEV_TRACE || DEBUG_USB
	---help---
		If USBDEV_TRACE is enabled (or CONFIG_DEBUG_FEATURES and CONFIG_DEBUG_USB),
		then the add-on code will also manage the USB trace output.  The
		amount of trace output can be controlled this configuration value:
		This setting will show USB device controller events

config SYSTEM_CDCACM_TRACEINTERRUPTS
	bool "USB Trace Device Controller Interrupt Events"
	default n
	depends on USBDEV_TRACE || DEBUG_USB
	---help---
		If USBDEV_TRACE is enabled (or CONFIG_DEBUG_FEATURES and CONFIG_DEBUG_USB),
		then the add-on code will also manage the USB trace output.  The
		amount of trace output can be controlled this configuration value:
		This setting will show USB device controller interrupt-related events.

endif
```

## system/cfgdata/Kconfig
```kconfig
#
# For a description of the syntax of this configuration file,
# see the file kconfig-language.txt in the NuttX tools repository.
#

config SYSTEM_CFGDATA
	tristate "Cfgdata Command"
	default n
	depends on MTD_CONFIG
	---help---
		Enable support for the CFGDATA tool.

if SYSTEM_CFGDATA

config SYSTEM_CFGDATA_STACKSIZE
	int "Builtin task stack size"
	default DEFAULT_TASK_STACKSIZE
	---help---
		Size of the task to configure when started cfgdata from NSH

config SYSTEM_CFGDATA_PRIORITY
	int "Builtin task priority"
	default 100
	---help---
		Priority of the task to configure when started cfgdata from NSH

endif
```

## system/cle/Kconfig
```kconfig
#
# For a description of the syntax of this configuration file,
# see the file kconfig-language.txt in the NuttX tools repository.
#

menuconfig SYSTEM_CLE
	bool "EMACS-like Command Line Editor"
	default n
	---help---
		Enable support for NuttX tiny EMACS-like command line editor.

		Omitted features:
			- No keypad cursor control support
			- No word oriented operations.

		Assumptions and Limitations:
			- A VT100 host terminal is assumed.
			- A fixed width character set (like Courier) is assumed

		Memory Usage:  Looks like 1.5-2KB

if SYSTEM_CLE

config SYSTEM_CLE_CMD_HISTORY
	bool "Command line history"
	default n
	---help---
		Build in support for Unix-style command history using up and down
		arrow keys.  This feature was originally provided by Nghia Ho.

		NOTE: Command line history is kept in an in-memory array and is
		shared.  In the FLAT or PROTECTED builds, this history is shared by
		all threads; in the KERNEL build, the command line history is shared
		by all threads in the process.  This means that in a FLAT build, for
		example, a built-in application started from NSH will have the same
		history as does NSH if it also uses the CLE.  This also means
		that different NSH sessions on serial, USB, or Telnet will also
		share the same history array.

		In a KERNEL build, each process will have a separately allocated
		history array so the issue is lessened.  History would still be
		shared amount pthreads within the same process, however.

if SYSTEM_CLE_CMD_HISTORY

config SYSTEM_CLE_CMD_HISTORY_LINELEN
	int "Command line history length"
	default 64 if DEFAULT_SMALL
	default 80 if !DEFAULT_SMALL
	---help---
		The maximum length of one command line in the in-memory array.  The
		total memory usage for the command line array will be
		SYSTEM_CLE_CMD_HISTORY_LINELEN x SYSTEM_CLE_CMD_HISTORY_LEN. Default:
		64/80

config SYSTEM_CLE_CMD_HISTORY_LEN
	int "Command line history records"
	default 4 if DEFAULT_SMALL
	default 16 if !DEFAULT_SMALL
	---help---
		The number of lines of history that will be buffered in the in-
		memory array.  The total memory usage for the command line array
		will be SYSTEM_CLE_CMD_HISTORY_LINELEN x SYSTEM_CLE_CMD_HISTORY_LEN.
		Default: 16

endif # SYSTEM_CLE_CMD_HISTORY

config SYSTEM_CLE_DEBUGLEVEL
	int "Debug level"
	default 0
	range 0 2
	---help---
		0=Debug off; 1=Print errors on console; 2=Print debug information
		on the console.

		Debug output is generated with syslog.  The editor works on
		/dev/console.  In order to get both a usable display and also
		readable debug output, syslog'ing should sent to some device other
		than /dev/console (which is the default).

endif # SYSTEM_CLE
```

## system/composite/Kconfig
```kconfig
#
# For a description of the syntax of this configuration file,
# see the file kconfig-language.txt in the NuttX tools repository.
#

menuconfig SYSTEM_COMPOSITE
	tristate "USB Composite Device Commands"
	default n
	depends on LIB_BOARDCTL && USBDEV_COMPOSITE && BUILD_FLAT
	select BOARDCTL_USBDEVCTRL
	---help---
		Enable the USB composite class controls.  These controls include:

		conn:  Connect the mass storage device to the host
		disconn:  Disconnect the mass storage device to the host

if SYSTEM_COMPOSITE

config SYSTEM_COMPOSITE_DEFCONFIG
	int "Default composite configuration"
	default 0
	---help---
		Boards may support multiple composite configurations.  If so, then
		this is the default configuration that the conn command will use if
		no configuration ID is provided on the command line.

if USBDEV_TRACE || DEBUG_USB

config SYSTEM_COMPOSITE_TRACEINIT
	bool "USB Trace Initialization"
	default n
	---help---
		If USBDEV_TRACE is enabled (or CONFIG_DEBUG_FEATURES and CONFIG_DEBUG_USB),
		then the add-on code will also manage the USB trace output.  The
		amount of trace output can be controlled this configuration value:
		This setting will show USB initialization events

config SYSTEM_COMPOSITE_TRACECLASS
	bool "USB Trace Class"
	default n
	---help---
		If USBDEV_TRACE is enabled (or CONFIG_DEBUG_FEATURES and CONFIG_DEBUG_USB),
		then the add-on code will also manage the USB trace output.  The
		amount of trace output can be controlled this configuration value:
		This setting will show USB class driver events

config SYSTEM_COMPOSITE_TRACETRANSFERS
	bool "USB Trace Transfers"
	default n
	---help---
		If USBDEV_TRACE is enabled (or CONFIG_DEBUG_FEATURES and CONFIG_DEBUG_USB),
		then the add-on code will also manage the USB trace output.  The
		amount of trace output can be controlled this configuration value:
		This setting will show USB data transfer events

config SYSTEM_COMPOSITE_TRACECONTROLLER
	bool "USB Trace Device Controller Events"
	default n
	---help---
		If USBDEV_TRACE is enabled (or CONFIG_DEBUG_FEATURES and CONFIG_DEBUG_USB),
		then the add-on code will also manage the USB trace output.  The
		amount of trace output can be controlled this configuration value:
		This setting will show USB device controller events

config SYSTEM_COMPOSITE_TRACEINTERRUPTS
	bool "USB Trace Device Controller Interrupt Events"
	default n
	---help---
		If USBDEV_TRACE is enabled (or CONFIG_DEBUG_FEATURES and CONFIG_DEBUG_USB),
		then the add-on code will also manage the USB trace output.  The
		amount of trace output can be controlled this configuration value:
		This setting will show USB device controller interrupt-related events.

endif # USBDEV_TRACE || DEBUG_USB

config SYSTEM_COMPOSITE_DEBUGMM
	bool "Memory usage debug"
	default n
	---help---
		Enables some debug tests to check for memory usage and memory leaks.

endif
```

## system/conntrack/Kconfig
```kconfig
#
# For a description of the syntax of this configuration file,
# see the file kconfig-language.txt in the NuttX tools repository.
#

config SYSTEM_CONNTRACK
	tristate "conntrack command"
	default n
	depends on NETLINK_NETFILTER
	select SYSTEM_ARGTABLE3
	---help---
		Enable support for the 'conntrack' command, a simple tool like
		Linux's 'conntrack', only supports printing NAT connections now.

if SYSTEM_CONNTRACK

config SYSTEM_CONNTRACK_PROGNAME
	string "conntrack program name"
	default "conntrack"
	---help---
		This is the name of the program that will be used when the NSH ELF
		program is installed.

config SYSTEM_CONNTRACK_PRIORITY
	int "conntrack task priority"
	default 100

config SYSTEM_CONNTRACK_STACKSIZE
	int "conntrack stack size"
	default DEFAULT_TASK_STACKSIZE

endif
```

## system/coredump/Kconfig
```kconfig
#
# For a description of the syntax of this configuration file,
# see the file kconfig-language.txt in the NuttX tools repository.
#

menuconfig SYSTEM_COREDUMP
	tristate "Coredump tool capture system status"
	default n
	depends on COREDUMP

if SYSTEM_COREDUMP

config SYSTEM_COREDUMP_STACKSIZE
	int "coredump stack size"
	default DEFAULT_TASK_STACKSIZE
	---help---
		This is the stack size that will be used when starting the coredump.

config SYSTEM_COREDUMP_PRIORITY
	int "coredump priority"
	default 254
	---help---
		This is the task priority that will be used when starting the coredump.

config SYSTEM_COREDUMP_SWAPBUFFER_SIZE
	int "coredump read/write swap buffer size"
	default 16384
	---help---
		The coredump read/write swap buffer size in bytes.

config SYSTEM_COREDUMP_RESTORE
	bool "coredump restore from block/mtd device to filesystem"
	default BOARD_COREDUMP_BLKDEV || BOARD_COREDUMP_MTDDEV
	---help---
		Userspace restore from block/mtd device to specific filesystem path.

config SYSTEM_COREDUMP_DEVPATH
	string "coredump block device path to restore"
	depends on SYSTEM_COREDUMP_RESTORE
	default BOARD_COREDUMP_DEVPATH if BOARD_COREDUMP_BLKDEV || BOARD_COREDUMP_MTDDEV
	---help---
		This is the block device path to restore.

endif # SYSTEM_COREDUMP
```

## system/cpuload/Kconfig
```kconfig
#
# For a description of the syntax of this configuration file,
# see the file kconfig-language.txt in the NuttX tools repository.
#

config SYSTEM_CPULOAD
	tristate "cpuload test"
	default n
```

## system/critmon/Kconfig
```kconfig
#
# For a description of the syntax of this configuration file,
# see the file kconfig-language.txt in the NuttX tools repository.
#

menuconfig SYSTEM_CRITMONITOR
	tristate "Critcal Section Monitor"
	default n
	depends on FS_PROCFS && !FS_PROCFS_EXCLUDE_PROCESS && SCHED_CRITMONITOR
	---help---
		If the critical section monitor is enabled (CONFIGSCHED_CRITMONITOR)
		this option will enable a critical section monitor daemon.  This daemon
		that will periodically assess usage of critical sections by all tasks
		and threads in the system.

if SYSTEM_CRITMONITOR

config SYSTEM_CRITMONITOR_STACKSIZE
	int "Critical section monitor stop/stop stack size"
	default DEFAULT_TASK_STACKSIZE
	---help---
		The stack size to use the critmon_start/critmon_stop task.  Default: 2048

config SYSTEM_CRITMONITOR_PRIORITY
	int "Critical section monitor stop/stop priority"
	default 100
	---help---
		The priority to use the critmon_start/critmon_stop task.  Default: 100

config SYSTEM_CRITMONITOR_DAEMON_STACKSIZE
	int "Critical section monitor daemon stack size"
	default DEFAULT_TASK_STACKSIZE
	---help---
		The stack size to use the critical section monitor daemon.  Default: 2048

config SYSTEM_CRITMONITOR_DAEMON_PRIORITY
	int "Critical section monitor daemon priority"
	default 50
	---help---
		The priority to use the stack monitor daemon.  Default: 50

config SYSTEM_CRITMONITOR_INTERVAL
	int "Critical section monitor dump frequency"
	default 2
	---help---
		The rate in seconds that the Critical section monitor will wait before
		dumping the next set Critical section information.  Default:  2 seconds.

config SYSTEM_CRITMONITOR_MOUNTPOINT
	string "procfs mountpoint"
	default "/proc"

endif
```

## system/cu/Kconfig
```kconfig
#
# For a description of the syntax of this configuration file,
# see misc/tools/kconfig-language.txt.
#

config SYSTEM_CUTERM
	bool "CU serial terminal"
	default n
	---help---
		Enable the CU serial terminal.  This is a minimalistic
		implementation of the 'cu' terminal program (part of Taylor UUCP for
		ages). Using it, you can simply open a serial port and interact with
		it. Using '~.' you can leave the terminal program and drop back to nsh.

		This terminal might come in handy for other people that have e.g. GS
		modems, GPS receivers or other devices with text based serial
		communications attached to their Nuttx systems.

if SYSTEM_CUTERM

config SYSTEM_CUTERM_STACKSIZE
	int "CU terminal stack size"
	default 2048
	---help---
		This is the stack size that will be used when starting the CU terminal.

config SYSTEM_CUTERM_PRIORITY
	int "CU terminal priority"
	default 100
	---help---
		This is the task priority that will be used when starting the CU terminal.

endif # SYSTEM_CUTERM
```

## system/curl/Kconfig
```kconfig
#
# For a description of the syntax of this configuration file,
# see the file kconfig-language.txt in the NuttX tools repository.
#

config SYSTEM_CURL
	tristate "curl HTTP command"
	default n
	depends on NETUTILS_WEBCLIENT
	---help---
		Enable the "curl" command: a small command-line HTTP client
		supporting GET and POST (and other methods via -X), custom
		headers (-H), a raw request body (-d, including -d @file) and
		multipart/form-data file uploads (-F name=@file), built on top
		of the netutils webclient library. HTTP only (no HTTPS).

if SYSTEM_CURL

config SYSTEM_CURL_PROGNAME
	string "Program name"
	default "curl"
	---help---
		This is the name of the program that will be used when the
		NSH ELF program is installed.

config SYSTEM_CURL_PRIORITY
	int "curl task priority"
	default 100

config SYSTEM_CURL_STACKSIZE
	int "curl stack size"
	default DEFAULT_TASK_STACKSIZE

config SYSTEM_CURL_BUFFERSIZE
	int "curl transfer buffer size"
	default 512
	---help---
		Size of the buffer used to hold the request/response headers and
		to stream body data. It must be large enough to hold the whole
		request header line and the whole response header.

endif
```
