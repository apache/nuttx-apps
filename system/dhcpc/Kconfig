## system/hex2bin/Kconfig
```kconfig
#
# For a description of the syntax of this configuration file,
# see misc/tools/kconfig-language.txt.
#

menuconfig SYSTEM_HEX2BIN
	bool "Intel HEX to binary conversion"
	default n
	---help---
		Enable support for a logic to convert Intel HEX format to binary.

if SYSTEM_HEX2BIN

config SYSTEM_HEX2BIN_BUILTIN
	bool "NSH hex2bin Built-In"
	default n
	depends on NSH_BUILTIN_APPS
	---help---
		By default, a flexible hex2bin library function built.  An NSH
		builtin function can also be generated to convert Intel HEX file
		to binary files.

if SYSTEM_HEX2BIN_BUILTIN

config SYSTEM_HEX2BIN_STACKSIZE
	int "hex2bin stack size"
	default 1536
	---help---
		The size of stack allocated for the hex2bin task.

config SYSTEM_HEX2BIN_PRIORITY
	int "hex2bin priority"
	default 100
	---help---
		The priority of the hex2bin task.

config SYSTEM_HEX2BIN_BASEADDR
	hex "Binary base address"
	default 0x00000000
	---help---
		The default value of the base address argument.  Saves typing.

config SYSTEM_HEX2BIN_ENDPADDR
	hex "Binary base address"
	default 0x00000000
	---help---
		The default value of the end (plus 1) address argument.  Saves typing.

config SYSTEM_HEX2BIN_SWAP
	int "Swap bytes"
	default 0
	range 0 2
	---help---
		The default value of the swap argument.  (0) No swap, (1) swap bytes
		in 16-bit values, or (2) swap bytes in 32-bit values.

config SYSTEM_HEX2BIN_USAGE
	bool "hex2bin usage"
	default y
	---help---
		You can save a little FLASH memory by suppressing usage
		instructions.

endif # SYSTEM_HEX2BIN_BUILTIN

config SYSTEM_HEX2MEM_BUILTIN
	bool "NSH hex2mem Built-In"
	default n
	depends on NSH_BUILTIN_APPS
	---help---
		By default, a flexible hex2bin library function built.  An NSH
		builtin function can also be generated to copy Intel HEX files
		to memory.

if SYSTEM_HEX2MEM_BUILTIN

config SYSTEM_HEX2MEM_STACKSIZE
	int "hex2mem stack size"
	default 1536
	---help---
		The size of stack allocated for the hex2bin task.

config SYSTEM_HEX2MEM_PRIORITY
	int "hex2mem priority"
	default 100
	---help---
		The priority of the hex2bin task.

config SYSTEM_HEX2MEM_BASEADDR
	hex "Binary base address"
	default 0x00000000
	---help---
		The default value of the base address argument.  Saves typing.

config SYSTEM_HEX2MEM_ENDPADDR
	hex "Binary base address"
	default 0x00000000
	---help---
		The default value of the end (plus 1) address argument.  Saves typing.

config SYSTEM_HEX2MEM_SWAP
	int "Binary base address"
	default 0
	range 0 2
	---help---
		The default value of the swap argument.  (0) No swap, (1) swap bytes
		in 16-bit values, or (2) swap tbytes in 32-bit values.

config SYSTEM_HEX2MEM_USAGE
	bool "hex2mem usage"
	default y
	---help---
		You can save a little FLASH memory by suppressing usage
		instructions.

endif # SYSTEM_HEX2MEM_BUILTIN

config SYSTEM_HEX2BIN_DEBUG
	bool "Hex2bin detailed error output"
	default n
	---help---
		Enable extended error output.

endif # SYSTEM_HEX2BIN
```

## system/hexed/Kconfig
```kconfig
#
# For a description of the syntax of this configuration file,
# see the file kconfig-language.txt in the NuttX tools repository.
#

menuconfig SYSTEM_HEXED
	tristate "Hex editor"
	default n
	---help---
		Enable support for the hexed command line hexadecial file editor

if SYSTEM_HEXED

config SYSTEM_HEXED_STACKSIZE
	int "hexed stack size"
	default 2048
	---help---
		The size of stack allocated for the hexed task.

config SYSTEM_HEXED_PRIORITY
	int "hexed priority"
	default 100
	---help---
		The priority of the hexed task.

endif # SYSTEM_HEXED
```

## system/hostname/Kconfig
```kconfig
#
# For a description of the syntax of this configuration file,
# see the file kconfig-language.txt in the NuttX tools repository.
#

config SYSTEM_HOSTNAME
	tristate "'hostname' command"
	default n
	---help---
		Enable the hostname tool

if SYSTEM_HOSTNAME
endif
```

## system/i2c/Kconfig
```kconfig
#
# For a description of the syntax of this configuration file,
# see the file kconfig-language.txt in the NuttX tools repository.
#


menuconfig SYSTEM_I2CTOOL
	tristate "I2C tool"
	default n
	depends on I2C
	select I2C_DRIVER
	---help---
		Enable support for the I2C tool.

if SYSTEM_I2CTOOL

config I2CTOOL_MINBUS
	int "Minimum bus number"
	default 0
	---help---
		Smallest bus index supported by the hardware (default 0).

config I2CTOOL_MAXBUS
	int "Maximum bus number"
	default 3
	---help---
		Largest bus index supported by the hardware (default 3)

config I2CTOOL_MINADDR
	hex "Minimum I2C address"
	default 0x03
	---help---
		Minimum 7-bit device address (default: 0x03)

config I2CTOOL_MAXADDR
	hex "Maximum I2C address"
	default 0x77
	---help---
		Largest 7-bit device address (default: 0x77)

config I2CTOOL_MAXREGADDR
	hex "Maximum I2C register address"
	default 0xff
	---help---
		Largest I2C register address (default: 0xff)

config I2CTOOL_DEFFREQ
	int "Default I2C frequency"
	default 400000
	---help---
		Default I2C frequency (default: 400000)

endif # SYSTEM_I2CTOOL
```

## system/i3c/Kconfig
```kconfig
#
# For a description of the syntax of this configuration file,
# see the file kconfig-language.txt in the NuttX tools repository.
#

menuconfig SYSTEM_I3CTOOL
	tristate "I3C tool"
	default n
	depends on I3C
	select I3C_DRIVER
	---help---
		Enable support for the I3C tool.

if SYSTEM_I3CTOOL

config I3CTOOL_DEF_TARGETADDR
	hex "Default I3C device target address"
	default 0xffff
	---help---
		Default I3C device target address (default: 0xffff)

config I3CTOOL_DEFBUS
	int "Default I2C bus number"
	default 0
	---help---
		Default I3C bus number (default: 0)

endif
```

## system/inifile/Kconfig
```kconfig
#
# For a description of the syntax of this configuration file,
# see misc/tools/kconfig-language.txt.
#

menuconfig SYSTEM_INIFILE
	bool "INI File Parser"
	default n
	---help---
		Enable support for a simple INI file parser.

if SYSTEM_INIFILE

config SYSTEM_INIFILE_MAXLINE
	int "Max line length"
	default 256
	---help---
		The largest line that the parser can expect to see in an INI file.

config SYSTEM_INIFILE_DEBUGLEVEL
	int "Debug level"
	default 0
	range 0 2
	---help---
		0=Debug off; 1=Print errors on console; 2=Print debug information
		on the console.

endif # SYSTEM_INIFILE
```

## system/init/Kconfig
~~~~kconfig
#
# For a description of the syntax of this configuration file,
# see the file kconfig-language.txt in the NuttX tools repository.
#

config SYSTEM_INIT
	tristate "System Init"
	default n
	depends on LIBC_EXECFUNCS
	depends on SCHED_CHILD_STATUS
	---help---
		Enable system init.

if SYSTEM_INIT

#
# Basic
#

config SYSTEM_INIT_PRIORITY
	int "Thread priority"
	default 100

config SYSTEM_INIT_STACKSIZE
	int "Stack size"
	default DEFAULT_TASK_STACKSIZE

config SYSTEM_INIT_PROGNAME
	string "Program name"
	default "init"

#
# RC
#

config SYSTEM_INIT_RC_LINE_MAX
	int "Max line length of RC file"
	default 128
	---help---
		Maximum line length of RC file.
		More details: https://android.googlesource.com/platform/system/core/+/master/init/README.md

#
# Action
#

config SYSTEM_INIT_ACTION_CMD_ARGS_MAX
	int "Max number of command arguments"
	default 8
	---help---
		Maximum number of command arguments.
		Form:
		```
		on <trigger>
		   <command>
		   <command>
		   <command>
		   ...
		```

config SYSTEM_INIT_ACTION_WARN_SLOW
	int "Warn if command takes too long"
	default 50
	depends on SYSTEM_INIT_WARN
	---help---
		Warning if command took more than `SYSTEM_INIT_ACTION_WARN_SLOW` ms.

config SYSTEM_INIT_ACTION_MANAGER_EVENT_MAX
	int "Max number of action manager events"
	default 32
	---help---
		Maximum number of action manager events.
		```
		struct action_manager_s
		{
		  ...
		  FAR char *events[CONFIG_SYSTEM_INIT_ACTION_MANAGER_EVENT_MAX];
		  ...
		};
		```

#
# Service
#

config SYSTEM_INIT_SERVICE_ARGS_MAX
	int "Max number of service arguments"
	default 8
	range 3 64
	---help---
		Maximum number of service arguments,
		including "name", "pathname" and key word "service"(at least 3). Form:
		```
		service <name> <pathname> [ <argument> ]*
		   <option>
		   <option>
		   ...
		```

config SYSTEM_INIT_SERVICE_RESTART_PERIOD
	int "Service restart period in ms"
	default 5000

#
# Log level
#

config SYSTEM_INIT_ERR
	bool "Enable error log"
	default !DEFAULT_SMALL

config SYSTEM_INIT_WARN
	bool "Enable warning log"
	depends on SYSTEM_INIT_ERR

config SYSTEM_INIT_INFO
	bool "Enable info log"
	depends on SYSTEM_INIT_WARN

config SYSTEM_INIT_DEBUG
	bool "Enable debug log"
	depends on SYSTEM_INIT_INFO

endif
~~~~

## system/input/Kconfig
```kconfig
#
# For a description of the syntax of this configuration file,
# see the file kconfig-language.txt in the NuttX tools repository.
#

menuconfig SYSTEM_INPUT
	tristate "Enable input tool"
	default n
	select INPUT_UINPUT
	---help---
		Enable support for a command line input tool.

if SYSTEM_INPUT

config SYSTEM_INPUT_STACKSIZE
	int "system/input stack size"
	default DEFAULT_TASK_STACKSIZE
	---help---
		The size of stack allocated for the input task.

config SYSTEM_INPUT_PRIORITY
	int "input priority"
	default 100
	---help---
		The priority of the input task.


endif # SYSTEM_INPUT
```

## system/install/Kconfig
```kconfig
#
# For a description of the syntax of this configuration file,
# see misc/tools/kconfig-language.txt.
#

config SYSTEM_INSTALL
	bool "FLASH Program Installation"
	default n
	---help---
		Enable support for the FLASH installation tool.

if SYSTEM_INSTALL
endif
```

## system/iptables/Kconfig
```kconfig
#
# For a description of the syntax of this configuration file,
# see the file kconfig-language.txt in the NuttX tools repository.
#

config SYSTEM_IPTABLES
	tristate "'iptables' command"
	default n
	depends on NET_IPTABLES && NET_IPv4
	select NETUTILS_NETLIB
	---help---
		Enable support for the 'iptables' command.

config SYSTEM_IP6TABLES
	tristate "'ip6tables' command"
	default n
	depends on NET_IPTABLES && NET_IPv6
	select NETUTILS_NETLIB
	---help---
		Enable support for the 'ip6tables' command.

if SYSTEM_IPTABLES || SYSTEM_IP6TABLES

config SYSTEM_IPTABLES_PRIORITY
	int "iptables & ip6tables task priority"
	default 100

config SYSTEM_IPTABLES_STACKSIZE
	int "iptables & ip6tables stack size"
	default DEFAULT_TASK_STACKSIZE

endif
```

## system/irtest/Kconfig
```kconfig
#
# For a description of the syntax of this configuration file,
# see the file kconfig-language.txt in the NuttX tools repository.
#

config SYSTEM_IRTEST
	tristate "IR driver test"
	default n
	depends on DRIVERS_RC
	---help---
		Enable the IR driver test

if SYSTEM_IRTEST

config SYSTEM_IRTEST_PROGNAME
	string "Program name"
	default "irtest"
	---help---
		This is the name of the program that will be used when the NSH ELF
		program is installed.

config SYSTEM_IRTEST_PRIORITY
	int "IR driver test task priority"
	default 100

config SYSTEM_IRTEST_STACKSIZE
	int "IR driver test stack size"
	default DEFAULT_TASK_STACKSIZE

config SYSTEM_IRTEST_MAX_NIRDEV
	int "The Maximum number of IR devices supported"
	default 2

config SYSTEM_IRTEST_MAX_SIRDATA
	int "The Maximum size of sending data in unsigned int"
	default 64

endif
```

## system/libarchive/Kconfig
```kconfig
#
# For a description of the syntax of this configuration file,
# see the file kconfig-language.txt in the NuttX tools repository.
#

config UTILS_LIBARCHIVE
	tristate "libarchive"
	default n

if UTILS_LIBARCHIVE

config UTILS_LIBARCHIVE_BSDUNZIP
	bool "Enable bsdunzip"
	depends on LIB_ZLIB
	default n

if UTILS_LIBARCHIVE_BSDUNZIP

config UTILS_LIBARCHIVE_BSDUNZIP_PROGNAME
	string "Programe Name"
	default "bsdunzip"

config UTILS_LIBARCHIVE_BSDUNZIP_PRIORITY
	int "bsdunzip priority"
	default 100

config UTILS_LIBARCHIVE_BSDUNZIP_STACKSIZE
	int "bsdunzip stacksize"
	default DEFAULT_TASK_STACKSIZE

endif

config UTILS_LIBARCHIVE_BSDTAR
	bool "Enable bsdtar"
	depends on LIBC_REGEX
	depends on PIPES
	depends on LIBC_EXECFUNCS
	default n

if UTILS_LIBARCHIVE_BSDTAR

config UTILS_LIBARCHIVE_BSDTAR_PROGNAME
	string "Programe Name"
	default "bsdtar"

config UTILS_LIBARCHIVE_BSDTAR_PRIORITY
	int "bsdtar priority"
	default 100

config UTILS_LIBARCHIVE_BSDTAR_STACKSIZE
	int "bsdtar stacksize"
	default DEFAULT_TASK_STACKSIZE

endif

config UTILS_LIBARCHIVE_BSDCAT
	bool "Enable bsdcat"
	depends on LIBC_REGEX
	depends on PIPES
	depends on LIBC_EXECFUNCS
	default n

if UTILS_LIBARCHIVE_BSDCAT

config UTILS_LIBARCHIVE_BSDCAT_PROGNAME
	string "Programe Name"
	default "bsdcat"

config UTILS_LIBARCHIVE_BSDCAT_PRIORITY
	int "bsdcat priority"
	default 100

config UTILS_LIBARCHIVE_BSDCAT_STACKSIZE
	int "bsdcat stacksize"
	default DEFAULT_TASK_STACKSIZE

endif

config UTILS_LIBARCHIVE_CPIO
	bool "Enable cpio"
	depends on PSEUDOFS_SOFTLINKS
	depends on PIPES
	depends on DEV_FIFO_SIZE > 0
	depends on LIBC_EXECFUNCS
	default n

if UTILS_LIBARCHIVE_CPIO

config UTILS_LIBARCHIVE_CPIO_PROGNAME
	string "Programe Name"
	default "cpio"

config UTILS_LIBARCHIVE_CPIO_PRIORITY
	int "cpio priority"
	default 100

config UTILS_LIBARCHIVE_CPIO_STACKSIZE
	int "cpio stacksize"
	default 32768

endif

config UTILS_LIBARCHIVE_MINITAR
	bool "Enable minitar"
	default n

if UTILS_LIBARCHIVE_MINITAR

config UTILS_LIBARCHIVE_MINITAR_PROGNAME
	string "Programe Name"
	default "minitar"

config UTILS_LIBARCHIVE_MINITAR_PRIORITY
	int "minitar priority"
	default 100

config UTILS_LIBARCHIVE_MINITAR_STACKSIZE
	int "minitar stacksize"
	default DEFAULT_TASK_STACKSIZE

endif

config UTILS_LIBARCHIVE_TARFILTER
	bool "Enable tarfilter"
	default n

if UTILS_LIBARCHIVE_TARFILTER

config UTILS_LIBARCHIVE_TARFILTER_PROGNAME
	string "Programe Name"
	default "tarfilter"

config UTILS_LIBARCHIVE_TARFILTER_PRIORITY
	int "tarfilter priority"
	default 100

config UTILS_LIBARCHIVE_TARFILTER_STACKSIZE
	int "tarfilter stacksize"
	default DEFAULT_TASK_STACKSIZE

endif

config UTILS_LIBARCHIVE_UNTAR
	bool "Enable untar"
	default n

if UTILS_LIBARCHIVE_UNTAR

config UTILS_LIBARCHIVE_UNTAR_PROGNAME
	string "Programe Name"
	default "untar"

config UTILS_LIBARCHIVE_UNTAR_PRIORITY
	int "untar priority"
	default 100

config UTILS_LIBARCHIVE_UNTAR_STACKSIZE
	int "untar stacksize"
	default DEFAULT_TASK_STACKSIZE

endif

endif
```

## system/libffi/Kconfig
```kconfig
#
# For a description of the syntax of this configuration file,
# see the file kconfig-language.txt in the NuttX tools repository.
#

config LIB_LIBFFI
	bool "libffi"
	default n
	---help---
		Enable the libffi Foreign Function Interface library. libffi
		provides a portable way to call C functions with arguments
		determined at runtime. It is required by CPython's _ctypes module.

if LIB_LIBFFI

config LIB_LIBFFI_VERSION
	string "libffi commit hash"
	default "9760868682cc9a33008761f158d86481d56738aa"
	---help---
		Git commit hash of the libffi repository to download and build.
		The source is fetched from https://github.com/libffi/libffi at
		the specified commit.

endif # LIB_LIBFFI
```
