## system/gnsspps/Kconfig
```kconfig
#
# For a description of the syntax of this configuration file,
# see the file kconfig-language.txt in the NuttX tools repository.
#

config SYSTEM_GNSSPPS
	tristate "GNSS PPS clock discipline (gnsspps)"
	default n
	depends on PTP_CLOCK && CLOCK_ADJTIME
	---help---
		Discipline a PTP clock (/dev/ptpX) to the PPS output of a GNSS
		receiver.  Each PPS edge is time stamped in hardware by an
		external time stamp (EXTTS) input of the clock, for example
		the PPS disciplined software clock PTP_PPS, and a PI servo
		steers the clock frequency to align it with the pulses.  The
		whole seconds are taken from the NMEA RMC/ZDA sentences of
		the receiver.  Optionally CLOCK_REALTIME follows the clock.

		Boards that each run gnsspps with their own GNSS receiver (or
		a shared PPS signal) end up on the same UTC time scale.

if SYSTEM_GNSSPPS

config SYSTEM_GNSSPPS_PROGNAME
	string "Program name"
	default "gnsspps"

config SYSTEM_GNSSPPS_PRIORITY
	int "gnsspps task priority"
	default 200
	---help---
		The time stamps are latched by hardware, so the priority does
		not affect the accuracy.  A high priority makes the frequency
		corrections happen right after each pulse.

config SYSTEM_GNSSPPS_STACKSIZE
	int "gnsspps stack size"
	default DEFAULT_TASK_STACKSIZE

config SYSTEM_GNSSPPS_DEVPATH
	string "Default PTP clock device"
	default "/dev/ptp0"

endif # SYSTEM_GNSSPPS
```

## system/kbd/Kconfig
```kconfig
#
# For a description of the syntax of this configuration file,
# see the file kconfig-language.txt in the NuttX tools repository.
#

config SYSTEM_KBD
	tristate "Keyboard dump"
	default n
	depends on INPUT_KEYBOARD
	---help---
		Dump what a keyboard reports.  This reads any keyboard registered
		with keyboard_register(), whatever the hardware behind it is, so it
		is the tool to reach for when bringing up a new keyboard.

		Replaces the hidkbd and keyboard examples, which did the same thing
		for one kind of keyboard each.

if SYSTEM_KBD

config SYSTEM_KBD_PROGNAME
	string "Program name"
	default "kbd"

config SYSTEM_KBD_PRIORITY
	int "Task priority"
	default 100

config SYSTEM_KBD_STACKSIZE
	int "Task stack size"
	default DEFAULT_TASK_STACKSIZE

config SYSTEM_KBD_DEVPATH
	string "Keyboard device path"
	default "/dev/kbd0"
	---help---
		The keyboard to read when none is named on the command line.

endif
```

## system/nxinit/Kconfig
~~~~kconfig
#
# For a description of the syntax of this configuration file,
# see the file kconfig-language.txt in the NuttX tools repository.
#

config SYSTEM_NXINIT
	tristate "NuttX Init"
	default n
	depends on EXPERIMENTAL
	depends on LIBC_EXECFUNCS
	depends on SCHED_CHILD_STATUS
	---help---
		Enable NxInit(NuttX Init) component for system initialization.
		The script of NxInit(init.rc) is compatible with the Android Init Language syntax.

if SYSTEM_NXINIT

comment "NXInit Basic"

config SYSTEM_NXINIT_PRIORITY
	int "Thread priority"
	default 100

config SYSTEM_NXINIT_STACKSIZE
	int "Stack size"
	default DEFAULT_TASK_STACKSIZE

config SYSTEM_NXINIT_PROGNAME
	string "Program name"
	default "init"

comment "NXInit Run Control(RC)"

config SYSTEM_NXINIT_RC_FILE_PATH
	string "Path to RC file"
	default "/etc/init.d/init.rc"
	---help---
		Path to the init.rc file to use for NXInit's boot logic.

config SYSTEM_NXINIT_RC_LINE_MAX
	int "Max line length of RC file"
	default 128
	range 64 4096
	---help---
		Maximum line length of RC file.
		More details: https://android.googlesource.com/platform/system/core/+/master/init/README.md

comment "NXInit Action"

config SYSTEM_NXINIT_ACTION_CMD_ARGS_MAX
	int "Max number of command arguments"
	default 8
	---help---
		Maximum number of command arguments.
		Form:
		```
		on <event> [&& <event>]*
		   <command>
		   <command>
		   <command>
		   ...
		```

config SYSTEM_NXINIT_ACTION_WARN_SLOW
	int "Slow command warning timeout"
	default 50
	depends on SYSTEM_NXINIT_WARN
	---help---
		Warning if command took more than `SYSTEM_NXINIT_ACTION_WARN_SLOW` ms.

config SYSTEM_NXINIT_ACTION_EVENTS_MAX
	int "Max number of events"
	default 2
	range 1 64
	---help---
		Maximum number of event and action events.
		See action.h:
		```
		struct action_s
		{
		  ...
		  struct action_event_s events[CONFIG_SYSTEM_NXINIT_ACTION_EVENTS_MAX];
		  ...
		};
		```
config SYSTEM_NXINIT_FINALINIT
	bool "Enable NXInit final event"
	default n
	---help---
		Enable support to run the "final" event. Currently only "boot",
		and "init" event are enabled by default, where "netinit" and
		"final" are optional.

comment "NXInit Service"

config SYSTEM_NXINIT_SERVICE_ARGS_MAX
	int "Max number of service arguments"
	default 16
	range 3 64
	---help---
		Maximum number of service arguments,
		including "name", "pathname" and key word "service"(at least 3). Form:
		```
		service <name> <pathname> [ <argument> ]*
		   <option>
		   <option>
		   ...
		```

config SYSTEM_NXINIT_SERVICE_RESTART_PERIOD
	int "Service restart period in ms"
	default 5000

comment "NXInit Testing"

config SYSTEM_NXINIT_TEST
	bool "NxInit unit tests"
	default n
	depends on TESTING_CMOCKA
	---help---
		Enable cmocka-based unit tests covering NxInit's argument/config
		parser, action event matching, and service conflict detection.
		Builds a separate "nxinit_unit_test" program. Under the CMake
		build the test sources compile into a dedicated target and the
		"init" program is unaffected; under the Make build the test
		sources are appended to the shared CSRCS list, so they are also
		linked into "init", enlarging it and pulling in the cmocka
		dependency. Keep this disabled for production Make builds.

if SYSTEM_NXINIT_TEST

config SYSTEM_NXINIT_TEST_PRIORITY
	int "Test task priority"
	default 100

config SYSTEM_NXINIT_TEST_STACKSIZE
	int "Test task stack size"
	default 8192
	---help---
		Several of the parser test cases build multi-hundred-byte
		buffers on the stack (e.g. lines several times
		CONFIG_SYSTEM_NXINIT_RC_LINE_MAX long) on top of cmocka's own
		framework overhead. On at least one real embedded target this
		overflowed the default DEFAULT_TASK_STACKSIZE (2048) silently
		(no crash dump, no watchdog reset, the test task just stopped
		producing output), which is far harder to diagnose than an
		outright test failure. 8192 has been verified to run all test
		cases cleanly on that target; lower it back down only if you
		have confirmed your target's stack usage stays within bounds.

endif # SYSTEM_NXINIT_TEST

comment "NXInit Log level"

config SYSTEM_NXINIT_ERR
	bool "Enable error log"
	default !DEFAULT_SMALL

config SYSTEM_NXINIT_WARN
	bool "Enable warning log"
	depends on SYSTEM_NXINIT_ERR

config SYSTEM_NXINIT_INFO
	bool "Enable info log"
	depends on SYSTEM_NXINIT_WARN

config SYSTEM_NXINIT_DEBUG
	bool "Enable debug log"
	depends on SYSTEM_NXINIT_INFO

config SYSTEM_NXINIT_STDOUT
	bool "Output log to stdout (printf)"
	default n
	---help---
		Debug option: redirect all init logs to stdout via printf
		instead of syslog. Useful when syslog is not available or
		serial console has no output during early boot.

endif
~~~~

## system/sudo/Kconfig
```kconfig
#
# For a description of the syntax of this configuration file,
# see the file kconfig-language.txt in the NuttX tools repository.
#

config SYSTEM_SUDO
	tristate "sudo (setuid privilege helper)"
	default n
	depends on SCHED_USER_IDENTITY
	depends on LIBC_PASSWD_FILE
	depends on FSUTILS_PASSWD
	depends on LIBC_EXECFUNCS
	---help---
		Install a Linux-style setuid-root ``sudo`` program.  The kernel
		raises the effective UID to zero when the ELF is loaded (see
		``nx_uid`` / ``nx_mode`` in Application.mk).  ``sudo`` verifies
		the invoking user's password with ``passwd_verify()``, becomes
		fully root via ``setresuid()`` / ``setresgid()``, then
		``execvp()``s the requested command.

		Requires ``CONFIG_LIBC_EXECFUNCS`` so NSH (or ``posix_spawn``)
		loads the application ELF instead of calling its entry point
		directly from the builtin registry.

		Non-root callers must appear in the sudoers file
		(``SYSTEM_SUDO_SUDOERS_PATH``) or in
		``SYSTEM_SUDO_ALLOWED_USERS``.  Real UID 0 is always allowed.

if SYSTEM_SUDO

config SYSTEM_SUDO_SUDOERS_PATH
	string "Path to sudoers allowlist"
	default "/etc/sudoers"
	---help---
		Simple allowlist, one username per line.  Lines starting with
		``#`` are comments.  A Linux-style first field is also accepted
		(``user ALL=(ALL) ALL``).  Generate this file in ROMFS with
		``CONFIG_BOARD_ETC_ROMFS_PASSWD_EXTRA_ENABLE``.

config SYSTEM_SUDO_ALLOWED_USERS
	string "Compile-time sudoers usernames"
	default ""
	---help---
		Optional comma-separated extra allowlist compiled into sudo.
		Use this when /etc/sudoers is not present.  Example: ``user``.

endif # SYSTEM_SUDO
```

## system/toybox/Kconfig
```kconfig
#
# For a description of the syntax of this configuration file,
# see the file kconfig-language.txt in the NuttX tools repository.
#

menuconfig SYSTEM_TOYBOX
	bool "Toybox command suite"
	default n
	depends on SCHED_WAITPID
	depends on SCHED_HAVE_PARENT
	depends on !DISABLE_PSEUDOFS_OPERATIONS
	---help---
		Download, patch and build Toybox (https://landley.net/toybox/), a
		0BSD-licensed multi-call binary providing a POSIX/LSB command suite
		and a small interactive shell.  Toybox is built as a single NuttX
		builtin application (PROGNAME=toybox) that can be run directly
		("toybox ls", "toybox cat file") or, with no arguments, as an
		interactive command prompt suitable for use as the system's
		CONFIG_INIT_ENTRYPOINT -- see boards/sim/sim/sim/configs/toybox for
		an example. Toybox runs standalone (no NSH required) while still
		being able to run whatever other NuttX builtin apps happen to be
		enabled, NSH included if the user also enables it. See
		Documentation/applications/system/toybox/ for details.

		Only the commands enabled below (see "Toybox commands") are
		compiled in.

if SYSTEM_TOYBOX

config SYSTEM_TOYBOX_VERSION
	string "Toybox version to download"
	default "0.8.14"
	---help---
		Upstream Toybox release tag to download and build against. The
		patches in apps/system/toybox/patch/ are written against this
		version; bumping it may require refreshing those patches.

config SYSTEM_TOYBOX_URL
	string "Toybox download URL"
	default "https://github.com/landley/toybox/archive/refs/tags"
	---help---
		Base URL Toybox release tarballs are downloaded from.

config SYSTEM_TOYBOX_PRIORITY
	int "Toybox task priority"
	default 100

config SYSTEM_TOYBOX_STACKSIZE
	int "Toybox stack size"
	default 8192

config SYSTEM_TOYBOX_BUILTIN_BRIDGE
	bool "Run other NuttX builtin apps from the Toybox prompt"
	default y
	select BUILTIN
	---help---
		When a command typed at the Toybox prompt isn't a Toybox applet,
		look it up in NuttX's registered builtin application table and run
		it if found. This is what lets "hello", "nsh" (if the user also
		enables CONFIG_SYSTEM_NSH) and any other app registered as a
		builtin (MODULE=y) run from the Toybox prompt without Toybox
		needing to know about them individually -- useful when
		CONFIG_INIT_ENTRYPOINT is
		"toybox_main" and Toybox is the only shell running. Selects
		CONFIG_BUILTIN (off by default in NuttX); nothing else is
		required -- NSH is not a dependency of Toybox in any direction.

		Toybox applets always take precedence over a same-named builtin.

menu "Toybox commands"

comment "Each option here is one Toybox applet. ../Makefile translates"
comment "whichever are enabled into the CONFIG_<CMD>=y file it feeds"
comment "to Toybox's own scripts/genconfig.sh at build time -- toggling"
comment "a command here is the whole mechanism, nothing else to sync."

source "$APPSDIR/system/toybox/Kconfig.commands"

endmenu # Toybox commands

endif # SYSTEM_TOYBOX
```
