## system/toybox/Kconfig.commands
```kconfig
#
# apps/system/toybox/Kconfig.commands
#
# One config per Toybox applet, sourced from apps/system/toybox/Kconfig's
# "Toybox commands" menu. Hand-maintained (unlike apps/Kconfig or
# apps/system/Kconfig, this file is NOT regenerated by tools/mkkconfig.sh),
# curated to applets known to build on NuttX. To add
# another command, add a "config SYSTEM_TOYBOX_CMD_<NAME>" block (all-caps
# applet name) matching the pattern below. The CMD_ segment is what lets
# ../Makefile tell actual commands apart from this directory's other
# SYSTEM_TOYBOX_* options (VERSION, BUILTIN_BRIDGE, ...) when it translates
# enabled commands into Toybox's own CONFIG_<NAME> form -- don't drop it.
#

config SYSTEM_TOYBOX_CMD_BASE64
	bool "base64"
	default y

config SYSTEM_TOYBOX_CMD_BASENAME
	bool "basename"
	default y

config SYSTEM_TOYBOX_CMD_CAL
	bool "cal"
	default y

config SYSTEM_TOYBOX_CMD_CAT
	bool "cat"
	default y

config SYSTEM_TOYBOX_CMD_CHGRP
	bool "chgrp"
	default y

config SYSTEM_TOYBOX_CMD_CHMOD
	bool "chmod"
	default y

config SYSTEM_TOYBOX_CMD_CHOWN
	bool "chown"
	default y

config SYSTEM_TOYBOX_CMD_CKSUM
	bool "cksum"
	default y

config SYSTEM_TOYBOX_CMD_CLEAR
	bool "clear"
	default y

config SYSTEM_TOYBOX_CMD_CMP
	bool "cmp"
	default y

config SYSTEM_TOYBOX_CMD_COMM
	bool "comm"
	default y

config SYSTEM_TOYBOX_CMD_CP
	bool "cp"
	default y

config SYSTEM_TOYBOX_CMD_CPIO
	bool "cpio"
	default y

config SYSTEM_TOYBOX_CMD_CUT
	bool "cut"
	default y

config SYSTEM_TOYBOX_CMD_DATE
	bool "date"
	default y

config SYSTEM_TOYBOX_CMD_DD
	bool "dd"
	default y

config SYSTEM_TOYBOX_CMD_DF
	bool "df"
	default y

config SYSTEM_TOYBOX_CMD_DIFF
	bool "diff"
	default y

config SYSTEM_TOYBOX_CMD_DIRNAME
	bool "dirname"
	default y

config SYSTEM_TOYBOX_CMD_DOS2UNIX
	bool "dos2unix"
	default y

config SYSTEM_TOYBOX_CMD_DU
	bool "du"
	default y

config SYSTEM_TOYBOX_CMD_ECHO
	bool "echo"
	default y

config SYSTEM_TOYBOX_CMD_ENV
	bool "env"
	default y

config SYSTEM_TOYBOX_CMD_EXPAND
	bool "expand"
	default y

config SYSTEM_TOYBOX_CMD_EXPR
	bool "expr"
	default y

config SYSTEM_TOYBOX_CMD_FALLOCATE
	bool "fallocate"
	default y

config SYSTEM_TOYBOX_CMD_FALSE
	bool "false"
	default y

config SYSTEM_TOYBOX_CMD_FILE
	bool "file"
	default y

config SYSTEM_TOYBOX_CMD_FIND
	bool "find"
	default y

config SYSTEM_TOYBOX_CMD_FMT
	bool "fmt"
	default y

config SYSTEM_TOYBOX_CMD_FREE
	bool "free"
	default y

config SYSTEM_TOYBOX_CMD_FSYNC
	bool "fsync"
	default y

config SYSTEM_TOYBOX_CMD_GETOPT
	bool "getopt"
	default y

config SYSTEM_TOYBOX_CMD_GREP
	bool "grep"
	default y

config SYSTEM_TOYBOX_CMD_GROUPS
	bool "groups"
	default y

config SYSTEM_TOYBOX_CMD_GUNZIP
	bool "gunzip"
	default y

config SYSTEM_TOYBOX_CMD_GZIP
	bool "gzip"
	default y

config SYSTEM_TOYBOX_CMD_HEAD
	bool "head"
	default y

config SYSTEM_TOYBOX_CMD_HELP
	bool "help"
	default y

config SYSTEM_TOYBOX_CMD_HOSTNAME
	bool "hostname"
	default y

config SYSTEM_TOYBOX_CMD_ID
	bool "id"
	default y

config SYSTEM_TOYBOX_CMD_KILL
	bool "kill"
	default y

config SYSTEM_TOYBOX_CMD_KILLALL
	bool "killall"
	default y

config SYSTEM_TOYBOX_CMD_LN
	bool "ln"
	default y

config SYSTEM_TOYBOX_CMD_LOGNAME
	bool "logname"
	default y

config SYSTEM_TOYBOX_CMD_LS
	bool "ls"
	default y

config SYSTEM_TOYBOX_CMD_MD5SUM
	bool "md5sum"
	default y

config SYSTEM_TOYBOX_CMD_MKDIR
	bool "mkdir"
	default y

config SYSTEM_TOYBOX_CMD_MKFIFO
	bool "mkfifo"
	default y

config SYSTEM_TOYBOX_CMD_MKTEMP
	bool "mktemp"
	default y

config SYSTEM_TOYBOX_CMD_MV
	bool "mv"
	default y

config SYSTEM_TOYBOX_CMD_NICE
	bool "nice"
	default y

config SYSTEM_TOYBOX_CMD_NL
	bool "nl"
	default y

config SYSTEM_TOYBOX_CMD_NOHUP
	bool "nohup"
	default y

config SYSTEM_TOYBOX_CMD_NPROC
	bool "nproc"
	default y

config SYSTEM_TOYBOX_CMD_OD
	bool "od"
	default y

config SYSTEM_TOYBOX_CMD_PASTE
	bool "paste"
	default y

config SYSTEM_TOYBOX_CMD_PGREP
	bool "pgrep"
	default y

config SYSTEM_TOYBOX_CMD_PIDOF
	bool "pidof"
	default y

config SYSTEM_TOYBOX_CMD_PKILL
	bool "pkill"
	default y

config SYSTEM_TOYBOX_CMD_PRINTENV
	bool "printenv"
	default y

config SYSTEM_TOYBOX_CMD_PRINTF
	bool "printf"
	default y

config SYSTEM_TOYBOX_CMD_PS
	bool "ps"
	default y

config SYSTEM_TOYBOX_CMD_PWD
	bool "pwd"
	default y

config SYSTEM_TOYBOX_CMD_READLINK
	bool "readlink"
	default y

config SYSTEM_TOYBOX_CMD_REALPATH
	bool "realpath"
	default y

config SYSTEM_TOYBOX_CMD_RENICE
	bool "renice"
	default y

config SYSTEM_TOYBOX_CMD_REV
	bool "rev"
	default y

config SYSTEM_TOYBOX_CMD_RM
	bool "rm"
	default y

config SYSTEM_TOYBOX_CMD_RMDIR
	bool "rmdir"
	default y

config SYSTEM_TOYBOX_CMD_SED
	bool "sed"
	default y

config SYSTEM_TOYBOX_CMD_SEQ
	bool "seq"
	default y

config SYSTEM_TOYBOX_CMD_SETSID
	bool "setsid"
	default y

config SYSTEM_TOYBOX_CMD_SHA1SUM
	bool "sha1sum"
	default y

config SYSTEM_TOYBOX_CMD_SHA224SUM
	bool "sha224sum"
	default y

config SYSTEM_TOYBOX_CMD_SHA256SUM
	bool "sha256sum"
	default y

config SYSTEM_TOYBOX_CMD_SHA384SUM
	bool "sha384sum"
	default y

config SYSTEM_TOYBOX_CMD_SHA512SUM
	bool "sha512sum"
	default y

config SYSTEM_TOYBOX_CMD_SLEEP
	bool "sleep"
	default y

config SYSTEM_TOYBOX_CMD_SORT
	bool "sort"
	default y

config SYSTEM_TOYBOX_CMD_SPLIT
	bool "split"
	default y

config SYSTEM_TOYBOX_CMD_STAT
	bool "stat"
	default y

config SYSTEM_TOYBOX_CMD_STRINGS
	bool "strings"
	default y

config SYSTEM_TOYBOX_CMD_SYNC
	bool "sync"
	default y

config SYSTEM_TOYBOX_CMD_TAC
	bool "tac"
	default y

config SYSTEM_TOYBOX_CMD_TAIL
	bool "tail"
	default y

config SYSTEM_TOYBOX_CMD_TAR
	bool "tar"
	default y

config SYSTEM_TOYBOX_CMD_TEE
	bool "tee"
	default y

config SYSTEM_TOYBOX_CMD_TEST
	bool "test"
	default y

config SYSTEM_TOYBOX_CMD_TIME
	bool "time"
	default y

config SYSTEM_TOYBOX_CMD_TIMEOUT
	bool "timeout"
	default y

config SYSTEM_TOYBOX_CMD_TOUCH
	bool "touch"
	default y

config SYSTEM_TOYBOX_CMD_TR
	bool "tr"
	default y

config SYSTEM_TOYBOX_CMD_TRUE
	bool "true"
	default y

config SYSTEM_TOYBOX_CMD_TRUNCATE
	bool "truncate"
	default y

config SYSTEM_TOYBOX_CMD_ULIMIT
	bool "ulimit"
	default y

config SYSTEM_TOYBOX_CMD_UNAME
	bool "uname"
	default y

config SYSTEM_TOYBOX_CMD_UNIQ
	bool "uniq"
	default y

config SYSTEM_TOYBOX_CMD_UNIX2DOS
	bool "unix2dos"
	default y

config SYSTEM_TOYBOX_CMD_UNLINK
	bool "unlink"
	default y

config SYSTEM_TOYBOX_CMD_UPTIME
	bool "uptime"
	default y

config SYSTEM_TOYBOX_CMD_USLEEP
	bool "usleep"
	default y

config SYSTEM_TOYBOX_CMD_UUDECODE
	bool "uudecode"
	default y

config SYSTEM_TOYBOX_CMD_UUENCODE
	bool "uuencode"
	default y

config SYSTEM_TOYBOX_CMD_UUIDGEN
	bool "uuidgen"
	default y

config SYSTEM_TOYBOX_CMD_WC
	bool "wc"
	default y

config SYSTEM_TOYBOX_CMD_WHICH
	bool "which"
	default y

config SYSTEM_TOYBOX_CMD_WHOAMI
	bool "whoami"
	default y

config SYSTEM_TOYBOX_CMD_XARGS
	bool "xargs"
	default y

config SYSTEM_TOYBOX_CMD_XXD
	bool "xxd"
	default y

config SYSTEM_TOYBOX_CMD_YES
	bool "yes"
	default y

config SYSTEM_TOYBOX_CMD_ZCAT
	bool "zcat"
	default y
```

## system/wifibridge/Kconfig
```kconfig
#
# For a description of the syntax of this configuration file,
# see the file kconfig-language.txt in the NuttX tools repository.
#

config SYSTEM_WIFIBRIDGE
	tristate "Wi-Fi to Ethernet bridge 'wifibridge' command"
	default n
	depends on NET_IPv4 && NET_BRIDGE && WIRELESS_WAPI
	select NETUTILS_WIFIBRIDGE
	---help---
		Enable the 'wifibridge' command to start, stop and inspect a Wi-Fi
		SoftAP bridged to an Ethernet interface.

if SYSTEM_WIFIBRIDGE

config SYSTEM_WIFIBRIDGE_PRIORITY
	int "wifibridge task priority"
	default 100

config SYSTEM_WIFIBRIDGE_STACKSIZE
	int "wifibridge stack size"
	default DEFAULT_TASK_STACKSIZE

config SYSTEM_WIFIBRIDGE_BRIDGE
	string "Bridge interface name"
	default "br0"

config SYSTEM_WIFIBRIDGE_ETHIF
	string "Ethernet interface name"
	default "eth0"

config SYSTEM_WIFIBRIDGE_WLANIF
	string "Wi-Fi interface name"
	default "wlan0"

config SYSTEM_WIFIBRIDGE_SSID
	string "Default SoftAP SSID"
	default "NuttX-BR"

config SYSTEM_WIFIBRIDGE_PASSPHRASE
	string "Default SoftAP passphrase (8..63 characters)"
	default "nuttxbridge"

config SYSTEM_WIFIBRIDGE_CHANNEL
	int "Default SoftAP 2.4 GHz channel"
	default 6
	range 1 13

config SYSTEM_WIFIBRIDGE_IPADDR
	hex "Default bridge IPv4 address"
	default 0x0a000002
	---help---
		Address of the bridge interface itself (the ports stay at
		0.0.0.0).  The netmask is 255.255.255.0.

endif # SYSTEM_WIFIBRIDGE
```

## system/xipfs/Kconfig
```kconfig
#
# For a description of the syntax of this configuration file,
# see the file kconfig-language.txt in the NuttX tools repository.
#

config SYSTEM_XIPFS
	tristate "xipfs defragmentation command"
	default n
	depends on FS_XIPFS
	---help---
		Enable the 'xipfs' command, which compacts a xipfs volume and
		reports how its erase blocks are laid out.  With -n it only
		reports -- block usage, a map of the volume, and how much of the
		free space a single allocation can reach -- and moves nothing.

if SYSTEM_XIPFS

config SYSTEM_XIPFS_PROGNAME
	string "Program name"
	default "xipfs"
	---help---
		The name of the command as it appears in NSH.

config SYSTEM_XIPFS_MOUNTPOINT
	string "Default mountpoint"
	default "/mnt/xipfs"
	---help---
		The volume operated on when none is given on the command line.

config SYSTEM_XIPFS_PRIORITY
	int "Task priority"
	default 100

config SYSTEM_XIPFS_STACKSIZE
	int "Stack size"
	default DEFAULT_TASK_STACKSIZE

endif # SYSTEM_XIPFS
```

## system/xrcedds/Kconfig
```kconfig
#
# For a description of the syntax of this configuration file,
# see the file kconfig-language.txt in the NuttX tools repository.
#

menuconfig SYSTEM_XRCEDDS
	bool "eProsima Micro XRCE-DDS"
	default n
	---help---
		Enable a lightweight build of Micro XRCE-DDS Client 3.0.1 and
		Micro-CDR 2.0.2.  Only the core client and the built-in UDP
		transport are built; ROS 2, micro-ROS, discovery, and other
		transports are not included.

if SYSTEM_XRCEDDS

config SYSTEM_XRCEDDS_STREAM_FRAMING
	bool "Byte-stream transport framing"
	default n
	---help---
		Enable HDLC framing for byte-stream transports such as UART.
		The built-in UDP transport preserves packet boundaries, so this
		is not needed for the UDP publisher demo.

config SYSTEM_XRCEDDS_MTU
	int "UDP transport MTU"
	range 64 65535
	default 512

config SYSTEM_XRCEDDS_MAX_OUTPUT_BEST_EFFORT_STREAMS
	int "Maximum output best-effort streams"
	range 1 127
	default 1

config SYSTEM_XRCEDDS_MAX_OUTPUT_RELIABLE_STREAMS
	int "Maximum output reliable streams"
	range 1 127
	default 1

config SYSTEM_XRCEDDS_MAX_INPUT_BEST_EFFORT_STREAMS
	int "Maximum input best-effort streams"
	range 1 127
	default 1

config SYSTEM_XRCEDDS_MAX_INPUT_RELIABLE_STREAMS
	int "Maximum input reliable streams"
	range 1 127
	default 1

endif
```

## system/zbus/Kconfig
```kconfig
#
# For a description of the syntax of this configuration file,
# see the file kconfig-language.txt in the NuttX tools repository.
#

menuconfig ZBUS
	bool "ZBus message bus library"
	default n
	depends on !DISABLE_MQUEUE
	---help---
		Enable the zbus message bus library (port of the Zephyr zbus).
		Channels and observers are defined statically with the
		ZBUS_CHAN_DEFINE/ZBUS_LISTENER_DEFINE/ZBUS_SUBSCRIBER_DEFINE
		macros and collected in linker iterable sections.  The board
		linker script must include <nuttx/linker/common-rom.ld> (inside
		.text) and <nuttx/linker/common-ram.ld> (inside .data).

		For protection against priority inversion during the
		notification process, enable CONFIG_PRIORITY_INHERITANCE.

if ZBUS

config ZBUS_CHANNEL_NAME
	bool "Channel name field"
	default n
	---help---
		Store the channel name string and enable zbus_chan_name() and
		zbus_chan_from_name().

config ZBUS_CHANNEL_ID
	bool "Channel identifier field"
	default n
	---help---
		Store a unique numeric channel identifier and enable
		zbus_chan_from_id().  Use ZBUS_CHAN_DEFINE_WITH_ID.

config ZBUS_OBSERVER_NAME
	bool "Observer name field"
	default n
	---help---
		Store the observer name string and enable zbus_obs_name().

config ZBUS_CHANNEL_PUBLISH_STATS
	bool "Channel publishing statistics (timestamp and count)"
	default n

config ZBUS_MSG_SUBSCRIBER
	bool "Message subscribers (receive message copies in sequence)"
	default n
	---help---
		Enable ZBUS_MSG_SUBSCRIBER_DEFINE and zbus_sub_wait_msg().
		Message subscribers receive a copy of every published message
		through a POSIX message queue.

if ZBUS_MSG_SUBSCRIBER

config ZBUS_MSG_SUBSCRIBER_MAX_MSG_SIZE
	int "Size of the biggest message used with zbus (bytes)"
	default 64
	---help---
		Messages larger than this cannot be delivered to message
		subscribers.  Defines the message queue slot size.

		NOTE: CONFIG_MQ_MAXMSGSIZE must be at least this value plus
		the size of a pointer, otherwise the message subscriber
		queues fail to open with -EINVAL.

config ZBUS_MSG_SUBSCRIBER_QUEUE_SIZE
	int "Message subscriber queue depth"
	default 4

endif # ZBUS_MSG_SUBSCRIBER

config ZBUS_ASYNC_LISTENER
	bool "Async listeners"
	default n
	depends on ZBUS_MSG_SUBSCRIBER
	---help---
		Async listeners execute their callback on a dedicated task
		(one per async listener, spawned on first use) with a copy of
		the published message, instead of running synchronously in the
		publisher context.  Enable with ZBUS_ASYNC_LISTENER_DEFINE.

if ZBUS_ASYNC_LISTENER

config ZBUS_ASYNC_LISTENER_PRIORITY
	int "Async listener task priority"
	default 100

config ZBUS_ASYNC_LISTENER_STACKSIZE
	int "Async listener task stack size"
	default DEFAULT_TASK_STACKSIZE

endif # ZBUS_ASYNC_LISTENER

config ZBUS_RUNTIME_OBSERVERS
	bool "Runtime observers support"
	default n
	---help---
		Enable zbus_chan_add_obs()/zbus_chan_rm_obs().  Observer nodes
		are allocated from the heap.

config ZBUS_ASSERT_MOCK
	bool "Assert mock for test purposes"
	default n
	---help---
		Invalid parameters make the API return -EFAULT instead of
		asserting.

endif # ZBUS
```

## testing/drivers/taskwdt/Kconfig
```kconfig
#
# For a description of the syntax of this configuration file,
# see the file kconfig-language.txt in the NuttX tools repository.
#

config TESTING_TASKWDT
	bool "Task watchdog supervisor test (taskwdt_test)"
	default n
	depends on TASKWDT
	---help---
		Test the task watchdog supervisor (CONFIG_TASKWDT). Run
		"taskwdt_test" without arguments for the list of test cases. The
		cases that must not reset the system print PASS or FAIL, the
		others stop feeding on purpose and expect the system to reset.

if TESTING_TASKWDT

config TESTING_TASKWDT_PROGNAME
	string "Program name"
	default "taskwdt_test"
	---help---
		This is the name of the program that will be used when the NSH ELF
		program is installed.

config TESTING_TASKWDT_PRIORITY
	int "taskwdt_test task priority"
	default 100

config TESTING_TASKWDT_STACKSIZE
	int "taskwdt_test stack size"
	default DEFAULT_TASK_STACKSIZE

endif
```
