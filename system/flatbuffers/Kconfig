## testing/fs/diropen/Kconfig
```kconfig
#
# For a description of the syntax of this configuration file,
# see the file kconfig-language.txt in the NuttX tools repository.
#

config TESTING_DIROPEN
	tristate "open() of a directory test"
	default n
	depends on !DISABLE_MOUNTPOINT
	---help---
		Check open() of a directory and of a file with O_DIRECTORY, as
		POSIX says.  An open() of a directory with O_RDONLY gives a
		directory descriptor that fstat(), openat() and fdopendir() use.
		An open() of a directory with O_WRONLY or O_RDWR fails with
		EISDIR.  An open() of a file with O_DIRECTORY and opendir() of a
		file fail with ENOTDIR.

		The test runs on the pseudo file system (/dev, / and a new
		directory), on a tmpfs that it mounts when the kernel has one, and
		in each directory given as an argument, for example a hostfs, v9fs
		or rpmsgfs mount: "diropen /host".  A directory given as an
		argument must be writable.

if TESTING_DIROPEN

config TESTING_DIROPEN_PROGNAME
	string "Program name"
	default "diropen"
	---help---
		This is the name of the program that will be used when the NSH ELF
		program is installed.

config TESTING_DIROPEN_PRIORITY
	int "Directory open test task priority"
	default 100

config TESTING_DIROPEN_STACKSIZE
	int "Directory open test stack size"
	default DEFAULT_TASK_STACKSIZE

endif
```

## testing/fs/fatgap/Kconfig
```kconfig
#
# For a description of the syntax of this configuration file,
# see the file kconfig-language.txt in the NuttX tools repository.
#

config TESTING_FATGAP
	tristate "FAT file system test"
	default n
	depends on FS_FAT && FSUTILS_MKFATFS && BOARDCTL_MKRD
	---help---
		Write past the end of a file on a FAT file system and check that
		the old data stays and that the gap reads as zero.  The old size
		is on a cluster boundary, one byte below or above it, in the middle
		of a cluster, or zero.

		Other cases write with O_APPEND after a seek, after fcntl(F_SETFL),
		with pwrite() and from two handles, and fill the volume to check the
		count of the last, short write.

		More cases check that a second handle reads zeros after ftruncate()
		makes the file longer, that statfs() gives the number of clusters
		that a file can get, that stat() and fstat() give the size of an
		open file before a sync, and on FAT32 the free cluster count that
		mkfatfs writes in the FSINFO sector.

		The test makes its own RAM disks: 512 KiB for FAT12, about 2 MiB for
		FAT16 and about 34 MiB for FAT32.  It skips a FAT type when the memory
		for its RAM disk is not available.  The arguments select the FAT
		types, for example "fatgap 12".

if TESTING_FATGAP

config TESTING_FATGAP_PROGNAME
	string "Program name"
	default "fatgap"
	---help---
		This is the name of the program that will be used when the NSH ELF
		program is installed.

config TESTING_FATGAP_PRIORITY
	int "FAT file system test task priority"
	default 100

config TESTING_FATGAP_STACKSIZE
	int "FAT file system test stack size"
	default DEFAULT_TASK_STACKSIZE

endif
```

## testing/fs/filelock/Kconfig
```kconfig
#
# For a description of the syntax of this configuration file,
# see the file kconfig-language.txt in the NuttX tools repository.
#

config TESTING_FILELOCK
	tristate "File lock wait test"
	default n
	depends on FS_LOCK_BUCKET_SIZE > 0 && !DISABLE_PTHREAD && !DISABLE_ALL_SIGNALS
	---help---
		Check that a signal ends the wait for a file lock.  A thread waits
		for a lock that the main thread holds, with fcntl(F_SETLKW),
		flock(LOCK_EX) and lockf(F_LOCK).  A signal to the waiting thread
		must end the wait with EINTR before the lock is free.  The test also
		checks that the wait without a signal gets the lock after the unlock.

		The argument is the lock file, for example "filelock /tmp/lock".
		The file system of the file must support F_GETPATH.

if TESTING_FILELOCK

config TESTING_FILELOCK_PROGNAME
	string "Program name"
	default "filelock"
	---help---
		This is the name of the program that will be used when the NSH ELF
		program is installed.

config TESTING_FILELOCK_PRIORITY
	int "File lock wait test task priority"
	default 100

config TESTING_FILELOCK_STACKSIZE
	int "File lock wait test stack size"
	default DEFAULT_TASK_STACKSIZE

endif
```

## testing/fs/inotest/Kconfig
```kconfig
#
# For a description of the syntax of this configuration file,
# see the file kconfig-language.txt in the NuttX tools repository.
#

config TESTING_INOTEST
	tristate "File serial number test"
	default n
	---help---
		Check st_ino, d_ino and st_dev of the entries of some directories:
		st_ino is not 0 and does not change, readdir() gives the st_ino of
		lstat() and fstat(), two entries are two files, and a subdirectory
		does not have the numbers of a parent directory.

		By default the test checks /, /dev and /proc, and makes files in a
		new tmpfs if FS_TMPFS is enabled.  "inotest -w dir" makes the files
		in dir, and "inotest dir ..." checks other directories.

if TESTING_INOTEST

config TESTING_INOTEST_PROGNAME
	string "Program name"
	default "inotest"
	---help---
		This is the name of the program that will be used when the NSH ELF
		program is installed.

config TESTING_INOTEST_PRIORITY
	int "File serial number test task priority"
	default 100

config TESTING_INOTEST_STACKSIZE
	int "File serial number test stack size"
	default DEFAULT_TASK_STACKSIZE

endif
```

## testing/fs/xipfs/Kconfig
```kconfig
#
# For a description of the syntax of this configuration file,
# see the file kconfig-language.txt in the NuttX tools repository.
#

config TESTING_FS_XIPFS
	tristate "XIPFS file system test"
	depends on FS_XIPFS
	default n
	---help---
		Exercise the XIPFS filesystem: the routine VFS paths, the
		write-once rules, the in-place mmap and its strict variant, and
		then the corners that actually carry risk -- power loss atomicity
		of the metadata commit, and release of XIP pins when a task dies
		without unmapping.

		With CONFIG_FDPIC it also loads modules out of the filesystem and
		checks the loader properties that otherwise fail silently: global
		constructors running in dependency order, per-instance data, and
		the relocation paths nothing else reaches.

		Takes an optional section name to run just one part, since the
		power loss sweeps take minutes and everything else takes seconds:

		  xipfs_test          everything
		  xipfs_test xip      just the execute-in-place mapping tests
		  xipfs_test fdpic    just the module loading tests

		Sections: basic writeonce strict xip multimap crosstask teardown
		fdpic reject dirs defrag powerloss powertorn unlink dirloss
		defraglos

		The power loss sections need CONFIG_FS_XIPFS_FAULT_INJECT.

if TESTING_FS_XIPFS

config TESTING_FS_XIPFS_MOUNTPT
	string "XIPFS mountpoint"
	default "/mnt/xipfs"

config TESTING_FS_XIPFS_MTD
	string "MTD device backing the filesystem"
	default "/dev/rammtd"

endif # TESTING_FS_XIPFS
```

## testing/libc/arch_libc/Kconfig
```kconfig
#
# For a description of the syntax of this configuration file,
# see the file kconfig-language.txt in the NuttX tools repository.
#

config TESTING_ARCH_LIBC
	tristate "arch-specific libc function test"
	default n
	---help---
		Enable the arch libc test

if TESTING_ARCH_LIBC

config TESTING_ARCH_LIBC_MEMCHR
	bool "test memchr"
	default y

config TESTING_ARCH_LIBC_MEMCMP
	bool "test memcmp"
	default y

config TESTING_ARCH_LIBC_MEMCPY
	bool "test memcpy"
	default y

config TESTING_ARCH_LIBC_MEMMOVE
	bool "test memmove"
	default y

config TESTING_ARCH_LIBC_MEMSET
	bool "test memset"
	default y

config TESTING_ARCH_LIBC_STRCHR
	bool "test strchr"
	default y

config TESTING_ARCH_LIBC_STRCMP
	bool "test strcmp"
	default y

config TESTING_ARCH_LIBC_STRCPY
	bool "test strcpy"
	default y

config TESTING_ARCH_LIBC_STRLEN
	bool "test strlen"
	default y

config TESTING_ARCH_LIBC_STRNCMP
	bool "test strncmp"
	default y

config TESTING_ARCH_LIBC_STRNLEN
	bool "test strnlen"
	default y

config TESTING_ARCH_LIBC_STRNCPY
	bool "test strncpy"
	default y

config TESTING_ARCH_LIBC_STPCPY
	bool "test stpcpy"
	default y

config TESTING_ARCH_LIBC_STRCAT
	bool "test strcat"
	default y

config TESTING_ARCH_LIBC_STRRCHR
	bool "test strrchr"
	default y

config TESTING_ARCH_LIBC_STRCHRNUL
	bool "test strchrnul"
	default y

config TESTING_ARCH_LIBC_PROGNAME
	string "Program name"
	default "arch_libctest"
	---help---
		This is the name of the program that will be used when the NSH ELF
		program is installed.

config TESTING_ARCH_LIBC_PRIORITY
	int "arch libc test priority"
	default 100

config TESTING_ARCH_LIBC_STACKSIZE
	int "arch libc test stack size"
	default DEFAULT_TASK_STACKSIZE

config TESTING_ARCH_LIBC_VERBOSE
	bool "Verbose output"
	default n

endif
```

## testing/libc/inetntop/Kconfig
```kconfig
#
# For a description of the syntax of this configuration file,
# see the file kconfig-language.txt in the NuttX tools repository.
#

config TESTING_INETNTOP
	tristate "inet_ntop() test"
	default n
	depends on (NET_IPv4 || LIBC_IPv4_ADDRCONV) && (NET_IPv6 || LIBC_IPv6_ADDRCONV)
	---help---
		Check the text that inet_ntop(AF_INET6) makes: "::" only for the
		longest run of two or more 0 fields, lowercase hexadecimal, and the
		IPv4 dotted-decimal form for the IPv4-mapped and IPv4-compatible
		addresses.  Also check that inet_ntop() fails with ENOSPC only when
		the text does not fit in the buffer, for AF_INET6 and AF_INET.

if TESTING_INETNTOP

config TESTING_INETNTOP_PROGNAME
	string "Program name"
	default "inetntop"
	---help---
		This is the name of the program that will be used when the NSH ELF
		program is installed.

config TESTING_INETNTOP_PRIORITY
	int "inetntop task priority"
	default 100

config TESTING_INETNTOP_STACKSIZE
	int "inetntop stack size"
	default DEFAULT_TASK_STACKSIZE

endif
```
