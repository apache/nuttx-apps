## system/nxmbclient/Kconfig
```kconfig
#
# For a description of the syntax of this configuration file,
# see the file kconfig-language.txt in the NuttX tools repository.
#

config SYSTEM_NXMBCLIENT
	tristate "NxModbus Client Tool"
	default n
	depends on NXMODBUS_CLIENT
	---help---
		Enable the NxModbus client command-line tool. This utility allows
		you to perform Modbus client operations from the command line,
		supporting RTU, ASCII, and TCP transports.

if SYSTEM_NXMBCLIENT

config NXMBCLIENT_PROGNAME
	string "Program name"
	default "nxmbclient"
	---help---
		This is the name of the program that will be used when the NSH ELF
		program is installed.

config NXMBCLIENT_PRIORITY
	int "NxModbus client task priority"
	default 100

config NXMBCLIENT_STACKSIZE
	int "NxModbus client stack size"
	default DEFAULT_TASK_STACKSIZE

endif # SYSTEM_NXMBCLIENT
```

## system/nxpkg/Kconfig
```kconfig
#
# For a description of the syntax of this configuration file,
# see the file kconfig-language.txt in the NuttX tools repository.
#

config SYSTEM_NXPKG
	bool "'nxpkg' lifecycle helper"
	default n
	select CRYPTO
	select NETUTILS_CJSON
	---help---
		Enable the thin package lifecycle helper proposed for the
		Dynamic ELF distribution work.

if SYSTEM_NXPKG

config SYSTEM_NXPKG_PROGNAME
	string "Program name"
	default "nxpkg"
	---help---
		This is the name of the program that will be used when the
		nxpkg tool is installed.

config SYSTEM_NXPKG_PRIORITY
	int "'nxpkg' task priority"
	default 100

config SYSTEM_NXPKG_STACKSIZE
	int "'nxpkg' stack size"
	default 16384

config SYSTEM_NXPKG_ROOT
	string "'nxpkg' storage root"
	default "/tmp/nxpkg"
	---help---
		Base directory used by nxpkg for its local index, installed
		metadata, temporary downloads, and package payload storage.
		Boards with external storage can point this to a persistent
		location such as /mnt/sdcard/nxpkg.

endif
```

## system/nxrecorder/Kconfig
```kconfig
#
# For a description of the syntax of this configuration file,
# see the file kconfig-language.txt in the NuttX tools repository.
#

config SYSTEM_NXRECORDER
	bool "NxRecorder pcm raw data Recorder"
	default n
	depends on AUDIO
	---help---
		Enable support for the NxRecorder pcm raw data recorder library
		and optional command line interface.

if SYSTEM_NXRECORDER

config NXRECORDER_MAINTHREAD_STACKSIZE
	int "NxRecoder main thread stack size"
	default DEFAULT_TASK_STACKSIZE
	---help---
		Stack size to use with the NxRecoder main thread.

config NXRECORDER_RECORDTHREAD_STACKSIZE
	int "NxRecorder thread stack size"
	default PTHREAD_STACK_DEFAULT
	---help---
		Stack size to use with the NxRecorder record thread.

config NXRECORDER_COMMAND_LINE
	tristate "Include nxrecorder command line application"
	default y
	---help---
		Compiles in code for the nxrecorder command line control.
		This is a text-based command line interface that uses
		the nxrecorder library to record pcm raw data, control the
		volume, balance, bass, etc.

if NXRECORDER_COMMAND_LINE

config NXRECORDER_INCLUDE_HELP
	bool "Include HELP command and text"
	default y
	---help---
		Compiles in the NxRecorder help text to provide online help
		for available commands with syntax.

config NXRECORDER_FMT_FROM_EXT
	bool "Include code to determine Audio format from extension"
	default y
	---help---
		Compiles in extra code to determine audio format based
		on the filename extension for known file types.
		This feature is used if the format is not manually
		specified, and will take priority over the more lengthy
		file content detection approach.

endif
endif
```

## system/nxstore/Kconfig
```kconfig
#
# For a description of the syntax of this configuration file,
# see the file kconfig-language.txt in the NuttX tools repository.
#

config SYSTEM_NXSTORE
	tristate "Nxstore LVGL App Store"
	default n
	depends on GRAPHICS_LVGL && SYSTEM_NXPKG
	select NETUTILS_CJSON
	select SCHED_WAITPID
	select LV_FONT_MONTSERRAT_12
	select LV_FONT_MONTSERRAT_20
	---help---
		Enable the Nxstore LVGL graphical application store frontend.
		Lists packages from the local nxpkg repository, installs the
		selected one via nxpkg, and launches it.

if SYSTEM_NXSTORE

config SYSTEM_NXSTORE_PROGNAME
	string "Program name"
	default "nxstore"

config SYSTEM_NXSTORE_PRIORITY
	int "nxstore task priority"
	default 100

config SYSTEM_NXSTORE_STACKSIZE
	int "nxstore stack size"
	default 8192

config SYSTEM_NXSTORE_FBDEVPATH
	string "Framebuffer device path"
	default "/dev/fb0"

config SYSTEM_NXSTORE_INPUT_DEVPATH
	string "Input device path"
	default "/dev/input0"

endif
```

## system/ofloader/Kconfig
```kconfig
#
# For a description of the syntax of this configuration file,
# see the file kconfig-language.txt in the NuttX tools repository.
#

config SYSTEM_OFLOADER
	tristate "Open flash loader"
	default n
	select DISABLE_IDLE_LOOP
	---help---
		Enable support for flashloader.

if SYSTEM_OFLOADER

config SYSTEM_OFLOADER_PROGNAME
	string "Program name"
	default "ofloader"
	---help---
		This is the name of the program that will be used when the NSH ELF
		program is installed.

config SYSTEM_OFLOADER_PRIORITY
	int "ofloader task priority"
	default 100

config SYSTEM_OFLOADER_STACKSIZE
	int "ofloader stack size"
	default DEFAULT_TASK_STACKSIZE

config SYSTEM_OFLOADER_BUFFERSIZE
	int "ofloader transfer buffer size"
	default 32768

config SYSTEM_OFLOADER_DEBUG
	bool "Open flashloader debug option"
	default n

config SYSTEM_OFLOADER_TABLE
	string "open flashloder table"
	---help---
		devname[,addr[,size]][;devname2[,addr[,size]]]
		can enter multiple device nodes separated by semicolon

endif
```

## system/ping/Kconfig
```kconfig
#
# For a description of the syntax of this configuration file,
# see the file kconfig-language.txt in the NuttX tools repository.
#

config SYSTEM_PING
	tristate "ICMP 'ping' command"
	default n
	depends on NET_ICMP
	select NETUTILS_PING
	---help---
		Enable support for the ICMP 'ping' command.

if SYSTEM_PING

config SYSTEM_PING_PROGNAME
	string "Ping program name"
	default "ping"
	---help---
		This is the name of the program that will be used when the NSH ELF
		program is installed.

config SYSTEM_PING_PRIORITY
	int "Ping task priority"
	default 100

config SYSTEM_PING_STACKSIZE
	int "Ping stack size"
	default DEFAULT_TASK_STACKSIZE

endif
```

## system/ping6/Kconfig
```kconfig
#
# For a description of the syntax of this configuration file,
# see the file kconfig-language.txt in the NuttX tools repository.
#

config SYSTEM_PING6
	bool "ICMPv6 'ping6' command"
	default n
	depends on NET_ICMPv6_SOCKET || NET_USRSOCK
	---help---
		Enable support for the ICMP 'ping' command.

if SYSTEM_PING6
config SYSTEM_PING6_PROGNAME
	string "Ping program name"
	default "ping6"
	depends on BUILD_LOADABLE
	---help---
		This is the name of the program that will be use when the NSH ELF
		program is installed.

config SYSTEM_PING6_PRIORITY
	int "Ping task priority"
	default 100

config SYSTEM_PING6_STACKSIZE
	int "Ping stack size"
	default 2048

endif
```

## system/popen/Kconfig
```kconfig
#
# For a description of the syntax of this configuration file,
# see the file kconfig-language.txt in the NuttX tools repository.
#

config SYSTEM_POPEN
	bool "popen()/pclose()/dpopen()/dpclose() Functions"
	default n
	select SCHED_WAITPID
	depends on PIPES
	---help---
		Enable support for the popen(), pclose(), dpopen(), and
		dpclose() interfaces.

		dpopen()/dpclose() are the descriptor-based counterparts
		of popen()/pclose(), analogous to how dprintf() relates
		to fprintf().  They return a raw file descriptor instead
		of a FILE stream, avoiding the stdio.h dependency.

		popen()/pclose() are thin wrappers around dpopen()/dpclose()
		that additionally wrap the fd in a FILE stream.

		When NSH is available (NSH_LIBRARY), commands are executed
		through the shell (sh -c command), supporting full shell
		syntax including pipes, redirects, and globbing.

		When NSH is not available, commands are executed directly
		via posix_spawnp(). The command string must be a simple
		"program arg1 arg2" form without shell syntax.

if SYSTEM_POPEN

config SYSTEM_POPEN_SHPATH
	string "Path to shell command"
	default "/bin/sh"
	depends on (SYSTEM_NSH=m || BUILD_KERNEL) && NSH_LIBRARY
	---help---
		This is the full path to the program in a mounted file system that
		implements the system() command.  That is, a program that starts the
		NSH shell, executes one command (in argv[1]), then exits.

config SYSTEM_POPEN_STACKSIZE
	int "Shell stack size"
	default DEFAULT_TASK_STACKSIZE
	---help---
		The size of stack allocated for the shell.

		NOTE: I needed to set the stack size quite large to get this example
		working on the simulated target (perhaps because of the 64-bit
		stack?  Or perhaps that is a sneak call into the host libc that I
		have not caught).  I assume that a smaller stack would be okay on
		real hardware, but I have not yet verified that.

config SYSTEM_POPEN_PRIORITY
	int "Shell priority"
	default 100
	---help---
		The priority of the shell.

config SYSTEM_POPEN_MAXARGUMENTS
	int "Maximum number of command arguments (no-shell mode)"
	default 7
	depends on !NSH_LIBRARY
	---help---
		When NSH is not available, dpopen()/popen() splits the command
		string by whitespace into an argv array.  This sets the maximum
		number of arguments (excluding the program name and the
		terminating NULL).

		This is analogous to CONFIG_NSH_MAXARGUMENTS but applies
		only to the no-shell path.

endif
```

## system/poweroff/Kconfig
```kconfig
#
# For a description of the syntax of this configuration file,
# see the file kconfig-language.txt in the NuttX tools repository.
#

config SYSTEM_POWEROFF
	bool "Power-Off"
	default n
	---help---
		Enable support for the NSH poweroff command.  NOTE: This option
		provides the NSH power-off command only.  It requires board-specific
		support to actually implement the power-off.

if SYSTEM_POWEROFF
endif
```

## system/progmem/Kconfig
```kconfig
#
# For a description of the syntax of this configuration file,
# see the file kconfig-language.txt in the NuttX tools repository.
#

config SYSTEM_INSTALL
	tristate "FLASH Program Installation"
	default n
	---help---
		Enable support for the FLASH installation tool.

if SYSTEM_INSTALL
endif
```

## system/prun/Kconfig
```kconfig
#
# For a description of the syntax of this configuration file,
# see misc/tools/kconfig-language.txt.
#

config SYSTEM_PRUN
	bool "Pascal P-Code interpreter"
	default n
	depends on INTERPRETERS_PCODE
	---help---
		Build the Pascal P-Code interpreter / Virtual machine

if SYSTEM_PRUN

config SYSTEM_PEXEC
	bool "Pascal P-Code command"
	default n
	---help---
		Generates an NSH built-in task that may be used to execute P-Code
		from the NSH command line.

endif
```
