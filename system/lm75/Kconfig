## system/lm75/Kconfig
```kconfig
#
# For a description of the syntax of this configuration file,
# see the file kconfig-language.txt in the NuttX tools repository.
#

menuconfig SYSTEM_LM75
	tristate "Temperature"
	default n
	depends on LM75_I2C
	---help---
		Enable support for the NSH temp command.  This command will read the
		current temperature from an LM-75 (or compatible) temperature sensor
		and show the temperature on stdout.

if SYSTEM_LM75

config SYSTEM_LM75_DEVNAME
	string "Temperature sensing device"
	default "/dev/temp"

choice
	prompt "Temperature units"
	default SYSTEM_LM75_FAHRENHEIT

config SYSTEM_LM75_FAHRENHEIT
	bool "Fahrenheit"

config SYSTEM_LM75_CELSIUS
	bool "Celsius"

endchoice

config SYSTEM_LM75_STACKSIZE
	int "Stack size (bytes)"
	default 1024

config SYSTEM_LM75_PRIORITY
	int "Command priority"
	default 100

endif
```

## system/lsan/Kconfig
```kconfig
#
# For a description of the syntax of this configuration file,
# see the file kconfig-language.txt in the NuttX tools repository.
#

config SYSTEM_LSAN
	bool "lsan memory leak detection"
	default y
	depends on SIM_ASAN
	---help---
		Alsans support for the LeakSanitizer (lsan) memory leak detection tool.

if SYSTEM_LSAN

config SYSTEM_LSAN_PROGNAME
	string "lsan program name"
	default "lsan"
	---help---
		This is the name of the program that will be used when the lsan
		program is installed.

config SYSTEM_LSAN_PRIORITY
	int "lsan task priority"
	default 100

config SYSTEM_LSAN_STACKSIZE
	int "lsan stack size"
	default DEFAULT_TASK_STACKSIZE

endif
```

## system/lzf/Kconfig
```kconfig
#
# For a description of the syntax of this configuration file,
# see the file kconfig-language.txt in the NuttX tools repository.
#

config SYSTEM_LZF
	tristate "LZF compression tool"
	default n
	depends on LIBC_LZF
	---help---
		Enable theLZF compression tool

if SYSTEM_LZF

config SYSTEM_LZF_BLOG
	int "Log2 of block size"
	default 10
	range 9 12
	---help---
		This example uses two buffers of size a little more than
		(1 << CONFIG_SYSTEM_LZF_BLOG) to compress and decompress data in
		chunks. Slightly better compression should be obtainable with larger
		chunks.

		NOTE:  This is a static memory allocation and will take add a little
		more than 2 * (1 << CONFIG_SYSTEM_LZF_BLOG) bytes to the size of the
		.bss section used by the program.

		NOTE:  This represents a maximum blocksize.  The use may select a
		smaller blocksize using the 'lzf -b' option.

config SYSTEM_LZF_PROGNAME
	string "Program name"
	default "lzf"
	depends on BUILD_LOADABLE
	---help---
		This is the name of the program that will be use when the NSH ELF
		program is installed.

config SYSTEM_LZF_PRIORITY
	int "LZF tool task priority"
	default 100

config SYSTEM_LZF_STACKSIZE
	int "LZF tool stack size"
	default 2048

endif
```

## system/mdio/Kconfig
```kconfig
#
# For a description of the syntax of this configuration file,
# see the file kconfig-language.txt in the NuttX tools repository.
#

config SYSTEM_MDIO
	tristate "PHY Tool"
	default n
	depends on NETDEV_PHY_IOCTL
	---help---
		Enable the PHY MDIO tool

if SYSTEM_MDIO
endif
```

## system/memstress/Kconfig
```kconfig
#
# For a description of the syntax of this configuration file,
# see the file kconfig-language.txt in the NuttX tools repository.
#

config SYSTEM_MEMORY_STRESS
	tristate "memory stress test"
	default n
	---help---
		Enable a memory stress test.

if SYSTEM_MEMORY_STRESS

config SYSTEM_MEMORY_STRESS_PROGNAME
	string "Program name"
	default "memstress"
	---help---
		This is the name of the program that will be used when the NSH ELF
		program is installed.

config SYSTEM_MEMORY_STRESS_PRIORITY
	int "MEMORY stress task priority"
	default 100

config SYSTEM_MEMORY_STRESS_STACKSIZE
	int "MEMORY stress stack size"
	default DEFAULT_TASK_STACKSIZE

endif
```

## system/microros/Kconfig
```kconfig
#
# For a description of the syntax of this configuration file,
# see the file kconfig-language.txt in the NuttX tools repository.
#

menuconfig SYSTEM_MICROROS
	bool "micro-ROS Integration"
	default n
	depends on NET_UDP || SERIAL_TERMIOS
	---help---
		Enable micro-ROS integration for NuttX RTOS. Provides a ROS 2
		client library for embedded and real-time systems.

if SYSTEM_MICROROS

config MICROROS_DISTRO
	string "ROS 2 Distribution"
	default "jazzy"
	---help---
		Specifies the ROS 2 distribution branch (e.g., humble, jazzy, kilted).
		This determines which versions of micro-ROS packages are fetched.

choice
	prompt "Transport Method"
	default MICROROS_TRANSPORT_UDP

config MICROROS_TRANSPORT_UDP
	bool "UDP Transport"
	---help---
		Use UDP socket for communication with micro-ROS agent.

config MICROROS_TRANSPORT_SERIAL
	bool "Serial Transport"
	depends on SERIAL_TERMIOS
	---help---
		Use serial (UART/USB-CDC) for communication with micro-ROS agent.

endchoice

if MICROROS_TRANSPORT_UDP

config MICROROS_AGENT_IP
	string "Agent IP Address"
	default "10.42.0.214"
	---help---
		IP address of the micro-ROS agent.

config MICROROS_AGENT_PORT
	int "Agent Port"
	default 8888
	---help---
		UDP port of the micro-ROS agent.

endif

if MICROROS_TRANSPORT_SERIAL

config MICROROS_SERIAL_DEVICE
	string "Serial Device Path"
	default "/dev/ttyS0"
	---help---
		Serial device to use for transport (e.g., /dev/ttyS0, /dev/ttyACM0).

config MICROROS_SERIAL_BAUD
	int "Serial Baud Rate"
	default 115200
	---help---
		Baud rate for serial communication.

endif

config MICROROS_MAX_NODES
	int "Maximum Nodes"
	default 1
	---help---
		Maximum number of ROS nodes that can be created.

config MICROROS_MAX_PUBLISHERS
	int "Maximum Publishers"
	default 5
	---help---
		Maximum number of publishers per node.

config MICROROS_MAX_SUBSCRIPTIONS
	int "Maximum Subscriptions"
	default 5
	---help---
		Maximum number of subscriptions per node.

config MICROROS_MAX_SERVICES
	int "Maximum Services"
	default 1
	---help---
		Maximum number of services per node.

config MICROROS_MAX_CLIENTS
	int "Maximum Clients"
	default 1
	---help---
		Maximum number of service clients per node.

endif
```

## system/monkey/Kconfig
```kconfig
#
# For a description of the syntax of this configuration file,
# see the file kconfig-language.txt in the NuttX tools repository.
#

menuconfig SYSTEM_MONKEY
	tristate "Monkey test"
	select UINPUT_TOUCH
	select UINPUT_BUTTONS
	select LIBC_PRINT_EXTENSION
	default n

if SYSTEM_MONKEY

config SYSTEM_MONKEY_PRIORITY
	int "Task priority"
	default 110

config SYSTEM_MONKEY_STACKSIZE
	int "Stack size"
	default 4096

config SYSTEM_MONKEY_REC_DIR_PATH
	string "Recorder directory path"
	default "/data/monkey"

endif
```

## system/netdb/Kconfig
```kconfig
#
# For a description of the syntax of this configuration file,
# see the file kconfig-language.txt in the NuttX tools repository.
#

menuconfig SYSTEM_NETDB
	tristate "netdb interface"
	default n
	depends on LIBC_NETDB

if SYSTEM_NETDB

config SYSTEM_NETDB_STACKSIZE
	int "netdb task stack size"
	default DEFAULT_TASK_STACKSIZE

config SYSTEM_NETDB_PRIORITY
	int "netdb task priority"
	default 100

endif
```

## system/nsh/Kconfig
```kconfig
#
# For a description of the syntax of this configuration file,
# see the file kconfig-language.txt in the NuttX tools repository.
#

config SYSTEM_NSH
	tristate "NuttShell (NSH) example"
	default n
	select NSH_LIBRARY
	select SYSTEM_READLINE
	---help---
		Enable the NuttShell (NSH) example

if SYSTEM_NSH

config SYSTEM_NSH_PRIORITY
	int "NuttX shell thread priority"
	default 100

config SYSTEM_NSH_STACKSIZE
	int "NuttX shell stack size"
	default DEFAULT_TASK_STACKSIZE

config SYSTEM_NSH_PROGNAME
	string "Program name"
	default "nsh"
	---help---
		This is the name of the program that will be used when the NSH ELF
		program is installed.

endif
```

## system/ntpc/Kconfig
```kconfig
#
# For a description of the syntax of this configuration file,
# see the file kconfig-language.txt in the NuttX tools repository.
#

config SYSTEM_NTPC
	tristate "NTP Daemon Commands"
	default n
	select NETUTILS_NTPCLIENT
	depends on NET_UDP
	---help---
		Enable the NTP client example. This example provides a command-line
		interface to manage the NTP client for time synchronization.

if SYSTEM_NTPC

config SYSTEM_NTPC_PRIORITY
	int "NTPC task priority"
	default 100

config SYSTEM_NTPC_STACKSIZE
	int "NTPC stack size"
	default DEFAULT_TASK_STACKSIZE

endif
```

## system/nxcamera/Kconfig
```kconfig
#
# For a description of the syntax of this configuration file,
# see the file kconfig-language.txt in the NuttX tools repository.
#

config SYSTEM_NXCAMERA
	bool "NxCamera video test application"
	default n
	depends on VIDEO
	---help---
		Enable support for the NxCam media tester library and optional
		command line interface.

if SYSTEM_NXCAMERA

config NXCAMERA_MAINTHREAD_STACKSIZE
	int "NxCamera main thread stack size"
	default DEFAULT_TASK_STACKSIZE
	---help---
		Stack size to use with the NxCamera main thread.

config NXCAMERA_LOOPTHREAD_STACKSIZE
	int "NxCamera thread stack size"
	default PTHREAD_STACK_DEFAULT
	---help---
		Stack size to use with the NxCamera play thread.

config NXCAMERA_MSG_PRIO
	int "NxCamera priority of message queen"
	default 1
	---help---
		Priority of stop message to notice NxCamera thread.

config NXCAMERA_INCLUDE_HELP
	bool "Include HELP command and text"
	default y
	---help---
		Compiles in the NxCamera help text to provide online help
		for available commands with syntax.

endif
```

## system/nxcodec/Kconfig
```kconfig
#
# For a description of the syntax of this configuration file,
# see the file kconfig-language.txt in the NuttX tools repository.
#

config SYSTEM_NXCODEC
	bool "NxCodec test application"
	default n
	---help---
		This application is a command-line tool that verifies the functionality
		of NuttX codecs. Specifically, it serves as a verification tool for v4l2m2m.

		By default, it is the decodeing mode, with a default parameter size of
		640x480, input format of H264, and output format of YUV420. The `-i`
		parameter corresponds to the input parameter before it, and the `-i`
		parameter corresponds to the output parameter after it.

if SYSTEM_NXCODEC

config SYSTEM_NXCODEC_PROGNAME
	string "Program name"
	default "nxcodec"
	---help---
		This is the name of the program that will be used when the NSH ELF
		program is installed.

config SYSTEM_NXCODEC_PRIORITY
	int "nxcodec task priority"
	default 100

config SYSTEM_NXCODEC_STACKSIZE
	int "nxcodec stack size"
	default DEFAULT_TASK_STACKSIZE

endif # SYSTEM_NXCODEC
```

## system/nxdiag/Kconfig
```kconfig
menuconfig SYSTEM_NXDIAG
	bool "System information and diagnostic (nxdiag)"
	default n
	---help---
		Enable the nxdiag application to gather and display host
		and target system information. It can also perform some
		diagnostic checks on the host and target systems.

if SYSTEM_NXDIAG

config SYSTEM_NXDIAG_PRIORITY
	int "Nxdiag task priority"
	default 100

config SYSTEM_NXDIAG_STACKSIZE
	int "Nxdiag stack size"
	default DEFAULT_TASK_STACKSIZE

comment "NuttX system information"

config SYSTEM_NXDIAG_CONF
	bool "Get NuttX configuration"
	default n
	---help---
		Enable the nxdiag application to list the configuration options
		used to compile NuttX. This is useful for debugging the host and
		target systems. Enables the "-c" and "--nuttx-config" options.

config SYSTEM_NXDIAG_COMP_FLAGS
	bool "Get NuttX compilation flags"
	default n
	---help---
		Enable the nxdiag application to list the NuttX compilation
		flags. This is useful for debugging the host and target
		systems. Enables the "-f" and "--nuttx-flags" options.

comment "Host system infromation"

config SYSTEM_NXDIAG_HOST_PATH
	bool "Get host system PATH"
	default n
	---help---
		Enable the nxdiag application to list the host system PATH
		variable. This is useful for debugging the host system.
		Enables the "-p" and "--host-path" options.

config SYSTEM_NXDIAG_HOST_PACKAGES
	bool "Get host system packages"
	default n
	---help---
		Enable the nxdiag application to list the installed packages
		on the host system. This is useful for debugging the host
		system. Enables the "-k" and "--host-packages" options.

config SYSTEM_NXDIAG_HOST_MODULES
	bool "Get host system python modules"
	default n
	---help---
		Enable the nxdiag application to list the installed Python
		modules on the host system. This is useful for debugging the
		host system. Enables the "-m" and "--host-modules" options.

config SYSTEM_NXDIAG_VERBOSE
	bool "Verbose"
	default n
	---help---
		Enable printing nxdiag application information during build.

comment "Vendor specific information"

config SYSTEM_NXDIAG_ESPRESSIF
	bool "Espressif"
	depends on ARCH_CHIP_ESP32 || ARCH_CHIP_ESP32S2 || ARCH_CHIP_ESP32S3 || ARCH_CHIP_ESP32C3 || ARCH_CHIP_ESP32C6 || ARCH_CHIP_ESP32H2
	default n
	---help---
		Enable Espressif-specific information and checks.

config SYSTEM_NXDIAG_ESPRESSIF_CHIP
	bool "Espressif Chip"
	depends on ARCH_CHIP_ESP32 || ARCH_CHIP_ESP32S2 || ARCH_CHIP_ESP32S3 || ARCH_CHIP_ESP32C3 || ARCH_CHIP_ESP32C6 || ARCH_CHIP_ESP32H2
	default n
	---help---
		Enable Espressif-specific information about chip. Chip must be connected during build process.

config SYSTEM_NXDIAG_ESPRESSIF_CHIP_WO_TOOL
	bool "Espressif Chip info without esptool"
	depends on SYSTEM_NXDIAG_ESPRESSIF_CHIP
	default n
	---help---
		Enable Espressif-specific information about chip without using esptool.

endif # SYSTEM_NXDIAG
```

## system/nxlooper/Kconfig
```kconfig
#
# For a description of the syntax of this configuration file,
# see the file kconfig-language.txt in the NuttX tools repository.
#

config SYSTEM_NXLOOPER
	bool "NxLooper audio test application"
	default n
	depends on AUDIO
	---help---
		Enable support for the NxLoop media tester library and optional
		command line interface.

if SYSTEM_NXLOOPER

config NXLOOPER_MAINTHREAD_STACKSIZE
	int "NxLooper main thread stack size"
	default DEFAULT_TASK_STACKSIZE
	---help---
		Stack size to use with the NxLooper main thread.

config NXLOOPER_LOOPTHREAD_STACKSIZE
	int "NxLooper thread stack size"
	default PTHREAD_STACK_DEFAULT
	---help---
		Stack size to use with the NxLooper play thread.

config NXLOOPER_MSG_PRIO
	int "NxLooper priority of message queen"
	default 1
	---help---
		Priority of stop message to notice NxLooper thread.

config NXLOOPER_COMMAND_LINE
	tristate "Include nxlooper command line application"
	default y
	---help---
		Compiles in code for the nxlooper command line control.
		This is a text-based command line interface that uses
		the nxlooper library to play media files, control the
		volume, balance, bass, etc.

if NXLOOPER_COMMAND_LINE

config NXLOOPER_INCLUDE_HELP
	bool "Include HELP command and text"
	default y
	---help---
		Compiles in the NxLooper help text to provide online help
		for available commands with syntax.

endif

config NXLOOPER_INCLUDE_DEVICE_SEARCH
	bool "Include audio device search code"
	default y
	---help---
		Compiles in extra code to search the audio device directory
		for a suitable audio device to play the specified file.
		Disabling this feature saves some code space, but it will
		mean the calling application must specify the path of the
		audio device to use before performing any other operations.

config NXLOOPER_INCLUDE_PREFERRED_DEVICE
	bool "Include preferred audio device specification code"
	default y
	---help---
		Adds support for identifying a specific audio device  to use
		for audio operations.  If this feature is not enabled, then
		an audio device search will be performed.

config NXLOOPER_INCLUDE_SYSTEM_RESET
	bool "Include support for system / hardware reset"
	default n
	---help---
		When enabled, this feature will add code to enable issuing
		a HW reset via program call.  The system reset will perform
		a reset on all registered audio devices.

endif
```
