## system/psmq/Kconfig
```kconfig
#
# For a description of the syntax of this configuration file,
# see the file kconfig-language.txt in the NuttX tools repository.
#

comment "psmq requires SYSTEM_EMBEDLOG and !DISABLE_MQUEUE"
	depends on DISABLE_MQUEUE || !SYSTEM_EMBEDLOG

menuconfig SYSTEM_PSMQ
	bool "psmq"
	default n
	depends on !DISABLE_MQUEUE && SYSTEM_EMBEDLOG
	---help---
		psmq is tool set which allows IPC communication in publish/subscribe way
		created on top of posix messege queue. Full documentation is available
		at: https://psmq.bofc.pl (despite the domain, it is in english).

		Library is licensed under BSD 2-clause license. See LICENSE file in
		the downloaded code for license details.

if SYSTEM_PSMQ

config PSMQ_MAX_CLIENTS
	int "Max number of clients"
	default 8
	---help---
		This  defines  how  many  clients  single  broker process will
		support.  Broker will return error for clients that want to
		register to it and there are already max clients connected.  psmqd
		will  allocate client array with static storage duration that is
		about 12 bytes (may vary depending on architecture) for each
		client.

config PSMQ_MSG_MAX
	int "Max size of payload"
	range 6 2147483647
	default 24
	---help---
		Defines maximum size of message that can be sent via psmq.
		Message consists of topic and payload. Topic is always
		null-terminated after which payload follows. This allows
		for some flexibility, ie if PSMQ_MSG_MAX was be 10, then
		topic could be 3 bytes long and payload 7, but also
		topic could take 9 bytes and payload only 1.

		This value has direct impact on runtime memory usage by
		psmq as this increases size of struct that is used when
		allocating memory for client. This has no impact on
		number of bytes that are sent because only actual data
		is sent over mqueue.

config PSMQD_PRIORITY
	int "psmqd broker task priority"
	default 100

config PSMQD_STACKSIZE
	int "psmqd broker stack size"
	default DEFAULT_TASK_STACKSIZE

config PSMQ_TOOLS_PUB
	bool "Enable psmq_pub tool"
	default n
	---help---
		Enables program which allows to publish message over psmq directly
		from command line.

if PSMQ_TOOLS_PUB

config PSMQ_PUB_PRIORITY
	int "psmq_pub broker task priority"
	default 100

config PSMQ_PUB_STACKSIZE
	int "psmq_pub broker stack size"
	default DEFAULT_TASK_STACKSIZE

endif # PSMQ_TOOLS_PUB

config PSMQ_TOOLS_SUB
	bool "Enable psmq_sub tool"
	default n
	---help---
		Enables program which allows to listen to published messages on
		chosen topics. It also has capabilities to log these messages to
		a chosen file.

if PSMQ_TOOLS_SUB

config PSMQ_SUB_PRIORITY
	int "psmq_sub broker task priority"
	default 100

config PSMQ_SUB_STACKSIZE
	int "psmq_sub broker stack size"
	default DEFAULT_TASK_STACKSIZE

endif # PSMQ_TOOLS_SUB
endif # SYSTEM_PSMQ
```

## system/ptpd/Kconfig
```kconfig
#
# For a description of the syntax of this configuration file,
# see the file kconfig-language.txt in the NuttX tools repository.
#

config SYSTEM_PTPD
	tristate "PTP daemon commands"
	default n
	select NETUTILS_PTPD
	---help---
		Enable 'ptpd' command to start the PTP daemon

if SYSTEM_PTPD

config SYSTEM_PTPD_PRIORITY
	int "PTPD utility command task priority"
	default 100

config SYSTEM_PTPD_STACKSIZE
	int "PTPD utility command stack size"
	default DEFAULT_TASK_STACKSIZE

endif # SYSTEM_PTPD
```

## system/ramspeed/Kconfig
```kconfig
#
# For a description of the syntax of this configuration file,
# see the file kconfig-language.txt in the NuttX tools repository.
#

config SYSTEM_RAMSPEED
	tristate "RAM Speed Test"
	default n
	---help---
		Enable a simple RAM speed test.

if SYSTEM_RAMSPEED

config SYSTEM_RAMSPEED_PROGNAME
	string "Program name"
	default "ramspeed"
	---help---
		This is the name of the program that will be used when the NSH ELF
		program is installed.

config SYSTEM_RAMSPEED_PRIORITY
	int "RAM speed test task priority"
	default 100

config SYSTEM_RAMSPEED_STACKSIZE
	int "RAM speed test stack size"
	default DEFAULT_TASK_STACKSIZE

endif
```

## system/ramtest/Kconfig
```kconfig
#
# For a description of the syntax of this configuration file,
# see the file kconfig-language.txt in the NuttX tools repository.
#

config SYSTEM_RAMTEST
	tristate "RAM Test"
	default n
	---help---
		Enable a simple RAM test.

if SYSTEM_RAMTEST

config SYSTEM_RAMTEST_PROGNAME
	string "Program name"
	default "ramtest"
	depends on BUILD_LOADABLE
	---help---
		This is the name of the program that will be use when the NSH ELF
		program is installed.

config SYSTEM_RAMTEST_PRIORITY
	int "RAM test task priority"
	default 100

config SYSTEM_RAMTEST_STACKSIZE
	int "RAM test stack size"
	default 1024

endif
```

## system/ramtron/Kconfig
```kconfig
#
# For a description of the syntax of this configuration file,
# see the file kconfig-language.txt in the NuttX tools repository.
#

config SYSTEM_RAMTRON
	bool "RAMTRON"
	default n
	depends on EXPERIMENTAL
	---help---
		Enable support for the NSH RAMTRON command.

		This configuration is broken because it depends on obsoleted
		internal OS interfaces.  That's what you get for violating interface definitions!

if SYSTEM_RAMTRON
endif
```

## system/readline/Kconfig
```kconfig
#
# For a description of the syntax of this configuration file,
# see the file kconfig-language.txt in the NuttX tools repository.
#

menuconfig SYSTEM_READLINE
	bool "readline() Support"
	default n
	---help---
		Enable support for the readline() function.

if SYSTEM_READLINE

config READLINE_HAVE_EXTMATCH
	bool
	default n

config READLINE_ECHO
	bool "Echo character input"
	default y
	---help---
		Echo received character input back via stdout.  This is normal
		behavior and should be selected unless the source of stdin input
		already has local echo support or you need to suppress the back-channel
		responses for any other reason.

if READLINE_ECHO

config READLINE_TABCOMPLETION
	bool "Tab completion"
	default n
	depends on BUILTIN || READLINE_HAVE_EXTMATCH
	---help---
		Build in support for Unix-style tab completion.  This feature was
		originally provided by Nghia Ho.

if READLINE_TABCOMPLETION

config READLINE_MAX_BUILTINS
	int "Maximum built-in matches"
	default 64
	depends on BUILTIN
	---help---
		This the maximum number of matching names of builtin commands that
		will be displayed.

config READLINE_MAX_EXTCMDS
	int "Maximum external command matches"
	default 64
	depends on READLINE_HAVE_EXTMATCH
	---help---
		This the maximum number of matching names of external commands that
		will be displayed.

endif # READLINE_TABCOMPLETION

config READLINE_CMD_HISTORY
	bool "Command line history"
	default n
	---help---
		Build in support for Unix-style command history using up and down
		arrow keys.  This feature was originally provided by Nghia Ho.

		NOTE: Command line history is kept in an in-memory array and is
		shared.  In the FLAT or PROTECTED builds, this history is shared by
		all threads; in the KERNEL build, the command line history is shared
		by all threads in the process.  This means that in a FLAT build, for
		example, a built-in application started from NSH will have the same
		history as does NSH if it also uses readline().  This also means
		that different NSH sessions on serial, USB, or Telnet will also
		share the same history array.

		In a KERNEL build, each process will have a separately allocated
		history array so the issue is lessened.  History would still be
		shared amount pthreads within the same process, however.

if READLINE_CMD_HISTORY

config READLINE_CMD_HISTORY_LINELEN
	int "Command line history length"
	default 64 if DEFAULT_SMALL
	default 80 if !DEFAULT_SMALL
	---help---
		The maximum length of one command line in the in-memory array.  The
		total memory usage for the command line array will be
		READLINE_CMD_HISTORY_LINELEN x READLINE_CMD_HISTORY_LEN. Default:
		64/80

config READLINE_CMD_HISTORY_LEN
	int "Command line history records"
	default 4 if DEFAULT_SMALL
	default 16 if !DEFAULT_SMALL
	---help---
		The number of lines of history that will be buffered in the in-
		memory array.  The total memory usage for the command line array
		will be READLINE_CMD_HISTORY_LINELEN x READLINE_CMD_HISTORY_LEN.
		Default: 16

endif # READLINE_CMD_HISTORY
endif # READLINE_ECHO
endif # SYSTEM_READLINE
```

## system/resmonitor/Kconfig
```kconfig
#
# For a description of the syntax of this configuration file,
# see the file kconfig-language.txt in the NuttX tools repository.
#

config SYSTEM_RESMONITOR
	bool "enable resource monitor [showinfo]"
	default n
	---help---
		Enable resource show with specific duration.
		Should not use with LOW_RESOURCE_TEST at the same time.

if SYSTEM_RESMONITOR

config SYSTEM_RESMONITOR_PRIORITY
	int "Task priority"
	default 100

config SYSTEM_RESMONITOR_STACKSIZE
	int "Stack size"
	default 4096

config SYSTEM_RESMONITOR_FILL
	bool "[filldisk/fillcpu/fillmem]"
	default n

endif
```

## system/sched_note/Kconfig
```kconfig
#
# For a description of the syntax of this configuration file,
# see the file kconfig-language.txt in the NuttX tools repository.
#

config SYSTEM_NOTE
	tristate "Scheduler monitor"
	default n
	depends on DRIVER_NOTERAM
	---help---
		Enable the schedler instrumentation monitor

if SYSTEM_NOTE

config SYSTEM_NOTE_PROGNAME
	string "Program name"
	default "note"
	---help---
		This is the name of the program that will be used when the NSH ELF
		program is installed.

config SYSTEM_NOTE_PRIORITY
	int "Note daemon task priority"
	default 100

config SYSTEM_NOTE_STACKSIZE
	int "Note daemon stack size"
	default DEFAULT_TASK_STACKSIZE

config SYSTEM_NOTE_BUFFERSIZE
	int "Note daemon I/O buffer size"
	default 1024

config SYSTEM_NOTE_DELAY
	int "Note daemon sample delay (msec)"
	default 1000

endif # SYSTEM_NOTE
```

## system/sdcard/Kconfig
```kconfig
#
# For a description of the syntax of this configuration file,
# see the file kconfig-language.txt in the NuttX tools repository.
#

config SYSTEM_SDCARD
	bool "SD Card"
	default n
	---help---
		Enable support for the NSH sdcard command.

if SYSTEM_SDCARD
endif
```

## system/sensorscope/Kconfig
```kconfig
#
# For a description of the syntax of this configuration file,
# see the file kconfig-language.txt in the NuttX tools repository.
#

menuconfig SYSTEM_SENSORSCOPE
	bool "NxScope sensors stream app"
	default n
	depends on LOGGING_NXSCOPE
	select LOGGING_NXSCOPE_INTF_SERIAL
	select LOGGING_NXSCOPE_PROTO_SER

if SYSTEM_SENSORSCOPE

config SYSTEM_SENSORSCOPE_PROGNAME
	string "Program name"
	default "sensorscope"

config SYSTEM_SENSORSCOPE_PRIORITY
	int "nxscope task priority"
	default 100

config SYSTEM_SENSORSCOPE_STACKSIZE
	int "nxscope stack size"
	default DEFAULT_TASK_STACKSIZE

config SYSTEM_SENSORSCOPE_SERIAL_PATH
	string "nxscope serial path"
	default "/dev/ttyUSB0"

config SYSTEM_SENSORSCOPE_SERIAL_BAUD
	int "nxscope serial baud"
	default 115200
	---help---
		Ignored if set to 0 (for example for RTT interface)

config SYSTEM_SENSORSCOPE_CDCACM
	bool "nxscope CDCACM device support"
	depends on CDCACM
	default n

config SYSTEM_SENSORSCOPE_FORCE_ENABLE
	bool "nxscope force enable"
	default n

config SYSTEM_SENSORSCOPE_STREAMBUF_LEN
	int "nxscope stream buffer length"
	default 512

config SYSTEM_SENSORSCOPE_RXBUF_LEN
	int "nxscope RX buffer length"
	default 32

config SYSTEM_SENSORSCOPE_RX_PADDING
	int "nxscope RX padding"
	default 0

config SYSTEM_SENSORSCOPE_MAIN_INTERVAL
	int "nxscope main interval (microseconds)"
	default 100000
	---help---
		This value is responsible for the frequency at which stream
		frames will be sent and incoming frames will be received.

config SYSTEM_SENSORSCOPE_FETCH_INTERVAL
	int "nxscope sensor fetch interval (microseconds)"
	default 1000
	---help---
		This value is responsible for the frequency at which the sensors
		are read

endif # SYSTEM_SENSORSCOPE
```

## system/sensortest/Kconfig
```kconfig
#
# For a description of the syntax of this configuration file,
# see the file kconfig-language.txt in the NuttX tools repository.
#

config SYSTEM_SENSORTEST
	tristate "Sensor driver test"
	default n
	depends on SENSORS
	---help---
		Enable the Sensor driver test

if SYSTEM_SENSORTEST

config SYSTEM_SENSORTEST_PROGNAME
	string "Program name"
	default "sensortest"
	---help---
		This is the name of the program that will be used when the NSH ELF
		program is installed.

config SYSTEM_SENSORTEST_PRIORITY
	int "Sensor driver test task priority"
	default 100

config SYSTEM_SENSORTEST_STACKSIZE
	int "Sensor driver test stack size"
	default DEFAULT_TASK_STACKSIZE

endif
```

## system/setlogmask/Kconfig
```kconfig
#
# For a description of the syntax of this configuration file,
# see the file kconfig-language.txt in the NuttX tools repository.
#

config SYSTEM_SETLOGMASK
	tristate "'setlogmask' command"
	default n
	---help---
		Enable support for 'setlogmask' command used to set syslog level.

if SYSTEM_SETLOGMASK
config SYSTEM_SETLOGMASK_PROGNAME
	string "setlogmask program name"
	default "setlogmask"
	---help---
		This is the name of the program that will be used when the NSH ELF
		program is installed.

config SYSTEM_SETLOGMASK_PRIORITY
	int "setlogmask task priority"
	default 100

config SYSTEM_SETLOGMASK_STACKSIZE
	int "setlogmask stack size"
	default DEFAULT_TASK_STACKSIZE

endif
```

## system/settings/Kconfig
```kconfig
#
# Settings Storage Configuration
#

config SYSTEM_SETTINGS
	bool "Settings Functions"
	default n
	---help---
		The settings storage can be used to store and retrieve various
		configurable parameters. This storage is a RAM-based map (for fast access)
		but one or more files can be used too (so values can persist across system
		reboots).

if SYSTEM_SETTINGS

config SYSTEM_SETTINGS_MAP_SIZE
	int "Settings storage size"
	default 20
	---help---
		The size of the settings storage, i.e. the
		maximum number of settings that can be created.

config SYSTEM_SETTINGS_KEY_SIZE
	int "Settings key size"
	default 20
	---help---
		Maximum size of a setting key.

config SYSTEM_SETTINGS_VALUE_SIZE
	int "Settings value size"
	default 20
	---help---
		Maximum size of a string setting value.

config SYSTEM_SETTINGS_MAX_STORAGES
	int "Settings files"
	default 2
	---help---
		Maximum number of supported settings files.

config SYSTEM_SETTINGS_MAX_FILENAME
	int "Settings filename size"
	default 50
	---help---
		Maximum size of settings filename.

config SYSTEM_SETTINGS_CACHED_SAVES
	bool "Cache save operations"
	default y
	---help---
		If enabled saving to the storages will be cached.
		
		Whenever a save is triggered, the settings will only
		be saved in the RAM map (and will be immediately
		effective). Writes to the storages though will
		happen after a small delay.
		
		This improves performance greatly when multiple
		successive saves are to be performed, as the actual
		write will happen only once, asynchronously.

if SYSTEM_SETTINGS_CACHED_SAVES

config SYSTEM_SETTINGS_CACHE_TIME_MS
	int "Cache Delay (ms)"
	default 100
	---help---
		Sets the delay after a setting is changed before they are written
endif # SYSTEM_SETTINGS_CACHED_SAVES

config SYSTEM_SETTINGS_MAX_SIGNALS
	int "Max. settings signals"
	default 2
	---help---
		Maximum number of signals that can be registered
		on the settings storage.

config SYSTEM_SETTINGS_SIGNO
	int "Signal Number to use"
	default 32
	range 32 63
	---help---
		The Signal number to use for notifies

endif # SYSTEM_SETTINGS
```
