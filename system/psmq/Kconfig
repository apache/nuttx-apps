## system/smf/Kconfig
```kconfig
# SMF (State Machine Framework) configuration options
#
# For syntax reference, see kconfig-language.txt in the NuttX tools repository.

config SYSTEM_SMF
  bool "(SMF) support"
  default n
  ---help---
    Enables the State Machine Framework (SMF) for implementing state machines

if SYSTEM_SMF

config SYSTEM_SMF_ANCESTOR_SUPPORT
	bool "Enable ancestor/parent state support"
	default n
	---help---
	  Enables support for parent/ancestor relationships between SMF states.
	  Required for hierarchical state machines.

config SYSTEM_SMF_INITIAL_TRANSITION
	bool "Enable initial transition support"
	default n
	depends on SYSTEM_SMF_ANCESTOR_SUPPORT
	---help---
	  Enables support for initial transitions in hierarchical states.
	  Depends on ancestor/parent state support.

endif # SYSTEM_SMF
```

## system/spi/Kconfig
```kconfig
#
# For a description of the syntax of this configuration file,
# see the file kconfig-language.txt in the NuttX tools repository.
#

menuconfig SYSTEM_SPITOOL
	tristate "SPI tool"
	default n
	depends on SPI
	select SPI_DRIVER
	---help---
		Enable support for the SPI tool.

if SYSTEM_SPITOOL

config SPITOOL_PROGNAME
	string "Program name"
	default "spi"
	---help---
		This is the name of the program that will be used when the ELF
		program is installed.

config SPITOOL_PRIORITY
	int "Task priority"
	default 100

config SPITOOL_STACKSIZE
	int "Stack size"
	default DEFAULT_TASK_STACKSIZE

config SPITOOL_MINBUS
	int "Minimum bus number"
	default 0
	---help---
		Smallest bus index supported by the hardware (default 0).

config SPITOOL_MAXBUS
	int "Maximum bus number"
	default 3
	---help---
		Largest bus index supported by the hardware (default 3)

config SPITOOL_DEFFREQ
	int "SPI frequency"
	default 4000000
	---help---
		Default SPI frequency (default: 4000000)

config SPITOOL_DEFCMD
	int "CMD/DATA select"
	default 0
	range 0 1
	depends on SPI_CMDDATA
	---help---
		Send in command or data mode
		0 = Data mode
		1 = Command mode

config SPITOOL_DEFMODE
	int "SPI mode"
	default 0
	---help---
		Default SPI mode, where;
		0 = CPOL=0, CHPHA=0
		1 = CPOL=0, CHPHA=1
		2 = CPOL=1, CHPHA=0
		3 = CPOL=1, CHPHA=1

config SPITOOL_DEFWIDTH
	int "SPI Bit width"
	default 8
	---help---
		Number of bits per SPI transfer (default 8)

config SPITOOL_DEFWORDS
	int "Number of words to transfer"
	default 1
	---help---
		Number of words to be transferred (default 1)

endif # SYSTEM_SPITOOL
```

## system/stackmonitor/Kconfig
```kconfig
#
# For a description of the syntax of this configuration file,
# see the file kconfig-language.txt in the NuttX tools repository.
#

menuconfig SYSTEM_STACKMONITOR
	tristate "Stack Monitor"
	default n
	depends on FS_PROCFS && !_FS_PROCFS_EXCLUDE_PROCESS && STACK_COLORATION
	---help---
		If the stack coloration feature is enabled (STACK_COLORATION) this
		option will select the Stack Monitor.  The stack monitor is a daemon
		that will periodically assess stack usage by all tasks and threads
		in the system.

if SYSTEM_STACKMONITOR

config SYSTEM_STACKMONITOR_STACKSIZE
	int "Stack monitor daemon stack size"
	default 2048
	---help---
		The stack size to use the stack monitor daemon.  Default: 2048

config SYSTEM_STACKMONITOR_PRIORITY
	int "Stack monitor daemon priority"
	default 50
	---help---
		The priority to use the stack monitor daemon.  Default: 50

config SYSTEM_STACKMONITOR_INTERVAL
	int "Stack monitor dump frequency"
	default 2
	---help---
		The rate in seconds that the stack monitor will wait before dumping
		the next set stack usage information.  Default:  2 seconds.

config SYSTEM_STACKMONITOR_MOUNTPOINT
	string "procfs mountpoint"
	default "/proc"

endif
```

## system/stty/Kconfig
```kconfig
#
# For a description of the syntax of this configuration file,
# see the file kconfig-language.txt in the NuttX tools repository.
#

menuconfig SYSTEM_STTY
	tristate "stty - set terminal options"
	default n
	depends on SERIAL_TERMIOS
	---help---
		Enable the stty command to configure terminal (TTY) settings.
		This command allows you to view and change terminal attributes
		such as echo, canonical mode, and line endings.

if SYSTEM_STTY

config SYSTEM_STTY_PRIORITY
	int "stty task priority"
	default 100

config SYSTEM_STTY_STACKSIZE
	int "stty stack size"
	default DEFAULT_TASK_STACKSIZE

endif # SYSTEM_STTY
```

## system/sudoku/Kconfig
```kconfig
#
# For a description of the syntax of this configuration file,
# see misc/tools/kconfig-language.txt.
#

menuconfig SYSTEM_SUDOKU
	bool "Sudoku"
	default n
	select SYSTEM_READLINE
	---help---
		Enable the sudoku game.

if SYSTEM_SUDOKU

config SYSTEM_SUDOKU_STACKSIZE
	int "Sudoku stack size"
	default 1536
	---help---
		The size of stack allocated for the Sudoku task.

config SYSTEM_SUDOKU_PRIORITY
	int "Sudoku priority"
	default 100
	---help---
		The priority of the Sudoku task.

endif
```

## system/symtab/Kconfig
```kconfig
#
# For a description of the syntax of this configuration file,
# see the file kconfig-language.txt in the NuttX tools repository.
#

config SYSTEM_SYMTAB
	bool "User-provided symbol table"
	default n
	depends on EXECFUNCS_HAVE_SYMTAB && LIB_BOARDCTL
	select BOARDCTL_APP_SYMTAB
	---help---
		Build and include default symbol table in the NuttX application.
		The symbol table is selected by call symtab_initialize().  The
		table apps/system/symtab/symtab.inc has to be generated using
		mksymtab manually before this option is selected.
```

## system/sysinfo/Kconfig
```kconfig
#
# For a description of the syntax of this configuration file,
# see the file kconfig-language.txt in the NuttX tools repository.
#

menuconfig SYSTEM_SYSINFO
	bool "Sysinfo"
	default n
	---help---
		Enable support for the NSH sysinfo command.

if SYSTEM_SYSINFO

config SYSTEM_SYSINFO_STACKSIZE
	int "NSH sysinfo stack size"
	default 1024

endif
```

## system/syslogd/Kconfig
```kconfig
#
# For a description of the syntax of this configuration file,
# see the file kconfig-language.txt in the NuttX tools repository.
#

config SYSTEM_SYSLOGD
	bool "syslogd utility"
	default n
	depends on NET_UDP && SYSLOG_RFC5424
	---help---
		Enable support for the 'syslogd' utility. This utility will read syslog
		messages from the syslog device and transmit them over UDP in RFC 5424
		compatible format. Ensure the syslog device being used is capable of being
		read from.

if SYSTEM_SYSLOGD

config SYSTEM_SYSLOGD_PROGNAME
	string "syslogd progname"
	default "syslogd"
	---help---
		This is the name of the program that will be used when the syslogd
		program is installed.

config SYSTEM_SYSLOGD_PRIORITY
	int "syslogd task priority"
	default 100

config SYSTEM_SYSLOGD_STACKSIZE
	int "syslogd stack size"
	default DEFAULT_TASK_STACKSIZE

config SYSTEM_SYSLOGD_ENTRYSIZE
	int "Max entry size"
	default 480
	---help---
		The maximum size (in bytes) of the UDP message buffer for sending syslog
		entries. Set this value to the expected maximum length of a syslog entry. RFC
		5424 specifies a minimum maximum of 480.

config SYSTEM_SYSLOGD_PORT
	int "syslogd port"
	default 514
	---help---
		The default port for syslogd to send UDP traffic to.

config SYSTEM_SYSLOGD_ADDR
	string "Log server address"
	default "127.0.0.1"
	---help---
		The network address for syslogd to send UDP traffic to.

endif
```

## system/system/Kconfig
```kconfig
#
# For a description of the syntax of this configuration file,
# see the file kconfig-language.txt in the NuttX tools repository.
#

config SYSTEM_SYSTEM
	bool "System Command"
	default n
	select SCHED_WAITPID
	depends on NSH_LIBRARY
	---help---
		Enable support for the system() interface.  This will support
		execution of NSH commands from C code.

if SYSTEM_SYSTEM

config SYSTEM_SYSTEM_SHPATH
	string "Path to shell command"
	default "/bin/sh"
	depends on SYSTEM_NSH=m
	---help---
		This is the full path to the program in a mounted file system that
		implements the system() command.  That is, a program that starts the
		NSH shell, executes one command (in argv[1]), then exits.

config SYSTEM_SYSTEM_STACKSIZE
	int "system stack size"
	default DEFAULT_TASK_STACKSIZE
	---help---
		The size of stack allocated for the shell.

		NOTE: I needed to set the stack size quite large to get this example
		working on the simulated target (perhaps because of the 64-bit
		stack?  Or perhaps that is a sneak call into the host libc that I
		have not caught).  I assume that a smaller stack would be okay on
		real hardware, but I have not yet verified that.

config SYSTEM_SYSTEM_PRIORITY
	int "system priority"
	default 100
	---help---
		The priority of the shell.

endif
```

## system/taskset/Kconfig
```kconfig
#
# For a description of the syntax of this configuration file,
# see the file kconfig-language.txt in the NuttX tools repository.
#

config SYSTEM_TASKSET
	tristate "Taskset Command"
	default n
	depends on SMP && NSH_LIBRARY && SCHED_WAITPID
	---help---
		Enable support for the taskset command.

if SYSTEM_TASKSET
config SYSTEM_TASKSET_PROGNAME
	string "Taskset program name"
	default "taskset"
	depends on BUILD_LOADABLE
	---help---
		This is the name of the program that will be use when the NSH ELF
		program is installed.

config SYSTEM_TASKSET_PRIORITY
	int "Taskset task priority"
	default 50

config SYSTEM_TASKSET_STACKSIZE
	int "Taskset stack size"
	default 2048

endif
```

## system/tcpdump/Kconfig
```kconfig
#
# For a description of the syntax of this configuration file,
# see the file kconfig-language.txt in the NuttX tools repository.
#

config SYSTEM_TCPDUMP
	tristate "tcpdump command"
	default n
	depends on NET_PKT
	select SYSTEM_ARGTABLE3
	---help---
		Enable support for the 'tcpdump' command.

if SYSTEM_TCPDUMP

config SYSTEM_TCPDUMP_PROGNAME
	string "tcpdump program name"
	default "tcpdump"
	---help---
		This is the name of the program that will be used when the NSH ELF
		program is installed.

config SYSTEM_TCPDUMP_PRIORITY
	int "tcpdump task priority"
	default 100

config SYSTEM_TCPDUMP_STACKSIZE
	int "tcpdump stack size"
	default 4096

endif
```

## system/tee/Kconfig
```kconfig
#
# For a description of the syntax of this configuration file,
# see the file kconfig-language.txt in the NuttX tools repository.
#

config SYSTEM_TEE
	tristate "Tee Command"
	default n
	---help---
		Enable support for the tee command.

if SYSTEM_TEE

config SYSTEM_TEE_STACKSIZE
	int "tee stack size"
	default 1536
	---help---
		The size of stack allocated for the tee task.

config SYSTEM_TEE_PRIORITY
	int "tee priority"
	default 100
	---help---
		The priority of the tee task.

endif
```
