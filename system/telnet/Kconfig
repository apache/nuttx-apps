## system/telnet/Kconfig
```kconfig
#
# For a description of the syntax of this configuration file,
# see the file kconfig-language.txt in the NuttX tools repository.
#

menuconfig SYSTEM_TELNET_CHATD
	tristate "Telnet chat daemon"
	default n
	depends on NET && NET_TCP
	select NETUTILS_TELNETC
	---help---
		Enable the Telnet Chat daemon.

if SYSTEM_TELNET_CHATD

config SYSTEM_TELNET_CHATD_PROGNAME
	string "Chat daemon program name"
	default "chatd"

config SYSTEM_TELNET_CHATD_STACKSIZE
	int "Chat daemon stacksize"
	default DEFAULT_TASK_STACKSIZE

config SYSTEM_TELNET_CHATD_PRIORITY
	int "Chat daemon priority"
	default 100

endif # SYSTEM_TELNET_CHATD

menuconfig SYSTEM_TELNET_CLIENT
	tristate "Telnet client"
	default n
	depends on NET && NET_TCP
	select NETUTILS_TELNETC
	select SYSTEM_READLINE
	---help---
		Enable the Telnet client program.

if SYSTEM_TELNET_CLIENT

config SYSTEM_TELNET_CLIENT_PROGNAME
	string "Telnet client program name"
	default "telnet"

config SYSTEM_TELNET_CLIENT_STACKSIZE
	int "Telnet client stacksize"
	default DEFAULT_TASK_STACKSIZE

config SYSTEM_TELNET_CLIENT_PRIORITY
	int "Telnet client priority"
	default 100

endif # SYSTEM_TELNET_CLIENT
```

## system/telnetd/Kconfig
```kconfig
#
# For a description of the syntax of this configuration file,
# see the file kconfig-language.txt in the NuttX tools repository.
#

config SYSTEM_TELNETD
	tristate "Telnet daemon application"
	default !DEFAULT_SMALL
	depends on NETUTILS_TELNETD
	---help---
		Enable the Telnet daemon application

if SYSTEM_TELNETD

config SYSTEM_TELNETD_PROGNAME
	string "Telnetd program name"
	default "telnetd"
	---help---
		This is the name of the program that will be used when the NSH ELF
		program is installed.

config SYSTEM_TELNETD_PRIORITY
	int "Telnetd task priority"
	default 100

config SYSTEM_TELNETD_STACKSIZE
	int "Telnetd task stack size"
	default DEFAULT_TASK_STACKSIZE

config SYSTEM_TELNETD_PORT
	int "Telnetd port number"
	default 23
	---help---
		The telnet daemon will listen on this TCP port number for connections.
		Default: 23

config SYSTEM_TELNETD_SESSION_PRIORITY
	int "Telnetd session task priority"
	default 100

config SYSTEM_TELNETD_SESSION_STACKSIZE
	int "Telnetd session task stack size"
	default SYSTEM_NSH_STACKSIZE if SYSTEM_NSH
	default DEFAULT_TASK_STACKSIZE

endif # SYSTEM_TELNETD
```

## system/termcurses/Kconfig
```kconfig
#
# For a description of the syntax of this configuration file,
# see the file kconfig-language.txt in the NuttX tools repository.
#

if SERIAL || TELNET

config SYSTEM_TERMCURSES
	bool "Terminal Curses control support"
	default n
	---help---
		Terminal emulation library for curses support on TTY type consoles
		such as serial port, CDCACM, telnet, etc.

config SYSTEM_TERMCURSES_VT100
	bool "Terminal pdcurses support for VT-100"
	depends on SYSTEM_TERMCURSES
	default y

config SYSTEM_TERMCURSES_VT100_OSX_ALT_CODES
	bool "Support Mac OSX ALT keycodes in vt100 emulation."
	depends on SYSTEM_TERMCURSES_VT100
	default y

config SYSTEM_TERMCURSES_DEBUG_KEYCODES
	bool "Print raw terminal escape sequences for debug."
	depends on SYSTEM_TERMCURSES
	default n

config SYSTEM_TERMCURSES_INCLUDE_TERMINFO_NAME
	bool "Compile in static const 'terminfo' key names (for future use)."
	depends on SYSTEM_TERMCURSES
	default n

endif # SYSTEM_TERMCURSES
```

## system/trace/Kconfig
```kconfig
#
# For a description of the syntax of this configuration file,
# see the file kconfig-language.txt in the NuttX tools repository.
#

config SYSTEM_TRACE
	tristate "Trace command"
	default n
	depends on DRIVER_NOTECTL
	---help---
		Enable support for the trace command.

if SYSTEM_TRACE

config SYSTEM_TRACE_PROGNAME
	string "Trace program name"
	default "trace"
	---help---
		This is the name of the program that will be used when the NSH ELF
		program is installed.

config SYSTEM_TRACE_PRIORITY
	int "Trace task priority"
	default 100

config SYSTEM_TRACE_STACKSIZE
	int "Trace stack size"
	default DEFAULT_TASK_STACKSIZE

endif
```

## system/ubloxmodem/Kconfig
```kconfig
#
# For a description of the syntax of this configuration file,
# see the file kconfig-language.txt in the NuttX tools repository.
#


menuconfig SYSTEM_UBLOXMODEM
	tristate "u-blox modem configuration tool"
	default n
	---help---
		Enable the u-blox modem configuration tool.

		This app provides a command-line interface to GPIO power controls of
		u-blox modem. The actual behaviour should be implemented in the lower-
		half modem driver. Additionally the app can send test AT commands to
		the modem via the TTY device node settable in the defconfig:

			CONFIG_SYSTEM_UBLOXMODEM_TTY_DEVNODE="/dev/ttyS1"

if SYSTEM_UBLOXMODEM

config SYSTEM_UBLOXMODEM_TTY_DEVNODE
	string "u-blox modem TTY device node"
	default "/dev/ttyS1"
	---help---
		TTY device node associated to the u-blox modem UART.

config SYSTEM_UBLOXMODEM_DEVNODE
	string "u-blox modem device node"
	default "/dev/ubxmdm"
	---help---
		Device node created by the u-blox modem driver.

endif
```

## system/uniqueid/Kconfig
```kconfig
#
# For a description of the syntax of this configuration file,
# see the file kconfig-language.txt in the NuttX tools repository.
#

config SYSTEM_UNIQUEID
       tristate "'uniqueid' command"
       default n
       depends on BOARDCTL_UNIQUEID
       ---help---
               Enable the uniqueid tool

if SYSTEM_UNIQUEID
endif
```

## system/uorb/Kconfig
```kconfig
#
# For a description of the syntax of this configuration file,
# see the file kconfig-language.txt in the NuttX tools repository.
#

menuconfig UORB
	tristate "uorb(micro object request broker)"
	depends on SENSORS && USENSOR
	default n

if UORB

config UORB_PRIORITY
	int "task priority"
	default 100

config UORB_STACKSIZE
	int "stack size"
	default DEFAULT_TASK_STACKSIZE

config UORB_LISTENER
	bool "uorb listener"
	default n

config UORB_TESTS
	bool "uorb unit tests"
	default n

if UORB_TESTS

config UORB_SRORAGE_DIR
	string "uorb test result storage dir"
	default "/data/"

endif # UORB_TESTS

config DEBUG_UORB
	bool "uorb debug output"
	default n

if DEBUG_UORB

config UORB_ALERT
	bool "uorb panic output"
	default n
	depends on DEBUG_ALERT

config UORB_ERROR
	bool "uorb error output"
	default n
	depends on DEBUG_ERROR

config UORB_WARN
	bool "uorb warn output"
	default n
	depends on DEBUG_WARN

config UORB_INFO
	bool "uorb info output"
	default n
	depends on DEBUG_INFO

endif # DEBUG_UORB

endif # UORB
```

## system/usbmonitor/Kconfig
```kconfig
#
# For a description of the syntax of this configuration file,
# see misc/tools/kconfig-language.txt.
#

menuconfig SYSTEM_USBMONITOR
	bool "USB Monitor"
	default n
	depends on (USBDEV && USBDEV_TRACE) || (USBHOST && USBHOST_TRACE)
	---help---
		If USB device tracing (USBDEV_TRACE) AND/OR USB host tracing
		(USBHOST_TRACE) are enabled then this option will select the USB
		monitor.  The USB monitor is a daemon that will periodically collect
		the buffered USB trace data and dump it to the SYSLOG device.

if SYSTEM_USBMONITOR

config SYSTEM_USBMONITOR_STACKSIZE
	int "USB Monitor daemon stack size"
	default 2048
	---help---
		The stack size to use the the USB monitor daemon.  Default: 2048

config SYSTEM_USBMONITOR_PRIORITY
	int "USB Monitor daemon priority"
	default 50
	---help---
		The priority to use the the USB monitor daemon.  Default: 50

config SYSTEM_USBMONITOR_INTERVAL
	int "USB Monitor dump frequency"
	default 2
	---help---
		The rate in seconds that the USB monitor will wait before dumping
		the next set of buffered USB trace data.  Default:  2 seconds.

if USBDEV && USBDEV_TRACE
config SYSTEM_USBMONITOR_TRACEINIT
	bool "Show USB device initialization events"
	default n
	---help---
		Show initialization events

config SYSTEM_USBMONITOR_TRACECLASS
	bool "Show USB device class driver events"
	default n
	---help---
		Show class driver events

config SYSTEM_USBMONITOR_TRACETRANSFERS
	bool "Show USB device data transfer events"
	default n
	---help---
		Show data transfer events

config SYSTEM_USBMONITOR_TRACECONTROLLER
	bool "Show USB device controller events"
	default n
	---help---
		Show controller events

config SYSTEM_USBMONITOR_TRACEINTERRUPTS
	bool "Show USB device interrupt-related events"
	default n
	---help---
		Show interrupt-related events

endif
endif
```

## system/usbmsc/Kconfig
```kconfig
#
# For a description of the syntax of this configuration file,
# see the file kconfig-language.txt in the NuttX tools repository.
#

menuconfig SYSTEM_USBMSC
	tristate "USB Mass Storage Device Commands"
	default n
	depends on LIB_BOARDCTL && USBMSC && !KERNEL_BUILD
	select BOARDCTL_USBDEVCTRL
	---help---
		Enable the USB mass storage class controls.  These controls include:

		msconn:  Connect the mass storage device to the host
		msdis :  Disconnect the mass storage device to the host

if SYSTEM_USBMSC

config SYSTEM_USBMSC_NLUNS
	int "Number of LUNs"
	default 1
	---help---
		Defines the number of logical units (LUNs) exported by the USB
		storage driver.  Each LUN corresponds to one exported block driver
		(or partition of a block driver).  May be 1, 2, or 3.  Default is 1.

config SYSTEM_USBMSC_DEVMINOR1
	int "LUN1 Minor Device Number"
	default 0
	---help---
		The minor device number of the block driver for the first LUN. For
		example, N in /dev/mmcsdN.  Used for registering the block driver.
		Default is zero.

config SYSTEM_USBMSC_DEVPATH1
	string "LUN1 Device Path"
	default "/dev/mmcsd0"
	---help---
		The full path to the registered block driver.  Default is
		"/dev/mmcsd0"

config SYSTEM_USBMSC_WRITEPROTECT1
	bool "LUN1 Write-protected"
	default n
	---help---
		Enable this if you want to write-protect the first LUN. Default is
		off.

config SYSTEM_USBMSC_DEVMINOR2
	int "LUN2 Minor Device Number"
	default 1
	---help---
		The minor device number of the block driver for the second LUN. For
		example, N in /dev/mmcsdN.  Used for registering the block driver.
		Ignored if SYSTEM_USBMSC_NLUNS < 2. Default is one.

config SYSTEM_USBMSC_DEVPATH2
	string "LUN2 Device Path"
	default "/dev/mmcsd1"
	---help---
		The full path to the registered block driver.  Ignored if
		SYSTEM_USBMSC_NLUNS < 2. Default is "/dev/mmcsd1"

config SYSTEM_USBMSC_WRITEPROTECT2
	bool "LUN2 Write-protected"
	default n
	---help---
		Enable this if you want to write-protect the second LUN. Ignored if
		SYSTEM_USBMSC_NLUNS < 2. Default is off.

config SYSTEM_USBMSC_DEVMINOR3
	int "LUN3 Minor Device Number"
	default 2
	---help---
		The minor device number of the block driver for the third LUN. For
		example, N in /dev/mmcsdN.  Used for registering the block driver.
		Ignored if SYSTEM_USBMSC_NLUNS < 3. Default is two.

config SYSTEM_USBMSC_DEVPATH3
	string "LUN3 Device Path"
	default "/dev/mmcsd2"
	---help---
		The full path to the registered block driver.  Ignored if
		SYSTEM_USBMSC_NLUNS < 3. Default is "/dev/mmcsd2"

config SYSTEM_USBMSC_WRITEPROTECT3
	bool "LUN3 Write-protected"
	default n
	---help---
		Enable this if you want to write-protect the third LUN. Ignored if
		SYSTEM_USBMSC_NLUNS < 3. Default is off.

config SYSTEM_USBMSC_DEBUGMM
	bool "USB MSC MM Debug"
	default n
	---help---
		Enables some debug tests to check for memory usage and memory leaks.

config SYSTEM_USBMSC_TRACE
	bool "Trace USB activity"
	default n
	depends on (USBDEV_TRACE || DEBUG_USB) && !NSH_BUILTIN_APPS
	---help---
		If this add-on is built as a standalone task and if USB device tracing is
		enabled, then this add-on can be configured to unobtrusively monitor
		USB activity by selecting this option.

if SYSTEM_USBMSC_TRACE

config SYSTEM_USBMSC_TRACEINIT
	bool "USB Trace Initialization"
	default n
	---help---
		If USBDEV_TRACE is enabled (or CONFIG_DEBUG_FEATURES and CONFIG_DEBUG_USB),
		then the add-on code will also manage the USB trace output.  The
		amount of trace output can be controlled this configuration value:
		This setting will show USB initialization events

config SYSTEM_USBMSC_TRACECLASS
	bool "USB Trace Class"
	default n
	---help---
		If USBDEV_TRACE is enabled (or CONFIG_DEBUG_FEATURES and CONFIG_DEBUG_USB),
		then the add-on code will also manage the USB trace output.  The
		amount of trace output can be controlled this configuration value:
		This setting will show USB class driver events

config SYSTEM_USBMSC_TRACETRANSFERS
	bool "USB Trace Transfers"
	default n
	---help---
		If USBDEV_TRACE is enabled (or CONFIG_DEBUG_FEATURES and CONFIG_DEBUG_USB),
		then the add-on code will also manage the USB trace output.  The
		amount of trace output can be controlled this configuration value:
		This setting will show USB data transfer events

config SYSTEM_USBMSC_TRACECONTROLLER
	bool "USB Trace Device Controller Events"
	default n
	---help---
		If USBDEV_TRACE is enabled (or CONFIG_DEBUG_FEATURES and CONFIG_DEBUG_USB),
		then the add-on code will also manage the USB trace output.  The
		amount of trace output can be controlled this configuration value:
		This setting will show USB device controller events

config SYSTEM_USBMSC_TRACEINTERRUPTS
	bool "USB Trace Device Controller Interrupt Events"
	default n
	---help---
		If USBDEV_TRACE is enabled (or CONFIG_DEBUG_FEATURES and CONFIG_DEBUG_USB),
		then the add-on code will also manage the USB trace output.  The
		amount of trace output can be controlled this configuration value:
		This setting will show USB device controller interrupt-related events.

endif # SYSTEM_USBMSC_TRACE

if NSH_BUILTIN_APPS

config SYSTEM_USBMSC_CMD_STACKSIZE
	int "Stacksize of msconn and msdis commands"
	default 768
	---help---
		Size of the stack used by the small 'msconn' and 'msdis' command
		applications.  Warning, just because the applications are small,
		the stack usage could still be deep!

config SYSTEM_USBMSC_CMD_PRIORITY
	int "Priority of the msconn and msdis commands"
	default 100
	---help---
		Priority of the small 'msconn' and 'msdis' command applications.

endif # NSH_BUILTIN_APPS
endif # SYSTEM_USBMSC
```

## system/usrsock_rpmsg/Kconfig
```kconfig
#
# For a description of the syntax of this configuration file,
# see the file kconfig-language.txt in the NuttX tools repository.
#

config SYSTEM_USRSOCK_RPMSG
	tristate "RPMSG usrsock"
	default n
	depends on NET && OPENAMP
	---help---
		Enable usrsock through rpmsg channel.

if SYSTEM_USRSOCK_RPMSG

config SYSTEM_USRSOCK_RPMSG_PRIORITY
	int "usrsock task priority"
	default 80
	---help---
		The priority for usrsock task.

config SYSTEM_USRSOCK_RPMSG_STACKSIZE
	int "usrsock task stack size"
	default 2048
	---help---
		The stack size allocated for the usrsock task.

endif # SYSTEM_USRSOCK_RPMSG
```

## system/vncviewer/Kconfig
```kconfig
#
# For a description of the syntax of this configuration file,
# see the file kconfig-language.txt in the NuttX tools repository.
#

config SYSTEM_VNCVIEWER
	tristate "VNC Viewer"
	default n
	depends on NET_TCP && LCD
	---help---
		Enable the VNC Viewer example application.
		Connects to a VNC server and displays the remote
		framebuffer on a local LCD.

if SYSTEM_VNCVIEWER

config SYSTEM_VNCVIEWER_PROGNAME
	string "Program name"
	default "vncviewer"
	---help---
		This is the name of the program that will be used when the
		NSH ELF program is installed.

config SYSTEM_VNCVIEWER_PRIORITY
	int "VNC Viewer task priority"
	default 100

config SYSTEM_VNCVIEWER_STACKSIZE
	int "VNC Viewer stack size"
	default 4096

endif
```
