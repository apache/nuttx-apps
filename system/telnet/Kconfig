## testing/atomic/Kconfig
```kconfig
#
# For a description of the syntax of this configuration file,
# see the file kconfig-language.txt in the NuttX tools repository.
#

config TESTING_ATOMIC
	tristate "\"Test atomic\" testing"
	default n
	---help---
		Enable the \"Test atomic!\" testing.

if TESTING_ATOMIC

config TESTING_ATOMIC_PROGNAME
	string "Program name"
	default "atomic"
	---help---
		This is the name of the program that will be used when the NSH ELF
		program is atomic.

config TESTING_ATOMIC_PRIORITY
	int "Atomic task priority"
	default 100

config TESTING_ATOMIC_STACKSIZE
	int "Atomic stack size"
	default DEFAULT_TASK_STACKSIZE

endif
```

## testing/batterydump/Kconfig
```kconfig
#
# For a description of the syntax of this configuration file,
# see the file kconfig-language.txt in the NuttX tools repository.
#
#
config TESTING_BATTERYDUMP
	tristate "Battery dump for test"
	default n
	---help---
		Enable the battery dump

if TESTING_BATTERYDUMP

config TESTING_BATTERYDUMP_PROGNAME
	string "Program name"
	default "batterydump"
	---help---
		This is the name of the program that will be used when the NSH ELF
		program is installed.

config TESTING_BATTERYDUMP_PRIORITY
	int "Battery dump task priority"
	default 100

config TESTING_BATTERYDUMP_STACKSIZE
	int "Battery dump stack size"
	default DEFAULT_TASK_STACKSIZE

endif
```

## testing/cmocka/Kconfig
```kconfig
#
# For a description of the syntax of this configuration file,
# see the file kconfig-language.txt in the NuttX tools repository.
#

config TESTING_CMOCKA
	bool "Enable libcmocka"
	depends on LIBC_REGEX
	default n
	---help---
		Enable libcmocka and run all testcases

if TESTING_CMOCKA

config TESTING_CMOCKA_PROG
	tristate "Compile cmocka binary"
	default n
	---help---
		Instead of just compiling cmocka as a library, the 'cmocka' binary is
		also included.

if TESTING_CMOCKA_PROG

config TESTING_CMOCKA_PROGNAME
	string "Program name"
	default "cmocka"
	---help---
		This is the name of the program that will be used when the NSH ELF
		program is installed.

config TESTING_CMOCKA_PRIORITY
	int "cmocka test task priority"
	default 100

config TESTING_CMOCKA_STACKSIZE
	int "cmocka test stack size"
	default DEFAULT_TASK_STACKSIZE

endif # TESTING_CMOCKA_PROG

config TESTING_CMOCKA_LEAKDETECT
	bool "Detect leaks"
	default n
	---help---
		Memory leaks can be checked using cmocka, please use in a local
		environment.

endif
```

## testing/crypto/Kconfig
```kconfig
config TESTING_CRYPTO
	tristate "crypto test"
	default n
	---help---
		Enable crypto test

if TESTING_CRYPTO

config TESTING_CRYPTO_3DES_CBC
	bool "3des-cbc crypto test"
	default y

config TESTING_CRYPTO_AES_CBC
	bool "aes-cbc crypto test"
	default y

config TESTING_CRYPTO_AES_CTR
	bool "aes-ctr crypto test"
	default y

config TESTING_CRYPTO_AES_XTS
	bool "aes-xts crypto test"
	default y

config TESTING_CRYPTO_HMAC
	bool "hmac crypto test"
	default y

config TESTING_CRYPTO_HASH
	bool "hash crypto test"
	default n

if TESTING_CRYPTO_HASH

config TESTING_CRYPTO_HASH_HUGE_BLOCK
	bool "hash huge block crypto test"
	default y

endif

config TESTING_CRYPTO_CRC32
	bool "crc32 crypto test"
	default n

config TESTING_CRYPTO_AES_CMAC
	bool "aes-cmac crypto test"
	default n

config TESTING_CRYPTO_ECDSA
	bool "ecdsa crypto test"
	default n

config TESTING_CRYPTO_ECDH
	bool "ecdh crypto test"
	default n

config TESTING_CRYPTO_RSA
	bool "rsa crypto test"
	default n

config TESTING_CRYPTO_PRIORITY
	int "crypto test task priority"
	default 100

config TESTING_CRYPTO_STACKSIZE
	int "crypto test stack size"
	default DEFAULT_TASK_STACKSIZE

endif
```

## testing/crypto/passwd/Kconfig
```kconfig
#
# For a description of the syntax of this configuration file,
# see the file kconfig-language.txt in the NuttX tools repository.
#

config TESTING_PBKDF2
	tristate "PBKDF2 and passwd hash test"
	default n
	depends on FSUTILS_PASSWD
	---help---
		Enable the PBKDF2-HMAC-SHA256 unit test
		(apps/testing/crypto/passwd).  Always runs RFC 6070 SHA-256
		vectors.  The passwd_encrypt / passwd_verify round-trip runs only
		when FSUTILS_PASSWD_READONLY is disabled and DEV_URANDOM is
		enabled; otherwise it is skipped with an explanatory message.

if TESTING_PBKDF2

config TESTING_PBKDF2_PRIORITY
	int "pbkdf2_test task priority"
	default 100

config TESTING_PBKDF2_STACKSIZE
	int "pbkdf2_test stack size"
	default DEFAULT_TASK_STACKSIZE

config TESTING_PBKDF2_SLOW_VECTOR
	bool "Run RFC 6070 vector with 16777216 iterations"
	default n
	---help---
		Include RFC 6070 test vector #4 (16,777,216 iterations).  This
		takes a long time on embedded targets; enable only for manual runs.

endif
```
