## system/xz/Kconfig
```kconfig
#
# For a description of the syntax of this configuration file,
# see the file kconfig-language.txt in the NuttX tools repository.
#

config UTILS_XZ
	tristate "xz utils"
	default n

if UTILS_XZ

config UTILS_XZ_APP
	bool "xz program"
	default n

if UTILS_XZ_APP

config UTILS_XZ_PROGNAME
	string "Programe Name"
	default "xz"

config UTILS_XZ_PRIORITY
	int "xz priority"
	default 100

config UTILS_XZ_STACKSIZE
	int "xz stacksize"
	default 4096

endif

config UTILS_XZDEC_APP
	bool "xz program"
	default n

if UTILS_XZDEC_APP

config UTILS_XZDEC_PROGNAME
	string "Programe Name"
	default "xzdec"

config UTILS_XZDEC_PRIORITY
	int "xz priority"
	default 100

config UTILS_XZDEC_STACKSIZE
	int "xz stacksize"
	default 4096

endif

endif
```

## system/ymodem/Kconfig
```kconfig
#
# For a description of the syntax of this configuration file,
# see the file kconfig-language.txt in the NuttX tools repository.
#

config SYSTEM_YMODEM
	tristate "YMODEM"
	---help---
		Enable support for ymodem.

if SYSTEM_YMODEM

config SYSTEM_YMODEM_STACKSIZE
	int "ymodem stack size"
	default DEFAULT_TASK_STACKSIZE
	---help---
		The size of stack allocated for the ymodem task.

config SYSTEM_YMODEM_PRIORITY
	int "ymodem priority"
	default 100
	---help---
		The priority of the ymodem task.

config SYSTEM_YMODEM_DEBUG
	bool "ymodem debug"
	default n

config SYSTEM_YMODEM_DEBUG_FILEPATH
	string "save ymodem debug log path"
	depends on SYSTEM_YMODEM_DEBUG
	default "/tmp/ymodem"

endif
```

## system/zlib/Kconfig
```kconfig
#
# For a description of the syntax of this configuration file,
# see the file kconfig-language.txt in the NuttX tools repository.
#

config LIB_ZLIB
	tristate "zlib data compression library"
	default n

if LIB_ZLIB

config LIB_ZLIB_TEST
	tristate "zlib test"
	default n
	---help---
		Enable the test for zlib.

if LIB_ZLIB_TEST

config LIB_ZLIB_TEST_PRIORITY
	int "Zlib test priority"
	default 100

config LIB_ZLIB_TEST_STACKSIZE
	int "Zlib test stack size"
	default DEFAULT_TASK_STACKSIZE

endif # LIB_ZLIB_TEST

config UTILS_GZIP
	bool "GZIP tool"
	default n
	---help---
		Enable gzip utility

if UTILS_GZIP
config UTILS_GZIP_PROGNAME
	string "Programe Name"
	default "gzip"

config UTILS_GZIP_PRIORITY
	int "gzip utility priority"
	default 100

config UTILS_GZIP_STACKSIZE
	int "gzip utility statcksize"
	default 32768

endif # UTILS_GZIP

config UTILS_ZIP
	bool "ZIP tool"
	default n
	---help---
		Enable zip utility

if UTILS_ZIP
config UTILS_ZIP_PROGNAME
	string "Programe Name"
	default "zip"

config UTILS_ZIP_PRIORITY
	int "zip utility priority"
	default 100

config UTILS_ZIP_STACKSIZE
	int "zip utility statcksize"
	default 32768

endif # UTILS_ZIP

config UTILS_UNZIP
	bool "UNZIP tool"
	default n
	---help---
		Enable unzip utility

if UTILS_UNZIP
config UTILS_UNZIP_PROGNAME
	string "Programe Name"
	default "unzip"

config UTILS_UNZIP_PRIORITY
	int "unzip utility priority"
	default 100

config UTILS_UNZIP_STACKSIZE
	int "unzip utility statcksize"
	default 32768

endif # UTILS_UNZIP

config LIB_ZLIB_MAX_WBITS
	int "Zlib max wbits"
	default 15
	range 8 15
	---help---
		Default windowBits. memory usage (1 << (windowBits+2)) bytes.

config LIB_ZLIB_MAX_MEM_LEVEL
	int "Zlib max mem level"
	default 8
	range 1 9
	---help---
		Default memLevel. memory usage (1 << (memLevel+9)) bytes.

endif # LIB_ZLIB
```

## system/zmodem/Kconfig
```kconfig
#
# For a description of the syntax of this configuration file,
# see the file kconfig-language.txt in the NuttX tools repository.
#

menuconfig SYSTEM_ZMODEM
	bool "Zmodem Commands"
	default n
	---help---
		This selection enables the 'sz' and 'rz' NSH commands.

		NOTE:  Hardware flow control is required on the selected device in
		order to throttle the rates of data transfer to fit within the
		allocated buffers.  This cannot be checked here in the configuration
		because the device that you use may be selected at runtime.

if SYSTEM_ZMODEM

config SYSTEM_ZMODEM_PRIORITY
	int "rz/sz task priority"
	default 100

config SYSTEM_ZMODEM_STACKSIZE
	int "rz/ez stack size"
	default 2048

config SYSTEM_ZMODEM_DEVNAME
	string "Default Zmodem device"
	default "/dev/console"
	---help---
		The default device used by the Zmodem commands if the -d option is
		not provided on the sz or rz command line.  Default:  "/dev/console".

		NOTE:  This device *MUST* support Hardware flow control in order to
		throttle the rates of data transfer to fit within the allocated buffers.

config SYSTEM_ZMODEM_RCVBUFSIZE
	int "Receive buffer size"
	default 512
	---help---
		The size of one buffer used to read data from the remote peer.  The
		total buffering capability is SYSTEM_ZMODEM_RCVBUFSIZE plus the size
		of the RX buffer in the device driver.  If you are using a serial
		driver with, say, USART0.  That that buffering capability includes
		USART0_RXBUFFERSIZE.  This total buffering capability must be
		significantly larger than SYSTEM_ZMODEM_PKTBUFSIZE (larger due
		streaming race conditions, data expansion due to escaping, and
		possible protocol overhead).

config SYSTEM_ZMODEM_PKTBUFSIZE
	int "Maximum packet size"
	default 512
	---help---
		Data may be received in gulps of varying size and alignment.
		Received packets data is properly unescaped, aligned and packed
		into a packet buffer of this size.

config SYSTEM_ZMODEM_SNDBUFSIZE
	int "Send buffer size"
	default 512
	---help---
		The size of one transmit buffer used for composing messages sent to
		the remote peer.

config SYSTEM_ZMODEM_MOUNTPOINT
	string "Zmodem sandbox"
	default "/tmp"
	---help---
		Absolute pathes in received file names are not accepted.  This
		configuration value must be set to provide the path to the file
		storage directory (such as a mountpoint directory).

		Names of file send by the sz commond, on the other hand, must be
		absolute paths beginning with '/'.

config SYSTEM_ZMODEM_FLOWC
	bool
	default n

config SYSTEM_ZMODEM_IFLOW
	bool "Rx flow control"
	default n
	select SYSTEM_ZMODEM_FLOWC
	depends on SERIAL_TERMIOS
	---help---
		Enable H/W CTS flow control.

config SYSTEM_ZMODEM_OFLOW
	bool "Tx flow control"
	default n
	select SYSTEM_ZMODEM_FLOWC
	depends on SERIAL_TERMIOS
	---help---
		Enable H/W RTS flow control.

config SYSTEM_ZMODEM_RCVSAMPLE
	bool "Reverse channel"
	default n
	---help---
		Local sender can sample reverse channel while sending.  This means
		in particular, that Zmodem can detect if data is received from the
		remote receiver while streaming a file to the remote receiver.
		Support for such asychronous incoming data notification is needed to
		support interruption of the file transfer by the remote receiver.

		This capapability is not yet supported.  There are only incomplete
		hooks in the code now!  Enable only if you want to see the warning.

config SYSTEM_ZMODEM_SENDATTN
	bool "Attn interrupt"
	default n
	---help---
		Local sender retains an attention string that will be sent to the remote receiver

		This capapability is not yet supported.  There are only incomplete
		hooks in the code now!  Enable only if you want to see the warning.

config SYSTEM_ZMODEM_ALWAYSSINT
	bool "Send ZSINIT"
	default y
	---help---
		Always send ZSINIT header

config SYSTEM_ZMODEM_TIMESTAMPS
	bool "File timestamps"
	default y
	depends on RTC
	---help---
		File timestamps may be supported

config SYSTEM_ZMODEM_SENDATTN
	bool "Send Attn string"
	default n
	---help---
		Send attention string not yet supported

config SYSTEM_ZMODEM_SENDBRAK
	bool "Can break"
	default n
	---help---
		Can not yet send BREAK

config SYSTEM_ZMODEM_RESPTIME
	int "Response time"
	default 10
	---help---
		Response time for remote peer to respond to requests.

config SYSTEM_ZMODEM_CONNTIME
	int "Rz startup time"
	default 30
	---help---
		When rz starts, it must wait a for the remote end to start the file
		transfer.  This may take longer than the normal response time.  This
		value may be set to tune that longer timeout value.

config SYSTEM_ZMODEM_SERIALNO
	int "Serial number"
	default 0
	---help---
		Receiver serial number

config SYSTEM_ZMODEM_MAXERRORS
	int "Max error"
	default 20
	---help---
		Max receive errors before canceling the transfer.

config SYSTEM_ZMODEM_WRITESIZE
	int "Write size limit"
	default 0
	---help---
		Some MMC/SD drivers may fail if large transfers are attempted.
		As a bug workaround, you can set the maximum write size with
		this configuration.  The default value of 0 means no write limit.

config DEBUG_ZMODEM
	bool "Zmodem debug"
	default n
	---help---
		Enable Zmodem debug output.  This debug is unrelated to the internal
		NuttX debug option; it does not use the SYSLOG channel but, instead,
		outputs debug information on stderr.  Obviously, enabling this
		option will likely cause you all kinds of problems if you intend to
		use /dev/console to transfer files!

config SYSTEM_ZMODEM_DUMPBUFFER
	bool "Dump buffers"
	default n
	depends on DEBUG_ZMODEM
	---help---
		Dump the contents of all incoming and outgoing buffers that are
		exchanged with the remote peer.

endif
```

## system/zoneinfo/Kconfig
```kconfig
#
# For a description of the syntax of this configuration file,
# see misc/tools/kconfig-language.txt.
#

config SYSTEM_ZONEINFO
	bool "TZ database"
	default n
	depends on LIBC_LOCALTIME
	---help---
		Build the TZ/Olson database.

if SYSTEM_ZONEINFO

config SYSTEM_ZONEINFO_ROMFS
	bool "Build ROMFS filesystem"
	default n
	depends on FS_ROMFS
	---help---
		Build a mountable ROMFS filesystem containing the TZ database

endif # SYSTEM_ZONEINFO
```

## tee/libteec/Kconfig
```kconfig
############################################################################
# apps/tee/libteec/Kconfig
#
# SPDX-License-Identifier: Apache-2.0
#
# Copyright (C) 2023 Xiaomi Corporation
#
# Licensed under the Apache License, Version 2.0 (the "License");
# you may not use this file except in compliance with the License.
# You may obtain a copy of the License at
#
#      http://www.apache.org/licenses/LICENSE-2.0
#
# Unless required by applicable law or agreed to in writing, software
# distributed under the License is distributed on an "AS IS" BASIS,
# WITHOUT WARRANTIES OR CONDITIONS OF ANY KIND, either express or implied.
# See the License for the specific language governing permissions and
# limitations under the License.
#
############################################################################

config LIBTEEC
	bool "TEE client library (libteec)"
	default n
	---help---
	        Enable libteec from https://github.com/OP-TEE/optee_client. This
	        is OP-TEE project's implementation of GlobalPlatform's TEE client
	        API specification v1.0 (GPD_SPE_007):
	         https://globalplatform.org/specs-library/?filter-committee=tee
	        The TEE Client API describes and defines how a client running in
	        a rich operating environment (REE, in this case NuttX) should
	        communicate with the Trusted Execution Environment (TEE) and its
	        Trusted Applications (TAs). The library provides a
	        well-established and easy-to-use interface abstracting away much
	        of the details of the underlying subsystems. For more information
	        please refer to:
	        https://optee.readthedocs.io/en/latest/architecture/globalplatform_api.html#tee-client-api

if LIBTEEC

config LIBTEEC_VERSION
	string "optee_client version (4.6.0)"
	default "4.6.0"

endif # LIBTEEC
```

## tee/optee_client/Kconfig
```kconfig
############################################################################
# apps/tee/optee_client/Kconfig
#
# SPDX-License-Identifier: Apache-2.0
#
# Copyright (C) 2023 Xiaomi Corporation
#
# Licensed under the Apache License, Version 2.0 (the "License");
# you may not use this file except in compliance with the License.
# You may obtain a copy of the License at
#
#      http://www.apache.org/licenses/LICENSE-2.0
#
# Unless required by applicable law or agreed to in writing, software
# distributed under the License is distributed on an "AS IS" BASIS,
# WITHOUT WARRANTIES OR CONDITIONS OF ANY KIND, either express or implied.
# See the License for the specific language governing permissions and
# limitations under the License.
#
############################################################################

config LIBTEEC
	bool "TEE client library (libteec)"
	default n
	---help---
	        Enable libteec from https://github.com/OP-TEE/optee_client. This
	        is OP-TEE project's implementation of GlobalPlatform's TEE client
	        API specification v1.0 (GPD_SPE_007):
	         https://globalplatform.org/specs-library/?filter-committee=tee
	        The TEE Client API describes and defines how a client running in
	        a rich operating environment (REE, in this case NuttX) should
	        communicate with the Trusted Execution Environment (TEE) and its
	        Trusted Applications (TAs). The library provides a
	        well-established and easy-to-use interface abstracting away much
	        of the details of the underlying subsystems. For more information
	        please refer to:
	        https://optee.readthedocs.io/en/latest/architecture/globalplatform_api.html#tee-client-api

if LIBTEEC

config OPTEE_CLIENT_VERSION
	string "optee_client version (4.6.0)"
	default "4.6.0"

endif # LIBTEEC

config OPTEE_SUPPLICANT
	bool "OP-TEE supplicant"
	depends on LIBTEEC
	default n
	---help---
		Enable OP-TEE supplicant from https://github.com/OP-TEE/optee_client.

if OPTEE_SUPPLICANT

config OPTEE_SUPPLICANT_PROGNAME
	string "Program name"
	default "optee_supplicant"
	---help---
		This is the name of the program that will be used when the NSH ELF
		program is installed.

config OPTEE_SUPPLICANT_PRIORITY
	int "OP-TEE supplicant task priority"
	default 100

config OPTEE_SUPPLICANT_STACKSIZE
	int "OP-TEE supplicant stack size"
	default DEFAULT_TASK_STACKSIZE

config OPTEE_SUPPLICANT_LOG_LEVEL
	int "Log level for the supplicant (0‑4)"
	range 0 4
	default 0

endif # OPTEE_SUPPLICANT
```

## tee/optee_supplicant/Kconfig
```kconfig
############################################################################
# apps/tee/optee_supplicant/Kconfig
#
# SPDX-License-Identifier: Apache-2.0
#
# Copyright (C) 2023 Xiaomi Corporation
#
# Licensed under the Apache License, Version 2.0 (the "License");
# you may not use this file except in compliance with the License.
# You may obtain a copy of the License at
#
#      http://www.apache.org/licenses/LICENSE-2.0
#
# Unless required by applicable law or agreed to in writing, software
# distributed under the License is distributed on an "AS IS" BASIS,
# WITHOUT WARRANTIES OR CONDITIONS OF ANY KIND, either express or implied.
# See the License for the specific language governing permissions and
# limitations under the License.
#
############################################################################

config OPTEE_SUPPLICANT
	bool "OP-TEE supplicant"
	depends on LIBTEEC
	default n
	---help---
		Enable OP-TEE supplicant from https://github.com/OP-TEE/optee_client.

if OPTEE_SUPPLICANT

config OPTEE_SUPPLICANT_PROGNAME
	string "Program name"
	default "optee_supplicant"
	---help---
		This is the name of the program that will be used when the NSH ELF
		program is installed.

config OPTEE_SUPPLICANT_PRIORITY
	int "OP-TEE supplicant task priority"
	default 100

config OPTEE_SUPPLICANT_STACKSIZE
	int "OP-TEE supplicant stack size"
	default DEFAULT_TASK_STACKSIZE

config OPTEE_SUPPLICANT_VERSION
	string "optee_client version (4.6.0)"
	default "4.6.0"

config OPTEE_SUPPLICANT_LOG_LEVEL
	int "Log level for the supplicant (0‑4)"
	range 0 4
	default 0
endif # OPTEE_SUPPLICANT
```

## testing/arch/x86-64-ABI/Kconfig
```kconfig
#
# For a description of the syntax of this configuration file,
# see the file kconfig-language.txt in the NuttX tools repository.
#

config TESTING_X86_64_ABI
	bool "X86_64_ABI testing support"
	default n
	depends on ALLOW_GPL_COMPONENTS
	---help---
		Enable support for the X86_64_ABI testing framework
```
