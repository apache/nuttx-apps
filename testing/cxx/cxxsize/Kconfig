## testing/cxx/cxxsize/Kconfig
```kconfig
#
# For a description of the syntax of this configuration file,
# see the file kconfig-language.txt in the NuttX tools repository.
#

config TESTING_CXXSIZE
	tristate "Test c++ code size program"
	default n
	depends on HAVE_CXX
```

## testing/cxx/cxxtest/Kconfig
```kconfig
#
# For a description of the syntax of this configuration file,
# see the file kconfig-language.txt in the NuttX tools repository.
#

config TESTING_CXXTEST
	tristate "C++ test program"
	default n
	depends on HAVE_CXX
	---help---
		Enable the C++ test program
```

## testing/cxx/uclibcxx_test/Kconfig
```kconfig
#
# For a description of the syntax of this configuration file,
# see the file kconfig-language.txt in the NuttX tools repository.
#

config TESTING_UCLIBCXXTEST
	tristate "uclibcxx test"
	default n
	---help---
		Enable the uclibcxxtest
```

## testing/debug/Kconfig
```kconfig
#
# For a description of the syntax of this configuration file,
# see the file kconfig-language.txt in the NuttX tools repository.
#

config TESTING_DEBUG
	tristate "Debug test"
	default n
	depends on ARCH_HAVE_DEBUG
	depends on LIB_GDBSTUB
	---help---
		Enable the DEBUG test program. It is a simple
		test case of the NuttX debugging facilities.

if TESTING_DEBUG

config TESTING_DEBUG_PROGNAME
	string "Program name"
	default "debug"
	---help---
		This is the name of the program that will be used when the NSH ELF
		program is installed.

config TESTING_DEBUG_PRIORITY
	int "Task priority"
	default 100

config TESTING_DEBUG_STACKSIZE
	int "Stack size"
	default DEFAULT_TASK_STACKSIZE

endif
```

## testing/driver/fftest/Kconfig
```kconfig
#
# For a description of the syntax of this configuration file,
# see the file kconfig-language.txt in the NuttX tools repository.
#

config TESTING_FF
	bool "Force feedback test"
	default n

if TESTING_FF

config TESTING_FF_PROGNAME
	string "Program name"
	default "fftest"

config TESTING_FF_PRIORITY
	int "FF driver test task priority"
	default 100

config TESTING_FF_STACKSIZE
	int "FF driver test stack size"
	default DEFAULT_TASK_STACKSIZE

endif
```

## testing/driver/nand_sim/Kconfig
```kconfig
#
# For a description of the syntax of this configuration file,
# see the file kconfig-language.txt in the NuttX tools repository.
#

config TESTING_NAND_SIM
	boolean "NAND Flash Simulator"
	depends on MTD_NAND_RAM
	default n
	---help---
		Enable the NAND Flash Simulator device.

if TESTING_NAND_SIM

config TESTING_NAND_SIM_SIZE
	int "Size of NAND Flash in MB"
	default 2
	---help---
		Size of NAND Flash in Megabytes.

config TESTING_NAND_SIM_DEBUG
	int "Debugging mode"
	default 1
	range 0 2
	---help---
		0 - Disable debugging mode
		1 - Enable debugging mode to standard I/O
		2 - Enable debugging mode to a special file

config TESTING_NAND_SIM_STACK
	int "Builtin task stack size"
	default DEFAULT_TASK_STACKSIZE
	---help---
		Size of the task to configure when started nand from NSH
endif
```

## testing/driver/pcitest/Kconfig
```kconfig
#
# For a description of the syntax of this configuration file,
# see the file kconfig-language.txt in the NuttX tools repository.
#

config TESTING_PCITEST
	tristate "\"pcitest tools\""
	default n
	depends on PCI_EP_TEST
	---help---
		Enable the \"pcitest tools\"

if TESTING_PCITEST

config TESTING_PCITEST_PRIORITY
	int "pcitest task priority"
	default 100

config TESTING_PCITEST_STACKSIZE
	int "pcitest stack size"
	default DEFAULT_TASK_STACKSIZE

endif
```

## testing/driver/sd_stress/Kconfig
```kconfig
#
# For a description of the syntax of this configuration file,
# see the file kconfig-language.txt in the NuttX tools repository.
#

config TESTING_SD_STRESS
	tristate "SD stress program"
	depends on ALLOW_BSD_COMPONENTS
	default n
	---help---
		SD stress application based on https://github.com/PX4/PX4-Autopilot/blob/main/src/systemcmds/sd_stress/sd_stress.cpp

if TESTING_SD_STRESS

config TESTING_SD_STRESS_PROGNAME
	string "Program name"
	default "sdstress"
	---help---
		This is the name of the program that will be used when the NSH ELF
		program is installed.

config TESTING_SD_STRESS_PRIORITY
	int "SD stress task priority"
	default 100

config TESTING_SD_STRESS_STACKSIZE
	int "SD stress stack size"
	default DEFAULT_TASK_STACKSIZE

config TESTING_SD_STRESS_DEVICE
	string "SD / MMC mount point"
	default "/mnt"

endif
```

## testing/drivers/crypto/Kconfig
```kconfig
config TESTING_CRYPTO
	tristate "crypto test"
	default n
	---help---
		Enable crypto test

if TESTING_CRYPTO

config TESTING_CRYPTO_3DES_CBC
	bool "3des-cbc crypto test"
	default y

config TESTING_CRYPTO_AES_CBC
	bool "aes-cbc crypto test"
	default y

config TESTING_CRYPTO_AES_CTR
	bool "aes-ctr crypto test"
	default y

config TESTING_CRYPTO_AES_XTS
	bool "aes-xts crypto test"
	default y

config TESTING_CRYPTO_HMAC
	bool "hmac crypto test"
	default y

config TESTING_CRYPTO_HASH
	bool "hash crypto test"
	default n

if TESTING_CRYPTO_HASH

config TESTING_CRYPTO_HASH_HUGE_BLOCK
	bool "hash huge block crypto test"
	default y

config TESTING_CRYPTO_HASH_UNALIGNED_BUFFER_SIZE
	bool "hash unaligned buffer size test"
	default y

config TESTING_CRYPTO_HASH_DISABLE_MD5
	bool "disable md5 tests"
	default n

config TESTING_CRYPTO_HASH_DISABLE_SHA1
	bool "disable sha1 tests"
	default n

config TESTING_CRYPTO_HASH_DISABLE_SHA224
	bool "disable sha224 tests"
	default n

config TESTING_CRYPTO_HASH_DISABLE_SHA256
	bool "disable sha256 tests"
	default n

config TESTING_CRYPTO_HASH_DISABLE_SHA512
	bool "disable sha512 tests"
	default n

config TESTING_CRYPTO_HASH_DISABLE_UNALIGNED_MD5
	bool "disable unaligned md5 tests"
        depends on !TESTING_CRYPTO_HASH_DISABLE_MD5
	default n

config TESTING_CRYPTO_HASH_DISABLE_UNALIGNED_SHA1
	bool "disable unaligned sha1 tests"
        depends on !TESTING_CRYPTO_HASH_DISABLE_SHA1
	default n

config TESTING_CRYPTO_HASH_DISABLE_UNALIGNED_SHA224
	bool "disable unaligned sha224 tests"
        depends on !TESTING_CRYPTO_HASH_DISABLE_SHA224
	default n

config TESTING_CRYPTO_HASH_DISABLE_UNALIGNED_SHA256
	bool "disable unaligned sha256 tests"
        depends on !TESTING_CRYPTO_HASH_DISABLE_SHA256
	default n

config TESTING_CRYPTO_HASH_DISABLE_UNALIGNED_SHA512
	bool "disable unaligned sha512 tests"
        depends on !TESTING_CRYPTO_HASH_DISABLE_SHA512
	default n

endif

config TESTING_CRYPTO_CRC32
	bool "crc32 crypto test"
	default n

config TESTING_CRYPTO_AES_CMAC
	bool "aes-cmac crypto test"
	default n

config TESTING_CRYPTO_ECDSA
	bool "ecdsa crypto test"
	default n

config TESTING_CRYPTO_ECDH
	bool "ecdh crypto test"
	default n

config TESTING_CRYPTO_RSA
	bool "rsa crypto test"
	default n

config TESTING_CRYPTO_PBKDF2
	bool "pbkdf2 crypto test"
	default n

config TESTING_CRYPTO_PRIORITY
	int "crypto test task priority"
	default 100

config TESTING_CRYPTO_STACKSIZE
	int "crypto test stack size"
	default DEFAULT_TASK_STACKSIZE

endif
```

## testing/drivers/ser/Kconfig
```kconfig
#
# For a description of the syntax of this configuration file,
# see the file kconfig-language.txt in the NuttX tools repository.
#

config TESTING_SERIAL
	bool "Serial Error Report (ser)"
	default n
	depends on SERIAL_TIOCGICOUNT
	---help---
		Enable the serial error reporting test. This test
		could report U[S]ART erros like frame, overrun, parity, etc

if TESTING_SERIAL

config TESTING_SERIAL_PORT
	string "Serial Port to Use"
	default "/dev/ttyS1"
	---help---
		This is the name of serial port to use. Please avoid using
		the ttyS0 because it is used as console.

config TESTING_SERIAL_PROGNAME
	string "Program name"
	default "ser"
	---help---
		This is the name of the program that will be used when the NSH ELF
		program is installed.

config TESTING_SERIAL_PRIORITY
	int "ser utility task priority"
	default 100

config TESTING_SERIAL_STACKSIZE
	int "ser utility stack size"
	default DEFAULT_TASK_STACKSIZE

endif
```

## testing/drivertest/Kconfig
```kconfig
#
# For a description of the syntax of this configuration file,
# see the file kconfig-language.txt in the NuttX tools repository.
#

config TESTING_DRIVER_TEST
	tristate "cmocka driver test"
	default n
	depends on TESTING_CMOCKA
	---help---
		Enable the cmocka driver test

if TESTING_DRIVER_TEST

config TESTING_DRIVER_TEST_PRIORITY
	int "Task priority"
	default 100

config TESTING_DRIVER_TEST_STACKSIZE
	int "Stack size"
	default DEFAULT_TASK_STACKSIZE

config TESTING_DRIVER_TEST_SIMPLE
	bool "Enable cmocka driver simple test"
	default n

config TESTING_ONESHOT_TEST
	bool "Enable cmocka oneshot test"
	default n
		depends on ONESHOT
endif
```

## testing/enet/Kconfig
```kconfig
#
# For a description of the syntax of this configuration file,
# see the file kconfig-language.txt in the NuttX tools repository.
#

config ENET_TEST
	tristate "cmocka enet test"
	default n
	depends on TESTING_CMOCKA
	---help---
		Enable the cmocka enet test

if ENET_TEST
config ENET_TEST_PROGNAME
	string "Program name"
	default "enet_test"
	---help---
		This is the name of the cmocka program that will be used as enet test.

config ENET_TEST_PRIORITY
	int "Task priority"
	default 100

config ENET_TEST_STACKSIZE
	int "Stack size"
	default DEFAULT_TASK_STACKSIZE

config ENET_TEST_DEV
	string "Dev Node"
	default "eth0"

endif
```

## testing/fatutf8/Kconfig
```kconfig
#
# For a description of the syntax of this configuration file,
# see the file kconfig-language.txt in the NuttX tools repository.
#

config TESTING_FATUTF8
	tristate "FAT UTF8 test"
	default n
	---help---
		Enable FAT UTF8 test

		For the tests to be successful, you need to enable
		CONFIG_FAT_LFN, CONFIG_FAT_LFN_UTF8.

if TESTING_FATUTF8

config TESTING_FATUTF8_PROGNAME
	string "Program name"
	default "fatutf8"
	---help---
		This is the name of the program that will be used when the NSH ELF
		program is installed.

config TESTING_FATUTF8_PRIORITY
	int "FAT UTF8 test task priority"
	default 100

config TESTING_FATUTF8_STACKSIZE
	int "FAT UTF8 test stack size"
	default DEFAULT_TASK_STACKSIZE

endif
```

## testing/fff/Kconfig
```kconfig
#
# For a description of the syntax of this configuration file,
# see the file kconfig-language.txt in the NuttX tools repository.
#

config TESTING_FFF
	tristate "Enable FakeFunctionFramework"
	default n
	---help---
		Enable FakeFunctionFramework
```

## testing/fs/basic/Kconfig
```kconfig
#
# For a description of the syntax of this configuration file,
# see the file kconfig-language.txt in the NuttX tools repository.
#

config TESTS_TESTSUITES
	tristate "vela test suite"
	default n
	depends on TESTING_CMOCKA
	---help---
		Enable testsuites for the vela

if TESTS_TESTSUITES

config TESTS_TESTSUITES_MOUNT_DIR
	string "Mount directory for the testsuites"
	default "/data"

config TESTS_TESTSUITES_PRIORITY
	int "Testsuites task priority"
	default 99

config TESTS_TESTSUITES_STACKSIZE
	int "Testsuites stack size"
	default 16384

config CM_FS_TEST
	bool "enable fs test"
	default n

endif # TESTS_TESTSUITES
```

## testing/fs/epoll/Kconfig
```kconfig
#
# For a description of the syntax of this configuration file,
# see the file kconfig-language.txt in the NuttX tools repository.
#

config TESTING_EPOLL
	tristate "cmocka epoll test"
	default n
	depends on TESTING_CMOCKA && TIMER_FD && NET_LOCAL
	---help---
		Enable the cmocka driver test

if TESTING_EPOLL

config TESTING_EPOLL_PRIORITY
	int "Task priority"
	default 100

config TESTING_EPOLL_STACKSIZE
	int "Stack size"
	default DEFAULT_TASK_STACKSIZE

endif
```

## testing/fs/fdsantest/Kconfig
```kconfig
#
# For a description of the syntax of this configuration file,
# see the file kconfig-language.txt in the NuttX tools repository.
#

config TESTING_FDSAN_TEST
	tristate "Nuttx cmocka fdsan test"
	default n
	depends on TESTING_CMOCKA
	---help---
		Enable the cmocka fdsan test

if TESTING_FDSAN_TEST

config TESTING_FDSAN_TEST_PRIORITY
	int "Task priority"
	default 100

config TESTING_FDSAN_TEST_STACKSIZE
	int "Stack size"
	default DEFAULT_TASK_STACKSIZE

config TESTING_FDSAN_TEST_SIMPLE
	bool "Enable cmocka fdsan simple test"
	default y

endif
```

## testing/fs/fopencookie/Kconfig
```kconfig
#
# For a description of the syntax of this configuration file,
# see the file kconfig-language.txt in the NuttX tools repository.
#

config TESTING_FOPENCOOKIE_TEST
	tristate "Fopencookie test tool"
	default n
	---help---
		Performs a basic operations with fopencookie call.

if TESTING_FOPENCOOKIE_TEST
endif
```

## testing/fs/memfd/Kconfig
```kconfig
#
# For a description of the syntax of this configuration file,
# see the file kconfig-language.txt in the NuttX tools repository.
#

config TESTING_MEMFD
	bool "Testing the stability of memfd"
	depends on !LIBC_MEMFD_ERROR && MM_KASAN
	default n
	---help---
		Enable to test the stability of memfd
```

## testing/fs/mtd_config_fs/Kconfig
```kconfig
#
# For a description of the syntax of this configuration file,
# see the file kconfig-language.txt in the NuttX tools repository.
#

config TESTING_MTD_CONFIG_NVS
	tristate "MTD Config fail-safe storage test"
	default n
	depends on MTD_CONFIG_NVS
	select MTD_CONFIG_NAMED
	---help---
		Enable the fail-safe storage test

if TESTING_MTD_CONFIG_NVS

config TESTING_MTD_CONFIG_PROGNAME
	string "Program name"
	default "mtdconfig_fs_test"
	---help---
		This is the name of the program that will be used when the NSH ELF
		program is installed.

config TESTING_MTD_CONFIG_MOUNTPT_NAME
	string "MTD driver mount pt"
	default "/dev/mtdnvs_flash"

config TESTING_MTD_CONFIG_MOUNTPT_MAXNAME
	int "MTD driver mount pt path len"
	default 64

config TESTING_MTD_CONFIG_FLASH_SECTION_SIZE
	int "MTD flash section size"
	default 4096

config TESTING_MTD_CONFIG_FLASH_SECTION_COUNT
	int "MTD flash section count"
	default 3

config TESTING_MTD_CONFIG_PRIORITY
	int "MTD nvs test task priority"
	default 100

config TESTING_MTD_CONFIG_STACKSIZE
	int "MTD nvs test stack size"
	default 4096

config TESTING_MTD_CONFIG_VERBOSE
	bool "Verbose output"
	default n

endif
```

## testing/fs/mtd_test/Kconfig
```kconfig
#
# For a description of the syntax of this configuration file,
# see the file kconfig-language.txt in the NuttX tools repository.
#

config TESTING_MTD_TRANSFER_RATE
	tristate "MTD transfer rate test"
	default n
	depends on BUILD_FLAT && MTD
	---help---
		This testing application measures the transfer rate for an MTD flash
		block device.  It performs a erase/write operation to evaluate write
		transfer rate and then reads the written content back to evaluate the
		read transfer rate. Finally, it compares the read data with the
		previously written data.

		NOTE:  This test uses internal OS interfaces and so it is not
		available in the NUTTX kernel build.
```
