## testing/fs/smart/Kconfig
```kconfig
#
# For a description of the syntax of this configuration file,
# see the file kconfig-language.txt in the NuttX tools repository.
#

config TESTING_SMART
	tristate "SMART file system example"
	default n
	---help---
		Enable the SMART file system example

if TESTING_SMART

config TESTING_SMART_ARCHINIT
	bool "Architecture-specific initialization"
	default n
	---help---
		The default is to use the RAM MTD device at drivers/mtd/rammtd.c.
		But an architecture-specific MTD driver can be used instead by
		defining TESTING_SMART_ARCHINIT.  In this case, the
		initialization logic will call smart_archinitialize() to obtain
		the MTD driver instance.

config TESTING_SMART_NEBLOCKS
	int "Number of erase blocks (simulated)"
	default 32
	depends on !TESTING_SMART_ARCHINIT
	---help---
		When TESTING_SMART_ARCHINIT is not defined, this test will use
		the RAM MTD device at drivers/mtd/rammtd.c to simulate FLASH.  In
		this case, this value must be provided to give the number of erase
		blocks in MTD RAM device.

		The size of the allocated RAM drive will be:

			RAMMTD_ERASESIZE * TESTING_SMART_NEBLOCKS

config TESTING_SMART_MAXNAME
	int "Max name size"
	default 32
	range 1 255
	---help---
		Determines the maximum size of names used in the filesystem

config TESTING_SMART_MAXFILE
	int "Max file size"
	default 8192
	---help---
		Determines the maximum size of a file

config TESTING_SMART_MAXIO
	int "Max I/O"
	default 347

config TESTING_SMART_MAXOPEN
	int "Max open files"
	default 512

config TESTING_SMART_MOUNTPT
	string "SMART mountpoint"
	default "/mnt/nxffs"

config TESTING_SMART_NLOOPS
	int "Number of test loops"
	default 100

config TESTING_SMART_VERBOSE
	bool "Verbose output"
	default n

endif
```

## testing/fs/smart_test/Kconfig
```kconfig
#
# For a description of the syntax of this configuration file,
# see the file kconfig-language.txt in the NuttX tools repository.
#

config TESTING_SMART_TEST
	tristate "SMART filesystem test tool"
	default n
	---help---
		Performs a file-based test on a SMART (or any) filesystem. Validates
		seek, append and seek-with-write operations.

if TESTING_SMART_TEST
endif
```

## testing/fstest/Kconfig
```kconfig
#
# For a description of the syntax of this configuration file,
# see the file kconfig-language.txt in the NuttX tools repository.
#

config TESTING_FSTEST
	tristate "Generic file system test"
	default n
	---help---
		Enable the generic file system test

if TESTING_FSTEST

config TESTING_FSTEST_PROGNAME
	string "Program name"
	default "fstest"
	---help---
		This is the name of the program that will be used when the NSH ELF
		program is installed.

config TESTING_FSTEST_PRIORITY
	int "FS test task priority"
	default 100

config TESTING_FSTEST_STACKSIZE
	int "FS test stack size"
	default DEFAULT_TASK_STACKSIZE

config TESTING_FSTEST_MAXNAME
	int "Max name size"
	default 32
	range 1 255
	---help---
		Determines the maximum size of names used in the filesystem

config TESTING_FSTEST_MAXFILE
	int "Max file size"
	default 8192
	---help---
		Determines the maximum size of a file

config TESTING_FSTEST_MAXIO
	int "Max I/O"
	default 347

config TESTING_FSTEST_MAXOPEN
	int "Max open files"
	default 512

config TESTING_FSTEST_MOUNTPT
	string "FSTEST mountpoint"

config TESTING_FSTEST_NLOOPS
	int "Number of test loops"
	default 100

config TESTING_FSTEST_SPIFFS
	bool "Enable SPIFFS testing"
	default y
	depends on FS_SPIFFS && EXPERIMENTAL
	---help---
		SPIFFS garbage collection and integrity checking will be performed
		after each pass through the test.

		If this option is not selected then the SPIFFS FLASH will be be
		reclaimed on-demand when there is no longer any available FLASH.

		Marked EXPERIMENTAL because it interferes with test performance.

config TESTING_FSTEST_VERBOSE
	bool "Verbose output"
	default n

endif
```

## testing/himem_test/Kconfig
```kconfig
#
# For a description of the syntax of this configuration file,
# see the file kconfig-language.txt in the NuttX tools repository.
#

config TESTING_HIMEM_TEST
	tristate "HIMEM TEST APP"
	default n
	depends on ESP32_SPIRAM_BANKSWITCH_ENABLE
	---help---
		Enable the himem cdev test

if TESTING_HIMEM_TEST

config TESTING_HIMEM_TEST_PROGNAME
	string "Program name"
	default "esp32himem_cdev"
	---help---
		This is the name of the program that will be used when the NSH ELF
		program is installed.

config TESTING_HIMEM_TEST_PRIORITY
	int "himem test app task priority"
	default 100

config TESTING_HIMEM_TEST_STACKSIZE
	int "himem test app stack size"
	default DEFAULT_TASK_STACKSIZE

endif
```
