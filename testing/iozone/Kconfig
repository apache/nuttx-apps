## testing/iozone/Kconfig
```kconfig
#
# For a description of the syntax of this configuration file,
# see the file kconfig-language.txt in the NuttX tools repository.
#

config TESTING_IOZONE
	tristate "IOzone, filesystem benchmark tool"
	default n
	---help---
		https://www.iozone.org/

if TESTING_IOZONE

config TESTING_IOZONE_PROGNAME
	string "Program name"
	default "iozone"

config TESTING_IOZONE_PRIORITY
	int "IOzone task priority"
	default 100

config TESTING_IOZONE_STACKSIZE
	int "IOzone stack size"
	default 8192

config TESTING_IOZONE_VERSION
	string "iozone version"
	default "3_493"

endif
```

## testing/irtest/Kconfig
```kconfig
#
# For a description of the syntax of this configuration file,
# see the file kconfig-language.txt in the NuttX tools repository.
#

config TESTING_IRTEST
	tristate "IR driver test"
	default n
	---help---
		Enable the IR driver test

if TESTING_IRTEST

config TESTING_IRTEST_PROGNAME
	string "Program name"
	default "irtest"
	---help---
		This is the name of the program that will be used when the NSH ELF
		program is installed.

config TESTING_IRTEST_PRIORITY
	int "IR driver test task priority"
	default 100

config TESTING_IRTEST_STACKSIZE
	int "IR driver test stack size"
	default DEFAULT_TASK_STACKSIZE

config TESTING_IRTEST_MAX_NIRDEV
	int "The Maximum number of IR devices supported"
	default 2

config TESTING_IRTEST_MAX_SIRDATA
	int "The Maximum size of sending data in unsigned int"
	default 64

endif
```

## testing/kasantest/Kconfig
```kconfig
#
# For a description of the syntax of this configuration file,
# see the file kconfig-language.txt in the NuttX tools repository.
#

config TESTING_KASAN
	tristate "KASan validity test"
	default n
	---help---
		Enable the KASan validity test
```

## testing/libc/crctest/Kconfig
```kconfig
#
# For a description of the syntax of this configuration file,
# see the file kconfig-language.txt in the NuttX tools repository.
#

config TESTING_CRC_TEST
	tristate "vela cmocka CRC test"
	default n
	depends on TESTING_CMOCKA
	---help---
		Enable the cmocka CRC test

if TESTING_CRC_TEST

config TESTING_CRC_TEST_PRIORITY
	int "Task priority"
	default 100

config TESTING_CRC_TEST_STACKSIZE
	int "Stack size"
	default DEFAULT_TASK_STACKSIZE

endif
```

## testing/libc/fmemopen/Kconfig
```kconfig
#
# For a description of the syntax of this configuration file,
# see the file kconfig-language.txt in the NuttX tools repository.
#

config TESTING_FMEMOPEN_TEST
	tristate "Fmemopen test tool"
	default n
	---help---
		Performs a basic operations with fmemopen call.

if TESTING_FMEMOPEN_TEST
endif
```

## testing/libc/popen/Kconfig
```kconfig
#
# For a description of the syntax of this configuration file,
# see the file kconfig-language.txt in the NuttX tools repository.
#

config TESTING_POPEN
	tristate "popen()/dpopen() test"
	default n
	depends on SYSTEM_POPEN
	---help---
		Test popen()/pclose() and dpopen()/dpclose() in both shell
		and no-shell modes. The test binary doubles as its own
		popen/dpopen target via --echo.

if TESTING_POPEN
endif
```

## testing/libc/stdbit/Kconfig
```kconfig
#
# For a description of the syntax of this configuration file,
# see the file kconfig-language.txt in the NuttX tools repository.
#

config TESTING_STDBIT_TEST
	tristate "stdbit test tool"
	default n
	---help---
		Performs a basic operations with stdbit call.

if TESTING_STDBIT_TEST
endif
```

## testing/libc/wcstombs/Kconfig
```kconfig
#
# For a description of the syntax of this configuration file,
# see the file kconfig-language.txt in the NuttX tools repository.
#

config TESTING_WCSTOMBS
	tristate "wcstombs() test"
	default n
	depends on LIBC_LOCALE
	---help---
		Enable wcstombs() test

if TESTING_WCSTOMBS

config TESTING_WCSTOMBS_PROGNAME
	string "Program name"
	default "wcstombs"
	---help---
		This is the name of the program that will be used when the NSH ELF
		program is installed.

config TESTING_WCSTOMBS_PRIORITY
	int "wcstombs task priority"
	default 100

config TESTING_WCSTOMBS_STACKSIZE
	int "wcstombs stack size"
	default DEFAULT_TASK_STACKSIZE

endif
```

## testing/ltp/Kconfig
```kconfig
#
# For a description of the syntax of this configuration file,
# see the file kconfig-language.txt in the NuttX tools repository.
#

config TESTING_LTP
	tristate "Linux Test Project"
	default n
	---help---
		Enable support for the Linux Test Project(LTP) framework

if TESTING_LTP

config TESTING_LTP_STACKSIZE
	int "Linux Test Project stack size"
	default 8192

endif #TESTING_LTP
```

## testing/memstress/Kconfig
```kconfig
#
# For a description of the syntax of this configuration file,
# see the file kconfig-language.txt in the NuttX tools repository.
#

config TESTING_MEMORY_STRESS
	tristate "memory stress test"
	default n
	---help---
		Enable a memory stress test.

if TESTING_MEMORY_STRESS

config TESTING_MEMORY_STRESS_PROGNAME
	string "Program name"
	default "memstress"
	---help---
		This is the name of the program that will be used when the NSH ELF
		program is installed.

config TESTING_MEMORY_STRESS_PRIORITY
	int "MEMORY stress task priority"
	default 100

config TESTING_MEMORY_STRESS_STACKSIZE
	int "MEMORY stress stack size"
	default DEFAULT_TASK_STACKSIZE

endif
```

## testing/memtester/Kconfig
```kconfig
#
# For a description of the syntax of this configuration file,
# see the file kconfig-language.txt in the NuttX tools repository.
#

config UTILS_MEMTESTER
	tristate "utils_memtester"
	default n

if UTILS_MEMTESTER

config UTILS_MEMTESTER_PROGNAME
	string "Program Name"
	default "memtester"

config UTILS_MEMTESTER_STACKSIZE
	int "utils memtester stack size"
	default DEFAULT_TASK_STACKSIZE

config UTILS_MEMTESTER_PRIORITY
	int "Task PRIORITY"
	default 90

config UTILS_MEMTESTER_NARROW
	bool "TEST_NARROW"
	default n
	---help---
		Turn on the "test_8bit_wide_random test_16bit_wide_random" tests, which
		may result in unaligned access on some platforms.

endif
```

## testing/mm/Kconfig
```kconfig
#
# For a description of the syntax of this configuration file,
# see the file kconfig-language.txt in the NuttX tools repository.
#

config TESTING_MM
	tristate "Memory management test"
	default n
	---help---
		Enable the memory management test

if TESTING_MM

config TESTING_MM_PROGNAME
	string "Program name"
	default "mm"
	---help---
		This is the name of the program that will be used when the NSH ELF
		program is installed.

config TESTING_MM_PRIORITY
	int "Task priority"
	default 100

config TESTING_MM_STACKSIZE
	int "Stack size"
	default DEFAULT_TASK_STACKSIZE

endif
```

## testing/mm/cachetest/Kconfig
```kconfig
#
# For a description of the syntax of this configuration file,
# see the file kconfig-language.txt in the NuttX tools repository.
#

config TESTING_CACHETEST
	tristate "Cache Test"
	default n
	---help---
		Enable a simple Cache test.

if TESTING_CACHETEST

config TESTING_CACHETEST_PROGNAME
	string "Program name"
	default "cachetest"
	---help---
		This is the name of the program that will be used when the NSH ELF
		program is installed.

config TESTING_CACHETEST_PRIORITY
	int "Cache test task priority"
	default 100

config TESTING_CACHETEST_STACKSIZE
	int "Cache test stack size"
	default DEFAULT_TASK_STACKSIZE

endif
```

## testing/mm/heaptest/Kconfig
```kconfig
#
# For a description of the syntax of this configuration file,
# see the file kconfig-language.txt in the NuttX tools repository.
#

config TESTING_HEAP
	tristate "Memory management test"
	default n
	---help---
		Enable the memory management test

if TESTING_HEAP

config TESTING_HEAP_PROGNAME
	string "Program name"
	default "heap"
	---help---
		This is the name of the program that will be used when the NSH ELF
		program is installed.

config TESTING_HEAP_PRIORITY
	int "Task priority"
	default 100

config TESTING_HEAP_STACKSIZE
	int "Stack size"
	default DEFAULT_TASK_STACKSIZE

config TESTING_HEAP_POWEROFF
	bool "Terminate on test completion"
	default n
	depends on BOARDCTL_POWEROFF

endif
```

## testing/mm/iob/Kconfig
```kconfig
#
# For a description of the syntax of this configuration file,
# see the file kconfig-language.txt in the NuttX tools repository.
#

config TESTING_IOB
	tristate "\"Test iob\" testing"
	default n
	depends on MM_IOB
	---help---
		Enable the \"Test iob!\" testing.

if TESTING_IOB

config TESTING_IOB_PROGNAME
	string "Program name"
	default "iob"
	---help---
		This is the name of the program that will be used when the NSH ELF
		program is iob.

config TESTING_IOB_PRIORITY
	int "Iob task priority"
	default 100

config TESTING_IOB_STACKSIZE
	int "Iob stack size"
	default DEFAULT_TASK_STACKSIZE

endif
```

## testing/mm/kasantest/Kconfig
```kconfig
#
# For a description of the syntax of this configuration file,
# see the file kconfig-language.txt in the NuttX tools repository.
#

config TESTING_KASAN
	tristate "KASan validity test"
	depends on MM_KASAN
	default n
	---help---
		Enable the KASan validity test

if TESTING_KASAN

config TESTING_KASAN_PRIORITY
	int "KASan test priority"
	default 101

config TESTING_KASAN_STACKSIZE
	int "KASan test stack size"
	default 8192

config TESTING_KASAN_PERF_HEAP_SIZE
	int "KASan test heap size"
	default 1024000

config TESTING_KASAN_PERF_CYCLES
	int "KASan test performance cycles"
	default 4096

endif
```

## testing/mm/open_memstream/Kconfig
```kconfig
#
# For a description of the syntax of this configuration file,
# see the file kconfig-language.txt in the NuttX tools repository.
#

config TESTING_OPEN_MEMSTREAM
	tristate "open_memstream test tool"
	default n
	---help---
		Performs a basic operations with open_memstream call.

if TESTING_OPEN_MEMSTREAM
endif
```

## testing/mm/ramtest/Kconfig
```kconfig
#
# For a description of the syntax of this configuration file,
# see the file kconfig-language.txt in the NuttX tools repository.
#

config TESTING_RAMTEST
	tristate "RAM Test"
	default n
	---help---
		Enable a simple RAM test.

if TESTING_RAMTEST

config TESTING_RAMTEST_PROGNAME
	string "Program name"
	default "ramtest"
	---help---
		This is the name of the program that will be used when the NSH ELF
		program is installed.

config TESTING_RAMTEST_PRIORITY
	int "RAM test task priority"
	default 90

config TESTING_RAMTEST_STACKSIZE
	int "RAM test stack size"
	default DEFAULT_TASK_STACKSIZE

endif
```

## testing/mm/stressapptest/Kconfig
```kconfig
#
# For a description of the syntax of this configuration file,
# see the file kconfig-language.txt in the NuttX tools repository.
#

config TESTING_STRESSAPPTEST
	bool "stressapptest"
	default n
	---help---
		stressapptest is a userspace memory and CPU stress test tool. It
		exercises the memory and CPU subsystem stressing for cache misses,
		TLB misses, memory allocation, memory freeing, etc. It has been
		used to find hardware bugs, test operating system reliability, and
		test system stability.
		http://people.redhat.com/~fche/stressapptest/

if TESTING_STRESSAPPTEST

config TESTING_STRESSAPPTEST_VERSION
	string "Version of stressapptest"
	default "1.0.11"

config TESTING_STRESSAPPTEST_PRIORITY
	int "Priority of stressapptest process"
	default 100

config TESTING_STRESSAPPTEST_STACKSIZE
	int "Stack size of stressapptest process"
	default 8192

endif
```

## testing/monkey/Kconfig
```kconfig
#
# For a description of the syntax of this configuration file,
# see the file kconfig-language.txt in the NuttX tools repository.
#

menuconfig TESTING_MONKEY
	tristate "Monkey test"
	select UINPUT_TOUCH
	select UINPUT_BUTTONS
	default n

if TESTING_MONKEY

config TESTING_MONKEY_PRIORITY
	int "Task priority"
	default 110

config TESTING_MONKEY_STACKSIZE
	int "Stack size"
	default 4096

config TESTING_MONKEY_REC_DIR_PATH
	string "Recorder directory path"
	default "/data/monkey"

endif
```

## testing/mtetest/Kconfig
```kconfig
#
# For a description of the syntax of this configuration file,
# see the file kconfig-language.txt in the NuttX tools repository.
#

config TESTING_MTE
	tristate "MTE instruction set test"
	depends on ARM64_MTE
	default n
	---help---
		Enable MTE instruction set test

if TESTING_MTE

config TESTING_MTE_PRIORITY
	int "Task priority"
	default 101

endif
```

## testing/mutex/Kconfig
```kconfig
#
# For a description of the syntax of this configuration file,
# see the file kconfig-language.txt in the NuttX tools repository.
#

config TESTS_MUTEX
	tristate "vela mutex test"
	default n
	---help---
		Enable mutex test for the vela

if TESTS_MUTEX                                                                                     

config TESTS_MUTEX_PRIORITY
	int "mutex task priority"
	default 99

config TESTS_MUTEX_STACKSIZE
	int "mutex stack size"
	default 16384

config CM_MUTEX_TEST
    bool "enbale mutex test"
    default n
    depends on TESTING_CMOCKA

endif # TESTS_MM
```

## testing/nest/Kconfig
```kconfig
#
# For a description of the syntax of this configuration file,
# see the file kconfig-language.txt in the NuttX tools repository.
#

config TESTING_NEST
	tristate "NuttX test collection"
	depends on TESTING_UNITY
	default n
	---help---
		Enable the NuttX test collection, based on the Unity test framework.

if TESTING_NEST

comment "Program options"

config TESTING_NEST_PROGNAME
	string "Program name"
	default "nest"
	---help---
		The name of the program.

config TESTING_NEST_STACKSIZE
	int "Stack size"
	default 1024
	---help---
		Size of the stack used to create the task.

comment "Test Suites"

comment "Collections"

config TESTING_NEST_COLLECTIONS
	bool "Collections tests"
	default n
	---help---
		Enable test suites for collections.

if TESTING_NEST_COLLECTIONS

config TESTING_NEST_COLLECTIONS_LIST
	bool "List testing"
	default y
	---help---
		Enable list test cases.

config TESTING_NEST_COLLECTIONS_CBUF
	bool "Circular buffer testing"
	default y
	---help---
		Enable circular buffer test cases.

config TESTING_NEST_COLLECTIONS_HMAP
	bool "Hashmap testing"
	default y
	---help---
		Enable hash map test cases.

endif # TESTING_NEST_COLLECTIONS

comment "Devices"

config TESTING_NEST_DEVICES
	bool "Device tests"
	default n
	---help---
		Enable test suites for devices.

if TESTING_NEST_DEVICES

config TESTING_NEST_DEVICES_DEVNULL
	bool "/dev/null test"
	depends on DEV_NULL
	default y
	---help---
		Enable test cases for /dev/null device.

config TESTING_NEST_DEVICES_DEVZERO
	bool "/dev/zero test"
	depends on DEV_ZERO
	default y
	---help---
		Enable test cases for /dev/zero device.

config TESTING_NEST_DEVICES_DEVASCII
	bool "/dev/ascii test"
	depends on DEV_ASCII
	default y
	---help---
		Enable test cases for /dev/ascii device.

config TESTING_NEST_DEVICES_DEVCONSOLE
	bool "/dev/console test"
	depends on DEV_CONSOLE
	default y
	---help---
		Enable test cases for /dev/console device.

config TESTING_NEST_DEVICES_DEVURANDOM
	bool "/dev/urandom test"
	depends on DEV_URANDOM
	default y
	---help---
		Enable test cases for /dev/urandom device.

endif # TESTING_NEST_DEVICES

endif # TESTING_NEST
```

## testing/nist-sts/Kconfig
```kconfig
#
# For a description of the syntax of this configuration file,
# see the file kconfig-language.txt in the NuttX tools repository.
#

config TESTING_NIST_STS
	tristate "NIST Statistical Test Suite"
	default n
	---help---
		https://csrc.nist.gov/projects/random-bit-generation/documentation-and-software

if TESTING_NIST_STS

config TESTING_NIST_STS_PROGNAME
	string "Program name"
	default "nist_sts"

config TESTING_NIST_STS_PRIORITY
	int "nist_sts task priority"
	default 100

config TESTING_NIST_STS_STACKSIZE
	int "nist_sts stack size"
	default 8192

config TESTING_NIST_STS_VERSION
	string "nist_sts version"
	default "2_1_2"

endif
```
