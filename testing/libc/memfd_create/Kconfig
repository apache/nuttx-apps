## testing/nettest/Kconfig
```kconfig
#
# For a description of the syntax of this configuration file,
# see the file kconfig-language.txt in the NuttX tools repository.
#

config TESTING_NET_TEST
	tristate "vela cmocka net test"
	default n
	depends on TESTING_CMOCKA
	depends on NET
	---help---
		Enable the cmocka net test

if TESTING_NET_TEST

config TESTING_NET_TEST_PRIORITY
	int "Task priority"
	default 100

config TESTING_NET_TEST_STACKSIZE
	int "Stack size"
	default DEFAULT_TASK_STACKSIZE

config TESTING_NET_TCP
	bool "Enable cmocka net tcp test"
	depends on NET_TCP && NET_TCPBACKLOG
	depends on NET_IPv4 || NET_IPv6
	default y

if TESTING_NET_TCP

config TESTING_NET_TCP_PORT
	int "TCP port of test server"
	default 5471

endif

config TESTING_NET_UDP
	bool "Enable cmocka net udp test"
	depends on NET_UDP && !NET_UDP_NO_STACK
	depends on NET_IPv4 && NET_IPv6 && NET_LOOPBACK && NET_SOCKOPTS
	default y
	---help---
		Test UDP sockets of AF_INET and AF_INET6 on one port over the
		loopback device: IPV6_V6ONLY (also on TCP sockets), the delivery
		of IPv4 and IPv6 datagrams, and EADDRINUSE from bind()
		(cmocka_net_udp).

config TESTING_NET_LOCAL
	bool "Enable cmocka net local test"
	depends on NET_LOCAL && NET_LOCAL_SCM
	default y

config TESTING_NET_LOCAL_DGRAM
	bool "Enable cmocka net local datagram test"
	depends on NET_LOCAL && NET_LOCAL_DGRAM
	depends on !DISABLE_PTHREAD && !DISABLE_POSIX_TIMERS
	default y
	---help---
		Test connect(), send(), getpeername(), poll(), select() and epoll
		of Unix domain datagram sockets, and that POLLHUP of pipes and
		stream sockets stays (cmocka_net_local_dgram).  The first optional
		argument of the program is a writable directory for the socket
		names (default P_tmpdir).  The second is a cmocka filter, to run
		some of the cases.

config TESTING_NET_OTHERS
	bool "Enable cmocka net other test"
	default y

config TESTING_NET_MCAST
	bool "Enable cmocka net multicast test"
	depends on NET_UDP && !NET_UDP_NO_STACK
	depends on NET_SOCKOPTS && NET_LOOPBACK
	depends on NET_IGMP || NET_MLD
	default y

config TESTING_NET_RADIO
	bool "Enable cmocka net radio socket test"
	depends on NET_BLUETOOTH || NET_IEEE802154
	default y
	---help---
		Test that recvfrom() on a Bluetooth or IEEE 802.15.4 socket with
		no radio device fails with ENODEV and leaves the socket usable
		(cmocka_net_radio).

config TESTING_NET_TIMESTAMP
	bool "Enable cmocka net timestamp test"
	depends on NET_TIMESTAMP && NET_PKT
	default n

endif
```

## wireless/bluetooth/zblue/Kconfig
```kconfig
#
# For a description of the syntax of this configuration file,
# see the file kconfig-language.txt in the NuttX tools repository.
#

menuconfig ZBLUE
	bool "zblue: Zephyr Bluetooth host"
	default n
	depends on ARCH_SIM
	depends on TLS_NELEM > 0
	depends on !WIRELESS_BLUETOOTH_HOST && !NIMBLE
	depends on UART_BTH4
	select CRYPTO_MBEDTLS
	select MBEDTLS_AES_C
	select MBEDTLS_CIPHER_C
	select MBEDTLS_CMAC_C
	select MBEDTLS_ECP_C
	select MBEDTLS_ECDH_C
	select MBEDTLS_ECP_DP_SECP256R1_ENABLED
	select MBEDTLS_MD5_C
	select MBEDTLS_PSA_CRYPTO_C
	select MBEDTLS_CTR_DRBG_C
	select MBEDTLS_ENTROPY_C
	select MBEDTLS_SHA256_C
	select MBEDTLS_PLATFORM_C
	---help---
		The Bluetooth host of the Zephyr project, run unmodified in
		userspace on top of a small porting layer.  The source is
		downloaded from the Zephyr release given by ZBLUE_REF.

		Only the simulator is supported for now: initialized data in
		iterable RAM sections (net_buf pools) is not yet placed in .data
		by the board linker scripts.

		The Bluetooth features are configured with the original
		Zephyr CONFIG_BT_* options, in the file given by ZBLUE_CONF.
		They are resolved by the Zephyr Kconfig after download and do
		not appear in this menu.

		The controller is reached through /dev/ttyHCIx (UART_BTH4),
		so any NuttX driver registered with bt_driver_register() can
		be used.

if ZBLUE

config ZBLUE_REF
	string "Zephyr release"
	default "v4.5.0"
	---help---
		Zephyr git tag to download the Bluetooth host from.

config ZBLUE_CONF
	string "Zephyr Bluetooth configuration"
	default "zblue.conf"
	---help---
		Zephyr style configuration fragment with the CONFIG_BT_*
		options.  A relative path is relative to this directory.

config ZBLUE_HCI_DEVICE
	string "HCI device"
	default "/dev/ttyHCI0"

config ZBLUE_HCI_RX_STACKSIZE
	int "HCI RX thread stack size"
	default 2048

config ZBLUE_THREAD_PRIORITY
	int "Base priority of the Bluetooth threads"
	default 120
	---help---
		Zephyr cooperative priorities are mapped below this value,
		preemptive priorities above it.

config ZBLUE_PERIPHERAL_EXAMPLE
	tristate "Peripheral example"
	default n
	---help---
		"zblue_peripheral": advertise and accept connections, with
		the GAP and GATT services only.

endif # ZBLUE
```

## wireless/lora_pkt_fwd/Kconfig
```kconfig
#
# For a description of the syntax of this configuration file,
# see the file kconfig-language.txt in the NuttX tools repository.
#

config WIRELESS_LORA_PKT_FWD
	tristate "LoRaWAN Semtech UDP packet forwarder"
	default n
	depends on LPWAN_LORA_GW && NET_UDP && NETUTILS_NETLIB
	select NETUTILS_CODECS
	select CODECS_BASE64
	select LIBC_STRERROR if DEBUG_FEATURES
	---help---
		Forwards the packets received by a LoRa concentrator to a LoRaWAN
		network server using the Semtech UDP protocol version 2, and turns
		the downlink requests of the server into transmissions.

		Also provides the "lora" command, the equivalent of the AT command
		set of the vendor gateway firmwares.

if WIRELESS_LORA_PKT_FWD

config LORA_PKT_FWD_PROGNAME
	string "Program name"
	default "lora"

config LORA_PKT_FWD_PRIORITY
	int "Daemon task priority"
	default 100

config LORA_PKT_FWD_STACKSIZE
	int "Daemon stack size"
	default 8192

config LORA_PKT_FWD_VERSION
	string "Version reported by \"lora ver\""
	default "1.0.0"

config LORA_PKT_FWD_DEVPATH
	string "Concentrator device"
	default "/dev/lora0"

config LORA_PKT_FWD_SERVER
	string "Network server host name or address"
	default "192.168.15.100"
	---help---
		Host name or address of the LoRaWAN network server.  A name is
		resolved with getaddrinfo(), which needs NETDB_DNSCLIENT.

		The Things Network uses the regional cluster names, for example
		au1.cloud.thethings.network for AU915.

config LORA_PKT_FWD_PORT_UP
	int "Uplink UDP port"
	default 1700

config LORA_PKT_FWD_PORT_DOWN
	int "Downlink UDP port"
	default 1700

config LORA_PKT_FWD_EUI
	string "Gateway identifier"
	default "080027FFFF0C2338"
	---help---
		The 64 bit gateway identifier, as sixteen hexadecimal digits.  It has
		to match the gateway registered in the network server.

config LORA_PKT_FWD_EUI_FROM_MAC
	bool "Derive the gateway identifier from the Ethernet address"
	default n
	---help---
		Build the identifier out of the Ethernet address of eth0 instead of
		using the configured one, inserting FFFE in the middle as usual for
		an EUI-64.

config LORA_PKT_FWD_TXPOWER
	int "Transmit power of \"lora tx\" in dBm"
	default 14
	---help---
		Antenna power requested for the packet sent by the "lora tx"
		command.  The concentrator picks the closest entry of its gain
		table.

config LORA_PKT_FWD_KEEPALIVE
	int "PULL_DATA keepalive interval in seconds"
	default 5

config LORA_PKT_FWD_STATINTERVAL
	int "Status push interval in seconds"
	default 30

endif # WIRELESS_LORA_PKT_FWD
```
