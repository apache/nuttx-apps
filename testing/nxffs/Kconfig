## testing/nxffs/Kconfig
```kconfig
#
# For a description of the syntax of this configuration file,
# see the file kconfig-language.txt in the NuttX tools repository.
#

config TESTING_NXFFS
	tristate "NXFFS file system example"
	default n
	---help---
		Enable the NXFFS file system example

if TESTING_NXFFS

config TESTING_NXFFS_ARCHINIT
	bool "Architecture-specific initialization"
	default n
	---help---
		The default is to use the RAM MTD device at drivers/mtd/rammtd.c.
		But an architecture-specific MTD driver can be used instead by
		defining TESTING_NXFFS_ARCHINIT.  In this case, the
		initialization logic will call mtdpart_archinitialize() to obtain
		the MTD driver instance.

config TESTING_NXFFS_NEBLOCKS
	int "Number of erase blocks (simulated)"
	default 32
	depends on !TESTING_NXFFS_ARCHINIT
	---help---
		When TESTING_NXFFS_ARCHINIT is not defined, this test will use
		the RAM MTD device at drivers/mtd/rammtd.c to simulate FLASH.  In
		this case, this value must be provided to give the number of erase
		blocks in MTD RAM device.

		The size of the allocated RAM drive will be:

			RAMMTD_ERASESIZE * TESTING_NXFFS_NEBLOCKS

config TESTING_NXFFS_MAXNAME
	int "Max name size"
	default 128
	range 1 255
	---help---
		Determines the maximum size of names used in the filesystem

	config TESTING_NXFFS_MAXFILE
	int "Max file size"
	default 8192
	---help---
		Determines the maximum size of a file

config TESTING_NXFFS_MAXIO
	int "Max I/O"
	default 347

config TESTING_NXFFS_MAXOPEN
	int "Max open files"
	default 512

config TESTING_NXFFS_MOUNTPT
	string "NXFFS mountpoint"
	default "/mnt/nxffs"

config TESTING_NXFFS_NLOOPS
	int "Number of test loops"
	default 100

config TESTING_NXFFS_VERBOSE
	bool "Verbose output"
	default n

endif
```

## testing/osperf/Kconfig
```kconfig
#
# For a description of the syntax of this configuration file,
# see the file kconfig-language.txt in the NuttX tools repository.
#

config TESTING_OSPERF
	tristate "System performance profiling"
	default n
	---help---
		Measure the performance of core system functions, such as thread
		switching and the time required for semaphore execution

if TESTING_OSPERF

config TESTING_OSPERF_PRIORITY
	int "OS profiling task priority"
	default 100

config TESTING_OSPERF_STACKSIZE
	int "OS profiling stack size"
	default DEFAULT_TASK_STACKSIZE

endif
```

## testing/pthread/Kconfig
```kconfig
#
# For a description of the syntax of this configuration file,
# see the file kconfig-language.txt in the NuttX tools repository.
#

config TESTS_PTHREAD
	tristate "vela pthread test"
	default n
	---help---
		Enable pthread test for the vela

if TESTS_PTHREAD

config TESTS_PTHREAD_PRIORITY
	int "PTHREAD task priority"
	default 99

config TESTS_PTHREAD_STACKSIZE
	int "PTHREAD stack size"
	default 16384


config CM_PTHREAD_TEST
	bool "enbale pthread test"
	default n
	depends on TESTING_CMOCKA


endif # TESTS_PTHREAD
```

## testing/resmonitor/Kconfig
```kconfig
#
# For a description of the syntax of this configuration file,
# see the file kconfig-language.txt in the NuttX tools repository.
#

config TESTING_RESMONITOR
	bool "enable resource monitor [showinfo]"
	default n
	---help---
		Enable resource show with specific duration.
		Should not use with LOW_RESOURCE_TEST at the same time.

if TESTING_RESMONITOR

config TESTING_RESMONITOR_PRIORITY
	int "Task priority"
	default 100

config TESTING_RESMONITOR_STACKSIZE
	int "Stack size"
	default 4096

config TESTING_RESMONITOR_FILL
	bool "[filldisk/fillcpu/fillmem]"
	default n

endif
```

## testing/scanftest/Kconfig
```kconfig
#
# For a description of the syntax of this configuration file,
# see the file kconfig-language.txt in the NuttX tools repository.
#

config TESTING_SCANFTEST
	tristate "sscanf() test"
	default n
	---help---
		Enable sscanf() test

		For all tests to be successful, you need to enable
		CONFIG_LIBC_FLOATINGPOINT, CONFIG_LIBC_LONG_LONG and
		CONFIG_LIBC_SCANSET in addition.

if TESTING_SCANFTEST

config TESTING_SCANFTEST_PROGNAME
	string "Program name"
	default "scanftest"
	---help---
		This is the name of the program that will be used when the NSH ELF
		program is installed.

config TESTING_SCANFTEST_PRIORITY
	int "Scanftest task priority"
	default 100

config TESTING_SCANFTEST_STACKSIZE
	int "Scanftest stack size"
	default DEFAULT_TASK_STACKSIZE

endif
```

## testing/sched/Kconfig
```kconfig
#
# For a description of the syntax of this configuration file,
# see the file kconfig-language.txt in the NuttX tools repository.
#

config TESTS_SCHED
	tristate "vela sched test"
	default n
	---help---
		Enable sched test for the vela

if TESTS_SCHED


config TESTS_SCHED_PRIORITY
	int "sched task priority"
	default 99

config TESTS_SCHED_STACKSIZE
	int "sched stack size"
	default 16384

config CM_SCHED_TEST
	bool "enbale schedule test"
	default n
	depends on TESTING_CMOCKA


endif # TESTS_SCHED
```

## testing/sched/getprime/Kconfig
```kconfig
#
# For a description of the syntax of this configuration file,
# see the file kconfig-language.txt in the NuttX tools repository.
#

config TESTING_GETPRIME
	tristate "getprime example"
	default n
	---help---
		Enable the getprime example. This program is used to check multi
		thread performance mainly for SMP (but not limited to)

if TESTING_GETPRIME

config TESTING_GETPRIME_PROGNAME
	string "Program name"
	default "getprime"
	---help---
		This is the name of the program that will be used when the NSH ELF
		program is installed.

config TESTING_GETPRIME_PRIORITY
	int "getprime task priority"
	default 50

config TESTING_GETPRIME_STACKSIZE
	int "getprime stack size"
	default DEFAULT_TASK_STACKSIZE

config TESTING_GETPRIME_THREAD_PRIORITY
	int "getprime thread priority"
	default 10

endif
```

## testing/sched/pthread_mutex_perf/Kconfig
```kconfig
#
# For a description of the syntax of this configuration file,
# see the file kconfig-language.txt in the NuttX tools repository.
#

config TESTING_PTHREAD_MUTEX_PERF
	bool "Pthread Mutex Performance (pmutexp) testing"
	default n
	---help---
		Pthread Mutex Performance (pmp) helps to analyze the pthread
                mutex performance, by calling the function many times.

if TESTING_PTHREAD_MUTEX_PERF

config TESTING_PTHREAD_MUTEX_PERF_PROGNAME
	string "Program name"
	default "pmutexp"
	---help---
		This is the name of the program that will be used when the NSH ELF
		program is installed.

config TESTING_PTHREAD_MUTEX_PERF_PRIORITY
	int "Priority of pmutexp process"
	default 100

config TESTING_PTHREAD_MUTEX_PERF_STACKSIZE
	int "Stack size of pmutexp process"
	default DEFAULT_TASK_STACKSIZE

endif
```

## testing/sched/rwsem_test/Kconfig
```kconfig
#
# For a description of the syntax of this configuration file,
# see the file kconfig-language.txt in the NuttX tools repository.
#

config TESTING_RWSEM_TEST
	tristate "Reader-Writer Semaphore Comprehensive Test"
	default n
	---help---
		Enable reader-writer semaphore optimization test suite.
		This test validates the rwsem optimization that reduces
		unnecessary context switches.

		Test Coverage:
		- Core Correctness Tests (6 tests)
		- Performance Tests (3 tests)
		- Basic Functionality Tests (1 test)

if TESTING_RWSEM_TEST

config TESTING_RWSEM_TEST_PRIORITY
	int "RWSem test task priority"
	default 100

config TESTING_RWSEM_TEST_STACKSIZE
	int "RWSem test stack size"
	default 8192

endif
```

## testing/sched/smp/Kconfig
```kconfig
#
# For a description of the syntax of this configuration file,
# see the file kconfig-language.txt in the NuttX tools repository.
#

config TESTING_SMP
	tristate "SMP example"
	default n
	depends on SMP
	---help---
		Enable the SMP example.  This example basically extracts the pthread
		barrier test from apps/testing/ostest and adds some instrumentation
		useful for debugging SMP implementations.

if TESTING_SMP

config TESTING_SMP_NBARRIER_THREADS
	int "Number of barrier threads"
	default 8
	---help---
		Specifies the number of threads to create in the SMP test.  The default
		is 8 but a smaller number may be needed on systems without sufficient memory
		to start so many threads.

config TESTING_SMP_PROGNAME
	string "Program name"
	default "smp"
	---help---
		This is the name of the program that will be used when the NSH ELF
		program is installed.

config TESTING_SMP_PRIORITY
	int "SMP task priority"
	default 100

config TESTING_SMP_STACKSIZE
	int "SMP stack size"
	default DEFAULT_TASK_STACKSIZE

endif
```

## testing/sched/timerjitter/Kconfig
```kconfig
#
# For a description of the syntax of this configuration file,
# see the file kconfig-language.txt in the NuttX tools repository.
#

config TESTING_TIMERJITTER
	bool "timerjitter testing"
	default n
	---help---
		timerjitter helps profiling timer accuracy and real-time performance.

if TESTING_TIMERJITTER

config TESTING_TIMERJITTER_PRIORITY
	int "Priority of timerjitter process"
	default 100

config TESTING_TIMERJITTER_STACKSIZE
	int "Stack size of timerjitter process"
	default DEFAULT_TASK_STACKSIZE

endif
```

## testing/security/setest/Kconfig
```kconfig
#
# For a description of the syntax of this configuration file,
# see the file kconfig-language.txt in the NuttX tools repository.
#

config TESTING_SETEST
	bool "Secure Element driver test"
	default n
	depends on DEV_SE05X
	---help---
		Enable the Secure Element driver test

if TESTING_SETEST

config TESTING_SETEST_PROGNAME
	string "Program name"
	default "setest"
	---help---
		This is the name of the program that will be used when the NSH ELF
		program is installed.

config TESTING_SETEST_PRIORITY
	int "setest utility task priority"
	default 100

config TESTING_SETEST_STACKSIZE
	int "setest utility stack size"
	default DEFAULT_TASK_STACKSIZE

endif
```

## testing/sensortest/Kconfig
```kconfig
#
# For a description of the syntax of this configuration file,
# see the file kconfig-language.txt in the NuttX tools repository.
#

config TESTING_SENSORTEST
	tristate "Sensor driver test"
	default n
	---help---
		Enable the Sensor driver test

if TESTING_SENSORTEST

config TESTING_SENSORTEST_PROGNAME
	string "Program name"
	default "sensortest"
	---help---
		This is the name of the program that will be used when the NSH ELF
		program is installed.

config TESTING_SENSORTEST_PRIORITY
	int "Sensor driver test task priority"
	default 100

config TESTING_SENSORTEST_STACKSIZE
	int "Sensor driver test stack size"
	default DEFAULT_TASK_STACKSIZE

endif
```

## testing/sig_sp_test/Kconfig
```kconfig
#
# For a description of the syntax of this configuration file,
# see the file kconfig-language.txt in the NuttX tools repository.
#

config TESTING_SIG_SP_TEST
	tristate "Signal SP restore test"
	default n
	depends on BUILD_FLAT && ARCH_ARM
	---help---
		Test that modifying SP (REG_R13) in saved register context
		during a signal handler is honored on exception return.

		This verifies the SP context relocation in arm_sigdeliver.
		Only available for flat builds on ARM.

if TESTING_SIG_SP_TEST

config TESTING_SIG_SP_TEST_PROGNAME
	string "Program name"
	default "sig_sp_test"

config TESTING_SIG_SP_TEST_PRIORITY
	int "Task priority"
	default 100

config TESTING_SIG_SP_TEST_STACKSIZE
	int "Stack size"
	default 4096

endif
```

## testing/socket/Kconfig
```kconfig
#
# For a description of the syntax of this configuration file,
# see the file kconfig-language.txt in the NuttX tools repository.
#

config TESTS_SOCKET
	tristate "vela socket test"
	default n
	---help---
		Enable socket test for the vela

if TESTS_SOCKET


config TESTS_SOCKET_PRIORITY
	int "socket task priority"
	default 99

config TESTS_SOCKET_STACKSIZE
	int "socket stack size"
	default 16384

config CM_SOCKET_TEST
	bool "enbale socket test"
	default n
	depends on TESTING_CMOCKA


endif # TESTS_SOCKET
```

## testing/superpi/Kconfig
```kconfig
config SUPERPI
	tristate "SuperPI test"
	default n

if SUPERPI

config SUPERPI_PROGNAME
	string "Program Name"
	default "pi_css5"

config SUPERPI_STACKSIZE
	int "SuperPI stack size"
	default DEFAULT_TASK_STACKSIZE

config SUPERPI_PRIORITY
	int "Task PRIORITY"
	default 100
	---help---
		The higher the priority value, the lower the priority.

endif # SUPERPI
```

## testing/syscall/Kconfig
```kconfig
#
# For a description of the syntax of this configuration file,
# see the file kconfig-language.txt in the NuttX tools repository.
#

config TESTS_SYSCALL
	tristate "vela syscall test"
	default n
	---help---
		Enable syscall test for the vela

if TESTS_SYSCALL

config TESTS_SYSCALL_PRIORITY
	int "Syscall task priority"
	default 99

config TESTS_SYSCALL_STACKSIZE
	int "Syscall stack size"
	default 16384
	
config TESTS_SYSCALL_MOUNT_DIR
	string "Mount directory for the CM_SYSCALL_TEST"
	default "/data"

config CM_SYSCALL_TEST
    bool "enbale syscall test"
    default n
    depends on TESTING_CMOCKA

endif # TESTS_SYSCALL
```

## testing/testsuites/Kconfig
```kconfig
#
# For a description of the syntax of this configuration file,
# see the file kconfig-language.txt in the NuttX tools repository.
#

config TESTS_TESTSUITES
	tristate "vela test suite"
	default n
	depends on TESTING_CMOCKA
	---help---
		Enable testsuites for the vela

if TESTS_TESTSUITES

menu "Testsuite cases"

config TESTS_TESTSUITES_MOUNT_DIR
	string "Mount directory for the testsuites"
	default "/data"

config TESTS_TESTSUITES_PRIORITY
	int "Testsuites task priority"
	default 99

config TESTS_TESTSUITES_STACKSIZE
	int "Testsuites stack size"
	default 16384

config CM_FS_TEST
	bool "enable fs test"
	default n
	depends on PSEUDOFS_SOFTLINKS

config CM_SCHED_TEST
	bool "enable schedule test"
	default n

config CM_SYSCALL_TEST
	bool "enbale syscall test"
	default n
	depends on PIPES && SCHED_HAVE_PARENT

config CM_MM_TEST
	bool "enable MM test"
	default n

config CM_KVDB_TEST
	bool "enbale kvdb test"
	default n
	depends on KVDB

config CM_TIME_TEST
	bool "enable time test"
	depends on !DISABLE_POSIX_TIMERS && SIG_EVTHREAD
	default n
	depends on SIG_EVTHREAD

config CM_SOCKET_TEST
	bool "enbale socket test"
	default n
	depends on NET && NETDEV_LATEINIT

config CM_PTHREAD_TEST
	bool "enable pthread test"
	default n

config CM_SOCKET_TEST
	bool "enable socket test"
	depends on NET
	default n

config CM_SYSCALL_TEST
	bool "enable syscall test"
	default n

config CM_MUTEX_TEST
	bool "enable mutex test"
	default n

config CM_DFX_TEST
	bool "enbale dfx test"
	default n
	depends on NETUTILS_CJSON && DFX && DFX_EVENT

endmenu
endif # TESTS_TESTSUITES
```

## testing/time/Kconfig
```kconfig
#
# For a description of the syntax of this configuration file,
# see the file kconfig-language.txt in the NuttX tools repository.
#

config TESTS_TIME
	tristate "vela time test"
	default n
	---help---
		Enable time test for the vela

if TESTS_TIME

config TESTS_TIME_PRIORITY
	int "Time task priority"
	default 99

config TESTS_TIME_STACKSIZE
	int "Time stack size"
	default 16384

config CM_TIME_TEST
	bool "enbale time test"
	default n
	depends on TESTING_CMOCKA


endif # TESTS_TESTSUITES
```

## testing/unity-ostest/Kconfig
```kconfig
config TESTING_UNITY_OSTEST
	tristate "Unity OS test"
	default n
	select TESTING_UNITY
	---help---
		Enable the Unity implementation of OS test

if TESTING_UNITY_OSTEST

config TESTING_UNITY_OSTEST_STACKSIZE
	int "Unity OS test stack size"
	default 8192
	---help---
		Size of the stack.

endif # TESTING_UNITY_OSTEST
```
