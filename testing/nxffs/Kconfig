## testing/unity/Kconfig
```kconfig
#
# For a description of the syntax of this configuration file,
# see the file kconfig-language.txt in the NuttX tools repository.
#

config TESTING_UNITY
	bool "Unity testing support"
	default n
	---help---
		Enable support for the Unity testing framework

if TESTING_UNITY

config TESTING_UNITY_URL
	string "URL where Unity can be downloaded"
	default "https://github.com/ThrowTheSwitch/Unity/archive"

config TESTING_UNITY_VERSION
	string "Version number"
	default "2.4.3"

config TESTING_UNITY_EXCLUDE_SETJMP
	bool "Exclude SETJMP"
	default y
	---help---
		Select this if your toolchain does not support setjmp

config TESTING_UNITY_OUTPUT_COLOR
	bool "Output color"
	default n
	---help---
		Select this if your want to add some colors to your tests

endif # TESTING_UNITY
```

## tests/Kconfig
```kconfig
#
# For a description of the syntax of this configuration file,
# see misc/tools/kconfig-language.txt.
#

menu "Unity test framework"
source "$APPSDIR/tests/testing/Kconfig"
source "$APPSDIR/tests/unity/Kconfig"
source "$APPSDIR/tests/unity_usrsock/Kconfig"
source "$APPSDIR/tests/unity_ramtest/Kconfig"
endmenu
```

## tests/unity/Kconfig
```kconfig
#
# For a description of the syntax of this configuration file,
# see misc/tools/kconfig-language.txt.
#

config TESTS_UNITY
	bool "Unity fixture example"
	default n
	---help---
		Demonstrates Unity fixture and runs its unit test

if TESTS_UNITY

config TESTS_UNITY_PROGNAME
	string "Program name"
	default "unity"
	depends on BUILD_KERNEL
	---help---
		This is the name of the program that will be use when the NSH ELF
		program is installed.

endif
```

## tests/unity_ramtest/Kconfig
```kconfig
#
# For a description of the syntax of this configuration file,
# see misc/tools/kconfig-language.txt.
#

config TESTS_UNITY_RAMTEST
	bool "Automated RAM test"
	default n
	---help---
		Enable automated RAM test
```
