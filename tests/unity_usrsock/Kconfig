## tests/unity_usrsock/Kconfig
```kconfig
#
# For a description of the syntax of this configuration file,
# see misc/tools/kconfig-language.txt.
#

config TESTS_UNITY_USRSOCK
    bool "User-space networking stack API Unity tests"
    default n
    depends on NET
    depends on NET_USRSOCK
    depends on !DISABLE_POLL
    select PIPES
    ---help---
        Enable user-space networking stack API Unity tests
```

## tools/Kconfig
```kconfig
#
# For a description of the syntax of this configuration file,
# see the file kconfig-language.txt in the NuttX tools repository.
#

menu "Extra Tools"

menu "Wasm Build Options"

config TOOLS_WASM_BUILD
	bool "Enable Wasm build support"
	default n
	---help---
		If enabled, then then build system will trigger the Wasm build
		process. This will require the WASI-SDK to be installed on the
		host system.

endmenu # Wasm Build Options

endmenu # Extra Tools
```

## uploadfiles/Kconfig
```kconfig
#
# For a description of the syntax of this configuration file,
# see the file kconfig-language.txt in the NuttX tools repository.
#

config UPLOADFILES
	tristate "Upload Files to NuttX at /data"
	default n
	depends on FS_ROMFS
	---help---
		Mount the ROMFS file system at /data on NuttX containing the
		files that the use put this local "data" directory. 
```

## videoutils/openh264/Kconfig
```kconfig
#
# For a description of the syntax of this configuration file,
# see the file kconfig-language.txt in the NuttX tools repository.
#

config VIDEOUTILS_OPENH264
	bool "Enable openh264"
	default n
```

## wireless/bluetooth/Kconfig
```kconfig
#
# For a description of the syntax of this configuration file,
# see misc/tools/kconfig-language.txt.
#

menu "Bluetooth applications"

source "$APPSDIR/wireless/bluetooth/btsak/Kconfig"

endmenu # Bluetooth applications
```

## wireless/bluetooth/btsak/Kconfig
```kconfig
#
# For a description of the syntax of this configuration file,
# see misc/tools/kconfig-language.txt.
#

config BTSAK
	tristate "Bluetooth Swiss Army Knife"
	default n
	---help---
		Enable the Bluetooth Swiss Army Knife

if BTSAK

config BTSAK_PROGNAME
	string "Program name"
	default "bt"
	depends on BUILD_LOADABLE
	---help---
		This is the name of the program that will be use when the NSH ELF
		program is installed.

config BTSAK_PRIORITY
	int "btsak task priority"
	default 100

config BTSAK_STACKSIZE
	int "btsak stack size"
	default 2048

if NET_6LOWPAN && !NET_BLUETOOTH

config BTSAK_DEFAULT_PORT
	int "Default Port"
	default 61616
	---help---
		The default port to be used for commands when using btsak through a
		Pv6 network interface (ex. wpan0). Port is 61616 because 6LoWPAN has
		special compression for port 61616-61631

endif

endif
```

## wireless/bluetooth/nimble/Kconfig
```kconfig
#
# For a description of the syntax of this configuration file,
# see misc/tools/kconfig-language.txt.
#

config NIMBLE
	bool "Apache NimBLE (BLE host-layer)"
	default n
	depends on !WIRELESS_BLUETOOTH_HOST
	---help---
		Enable Apache NimBLE Bluetooth Low Energy
		host-layer stack.

if NIMBLE

config NIMBLE_REF
	string "Version"
	default "fb15c844542e812ceb49ab5ac8502dc93c167b90"
	---help---
		Git ref name to use when downloading from NimBLE repo

config NIMBLE_CALLOUT_THREAD_STACKSIZE
	int "Stack size of NimBLE NPL callout thread"
	default DEFAULT_TASK_STACKSIZE

if DEBUG_FEATURES

config NIMBLE_DEBUG_ERROR
	bool "Apache NimBLE error output"
	default n
	depends on DEBUG_ERROR

config NIMBLE_DEBUG_WARN
	bool "Apache NimBLE warnings output"
	default n
	depends on DEBUG_ERROR

config NIMBLE_DEBUG_INFO
	bool "Apache NimBLE informational debug output"
	default n
	depends on DEBUG_INFO

endif # DEBUG_FEATURES

config NIMBLE_TINYCRYPT
	bool "Apache NimBLE tinycrypt support"
	default y

config NIMBLE_MESH
	bool "Apache NimBLE mesh support"
	default n
	depends on EXPERIMENTAL

menu "NimBLE role configuration"

config NIMBLE_ROLE_BROADCASTER
	bool "NimBLE broadcaster role"
	default n

config NIMBLE_ROLE_CENTRAL
	bool "NimBLE central role"
	default n

config NIMBLE_ROLE_OBSERVER
	bool "NimBLE observer role"
	default n

config NIMBLE_ROLE_PERIPHERAL
	bool "NimBLE peripheral role"
	default n

endmenu # "NimBLE role configuration"

choice
	prompt "NimBLE BLE version"
	default NIMBLE_BLE_VERSION_50

config NIMBLE_BLE_VERSION_50
	bool "NimBLE BLE version 5.0"

config NIMBLE_BLE_VERSION_51
	bool "NimBLE BLE version 5.1"

config NIMBLE_BLE_VERSION_52
	bool "NimBLE BLE version 5.2"

config NIMBLE_BLE_VERSION_53
	bool "NimBLE BLE version 5.3"

endchoice # "NimBLE BLE version"

config NIMBLE_BLE_VERSION
	int
	default 50 if NIMBLE_BLE_VERSION_50
	default 51 if NIMBLE_BLE_VERSION_51
	default 52 if NIMBLE_BLE_VERSION_52
	default 53 if NIMBLE_BLE_VERSION_53

menu "NimBLE BLE features"

config NIMBLE_BLE_SUBRATING
	bool "NimBLE connection subrating support"
	default n

config NIMBLE_BLE_EXT_ADV
	bool "NimBLE extended advertising support"
	default n

config NIMBLE_BLE_EXT_ADV_MAX_SIZE
	int "NimBLE extended advertising maximum size"
	depends on NIMBLE_BLE_EXT_ADV
	range 31 1650
	default 31

config NIMBLE_BLE_MAX_CONN
	int "NimBLE maximum number of connections"
	default 1

config NIMBLE_BLE_MAX_PERIODIC_SYNCS
	int "NimBLE maximum number of period syncs"
	default 1

config NIMBLE_BLE_MULTI_ADV_INSTANCES
	int "NimBLE number of multi-advertising instances"
	default 0
	---help---
		The total number of advertising instances is this number plus 1

config NIMBLE_BLE_PERIODIC_ADV
	bool "NimBLE periodic advertising support"
	default n

config NIMBLE_BLE_PERIODIC_ADV_SYNC_TRANSFER
	int "NimBLE periodic advertising sync transfer support"
	depends on NIMBLE_BLE_PERIODIC_ADV && NIMBLE_BLE_VERSION > 50
	default 0

config NIMBLE_BLE_POWER_CONTROL
	bool "NimBLE BLE LE power control support"
	depends on NIMBLE_BLE_VERSION > 51
	default n

config NIMBLE_BLE_WHITELIST
	bool "NimBLE BLE whitelist support"
	default n

endmenu # "NimBLE BLE features"

menu "NimBLE BLE Host configuration"

config NIMBLE_HS_FLOW_CTRL
	bool "NimBLE Host flow control enable"
	default n

endmenu # "NimBLE BLE Host configuration"

config NIMBLE_BLE_ATT_PREFFERED_MTU
	int "NimBLE preferred MTU size"
	default 256

config NIMBLE_L2CAP_COC_MAX_NUM
	int "NimBLE maximum number of connection oriented channels"
	range 0 9
	default 0
	---help---
		When set to 0, BLE COC is disabled

menu "NimBLE BLE privacy and security settings"

config NIMBLE_BLE_RPA_TIMEOUT
	int "NimBLE BLE RPA timeout"
	default 300
	---help---
		The rate that new random addresses should be generated (seconds)

config NIMBLE_BLE_SM_BONDING
	bool "NimBLE BLE bonding enable"
	default y
	---help---
		Enables bonding (persistence and restoration of secure links)

config NIMBLE_BLE_SM_LEGACY
	bool "NimBLE security manager legacy pairing"
	default y

config NIMBLE_BLE_SM_SC
	bool "NimBLE security manager secure connections"
	default y

if NIMBLE_BLE_SM_SC

config NIMBLE_BLE_SM_SC_DEBUG
	bool "NimBLE secure connections debug mode"
	default n

config NIMBLE_BLE_SM_SC_ONLY
	bool "NimBLE secure connections pairing only"
	default n

endif # NIMBLE_BLE_SM_SC

endmenu # "NimBLE BLE security manager settings"

menu "NimBLE memory configuration"

config NIMBLE_MSYS_1_BLOCK_COUNT
	int "NimBLE MSYS_1 block count"
	default 12

config NIMBLE_MSYS_1_BLOCK_SIZE
	int "NimBLE MSYS_1 block size"
	default 292

config NIMBLE_MSYS_2_BLOCK_COUNT
	int "NimBLE MSYS_2 block count"
	default 0

config NIMBLE_MSYS_2_BLOCK_SIZE
	int "NimBLE MSYS_2 block size"
	default 0

endmenu # "NimBLE memory configuration"

config NIMBLE_PORTING_EXAMPLE
	bool "Apache NimBLE NuttX porting example"
	default y

if NIMBLE_PORTING_EXAMPLE

config NIMBLE_PORTING_EXAMPLE_STACKSIZE
	int "Apache NimBLE NuttX porting example stack size"
	default DEFAULT_TASK_STACKSIZE

endif # NIMBLE_PORTING_EXAMPLE

endif # NIMBLE
```

## wireless/esp-hosted/Kconfig
```kconfig
#
# For a description of the syntax of this configuration file,
# see the file kconfig-language.txt in the NuttX tools repository.
#

config ESP_HOSTED
	bool "Use ESP32 HOSTED as a Tethering device to connect to the Internet"
	default n
	---help---
		Enable ESP Hosted Library to Enable Network in Non Wifi BT Boards
```

## wireless/gs2200m/Kconfig
```kconfig
#
# For a description of the syntax of this configuration file,
# see the file kconfig-language.txt in the NuttX tools repository.
#

config WIRELESS_GS2200M
	tristate "Telit GS2200M usrsock daemon"
	default n
	depends on NET_USRSOCK && WL_GS2200M
	select NET_USRSOCK_TCP
	select PIPES
	---help---
		Enable support for the gs2200m usrsock daemon

if WIRELESS_GS2200M
config WIRELESS_GS2200M_PROGNAME
	string "gs2200m program name"
	default "gs2200m"

config WIRELESS_GS2200M_PRIORITY
	int "gs2200m task priority"
	default 50

config WIRELESS_GS2200M_STACKSIZE
	int "gs2200m stack size"
	default DEFAULT_TASK_STACKSIZE

endif
```

## wireless/ieee802154/Kconfig
```kconfig
#
# For a description of the syntax of this configuration file,
# see misc/tools/kconfig-language.txt.
#

menu "IEEE 802.15.4 applications"

source "$APPSDIR/wireless/ieee802154/libmac/Kconfig"
source "$APPSDIR/wireless/ieee802154/libutils/Kconfig"
source "$APPSDIR/wireless/ieee802154/i8sak/Kconfig"
source "$APPSDIR/wireless/ieee802154/i8shark/Kconfig"

endmenu #ieee 802.15.4 apps
```

## wireless/ieee802154/coord/Kconfig
```kconfig
#
# For a description of the syntax of this configuration file,
# see misc/tools/kconfig-language.txt.
#

config IEEE802154_COORD
	bool "Generic IEEE 802.15.4 coordinator"
	default n
	select IEEE802154_COMMON
	---help---
		Enable the IEEE 802.15.4 generic coordinator

if IEEE802154_COORD

config IEEE802154_COORD_PROGNAME
	string "Program name"
	default "coord"
	depends on BUILD_KERNEL
	---help---
		This is the name of the program that will be use when the NSH ELF
		program is installed.

endif
```

## wireless/ieee802154/i8sak/Kconfig
```kconfig
#
# For a description of the syntax of this configuration file,
# see misc/tools/kconfig-language.txt.
#

config IEEE802154_I8SAK
	bool "IEEE 802.15.4 Swiss Army Knife"
	default n
	select IEEE802154_LIBUTILS
	select IEEE802154_LIBMAC
	---help---
		Enable the IEEE 802.15.4 Swiss Army Knife

if IEEE802154_I8SAK

config IEEE802154_I8SAK_PROGNAME
	string "Program name"
	default "i8"
	depends on BUILD_LOADABLE
	---help---
		This is the name of the program that will be use when the NSH ELF
		program is installed.

config IEEE802154_I8SAK_PRIORITY
	int "i8sak task priority"
	default 100

config IEEE802154_I8SAK_STACKSIZE
	int "i8sak stack size"
	default 4096

if NET_6LOWPAN
config IEEE802154_I8SAK_DEFAULT_PORT
	int "Default Port"
	default 61616
	---help---
		The default port to be used for blaster/tx/sniffer commands when using
		i8sak through a network interface (ex. wpan0). Port is 61616 because
		6LoWPAN has special compression for port 61616-61631
endif

endif
```

## wireless/ieee802154/i8shark/Kconfig
```kconfig
#
# For a description of the syntax of this configuration file,
# see the file kconfig-language.txt in the NuttX tools repository.
#

config IEEE802154_I8SHARK
	tristate "IEEE 802.15.4 Wireshark adapter"
	default n
	select IEEE802154_LIBUTILS
	select IEEE802154_LIBMAC
	depends on IEEE802154_MACDEV && NET_UDP && NET_IPv4

if IEEE802154_I8SHARK

config IEEE802154_I8SHARK_DEVPATH
	string "MAC char driver path"
	default "/dev/ieee0"
	---help---
		The default path to MAC character driver. Default: /dev/ieee0

config IEEE802154_I8SHARK_HOST_IPADDR
	hex "Host IP address where Wireshark is running"
	default 0x0a000001

config IEEE802154_I8SHARK_XBEE_APPHDR
	bool "XBee App Header compensation"
	default n
	---help---
		XBee radios use an optional "application header" to support duplicate
		frame detection. Wireshark does not know about this header and it causes
		packets not to be recognized appropriately (6LoWPAN etc.). This option
		blindly chops the first 2 bytes of payload from all incoming frames to
		remove the header. This option can only be used when sniffing XBee-only
		networks, as any frames not containing the application header will have
		2 arbitrary bytes removed from it.

endif
```

## wireless/ieee802154/libmac/Kconfig
```kconfig
#
# For a description of the syntax of this configuration file,
# see misc/tools/kconfig-language.txt.
#

config IEEE802154_LIBMAC
	bool "IEEE 802.15.4 MAC library routines"
	default n
	---help---
		Some MAC library routines for ieee 802.15.4 apps
```

## wireless/ieee802154/libradio/Kconfig
```kconfig
#
# For a description of the syntax of this configuration file,
# see misc/tools/kconfig-language.txt.
#

config IEEE802154_LIBRADIO
	bool "IEEE 802.15.4 radio library routines"
	default n
	---help---
		Some radio library routines for ieee 802.15.4 apps
```

## wireless/ieee802154/libutils/Kconfig
```kconfig
#
# For a description of the syntax of this configuration file,
# see misc/tools/kconfig-language.txt.
#

config IEEE802154_LIBUTILS
	bool "Common IEEE 802.15.4 library routines"
	default n
	---help---
		Some common library routines for ieee 802.15.4 apps
```

## wireless/ieee802154/wpanlistener/Kconfig
```kconfig
#
# For a description of the syntax of this configuration file,
# see misc/tools/kconfig-language.txt.
#

config IEEE802154_WPANLISTENER
	bool "WPAN Listener Module for receiving various IEEE 802.15.4 MAC events"
	default n
	select IEEE802154_MAC_DEV
	select IEEE802154_LIBUTILS
	select IEEE802154_LIBMAC
	---help---
		Enable the IEEE 802.15.4 WPAN Listener

if IEEE802154_WPANLISTENER

config WPANLISTENER_NFRAMERECEIVERS
	int "Number of frame receivers"
	default 3

config WPANLISTENER_NEVENTRECEIVERS
	int "Number of event receivers"
	default 3

endif
```

## wireless/iwpan/Kconfig
```kconfig
#
# For a description of the syntax of this configuration file,
# see the file kconfig-language.txt in the NuttX tools repository.
#

menuconfig WIRELESS_IWPAN
	tristate "IEEE 802.15.4 Command Line Tool"
	default n
	depends on NET && DRIVERS_WIRELESS
	select IEEE802154_LIBMAC
	select IEEE802154_LIBUTILS
	---help---
		IWPAN is a tool similar to wapi and inspired by iwpan on Linux that can
		be used to manage 802.15.4 PAN.

if WIRELESS_IWPAN

config WIRELESS_IWPAN_PROGNAME
	string "Program Name"
	default "iwpan"
	depends on BUILD_LOADABLE
	---help---
		This is the name of the program that will be use when the NSH ELF
		program is installed.

config WIRELESS_IWPAN_STACKSIZE
	int "Stack Size (bytes)"
	default 2048

config WIRELESS_IWPAN_PRIORITY
	int "Command Priority"
	default 100

endif
```

## wireless/sx1262/Kconfig
```kconfig
#
# For a description of the syntax of this configuration file,
# see the file kconfig-language.txt in the NuttX tools repository.
#

menuconfig WIRELESS_SX1262
        tristate "Custom sx1262 App"
        default n
        ---help---
                Enable the Custom sx1262 App

if WIRELESS_SX1262

config WIRELESS_SX1262_PROGNAME
        string "Program name"
        default "custom_sx1262"
        ---help---
                This is the name of the program that will be used when the NSH ELF
                program is installed.

config WIRELESS_SX1262_PRIORITY
        int "Custom sx1262 task priority"
        default 100

config WIRELESS_SX1262_STACKSIZE
        int "Custom sx1262 stack size"
        default DEFAULT_TASK_STACKSIZE

endif
```
